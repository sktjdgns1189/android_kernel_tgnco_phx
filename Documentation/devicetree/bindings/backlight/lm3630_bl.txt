## Documentation/devicetree/bindings/power/bq5101x_charger.txt
```
TI BQ5101X Wireless Charger

The bq5101x wireless charger provides the AC/DC power conversion while integrating
the digital control required to comply with the Qi v1.0 communication protocol.

Required properties:

 - status: "okay" or "disabled" for this feature
 - compatible : Must be "ti,bq5101x"
 - bq5101x,mode : Set the default mode, it's an enum value:
			0: WLC and adapter mode
			1: WLC only mode
			2: OTG mode
			3: Disable mode
			(This mode value also relate to the design of en1/en2 gpios)

Optional properties:

 - interrupt-parent :		Interrupt gpio group parent.

 - interrupts :			Specific gpio for interrupt, it should be same as soc_gpio.

 - bq5101x,term_gpio :		Input that allows allows the upper termination threshold to
				be programmable.

 - bq5101x,fault_gpio :		As a CTRL pin pull to ground to send end power transfer (EPT)
				fault to the transmitter or pull-up to an internal rail
				(i.e. 1.8 V) to send EPT termination to the transmitter.

 - bq5101x,en1_gpio :		Inputs that allow user to enable/disable wireless and wired
 - bq5101x,en2_gpio :		charging <EN1 EN2>:
					<00> wireless charging is enabled unless AD voltage > 3.6 V
					<01> Dynamic communication current limit disabled
					<10> AD-EN pulled low, wireless charging disabled
					<11> wired and wireless charging disabled.

 - bq5101x,ad_en_n_gpio :	Push-pull driver for external PFET connecting AD and OUT.

 - bq5101x,chg_state_n_gpio :	Open-drain output, active when output current is being
				delivered to the load.

Example:
&soc {
	ti,bq5101x {
		status = "OK";
		compatible = "ti,bq5101x";
		interrupt-parent = <&msmgpio>;
		interrupts = <&msmgpio 144 0>;
		bq5101x,mode = <0>;
		bq5101x,en1_gpio = <&msmgpio 94 0>;
		bq5101x,en2_gpio = <&msmgpio 95 0>;
		bq5101x,chg_state_n_gpio = <&msmgpio 144 0>;
	};
};
```

## Documentation/devicetree/bindings/sound/fih-modification.txt
```
Two files are added to device tree for sound:
 - Audio_alsa_[HW ver].dsti
 - Audio_headset_[HW ver].dsti

    [HW ver] is the PCB hardware version, could be "evb" ...

Optional properties:
 - qcom,audio-routing: one new widget for headphone amplifier is defined:
			"Headphone amp". Please include the route if device has headphone
			amplifier.
 - qcom,top-spk-pamp-gpio: GPIO of top speaker amplifier enable pin
 - qcom,bottom-spk-pamp-gpio: GPIO of bottom speaker amplifier enable pin
 - qcom,hph-pamp-gpio: GPIO of headset amplifier enable pin. Be sure to
			add DAPM route also.
 - qcom,top-spk-select-gpio: GPIO of receiver/top speaker select pin. For
			those devices whose receiver and top speaker share same amplifier,
			please define this pin.

Example:
&soc {
	sound {
		qcom,model = "msm8974-taiko-liquid-snd-card";

		qcom,audio-routing =
			"RX_BIAS", "MCLK",
			"LDO_H", "MCLK",
			"Lineout_1 amp", "LINEOUT1",
			"Lineout_3 amp", "LINEOUT3",
			"Lineout_2 amp", "LINEOUT2",
			"Lineout_4 amp", "LINEOUT4",
			"Headphone amp", "HEADPHONE",
			"AMIC2", "MIC BIAS2 External",
			"MIC BIAS2 External", "Headset Mic",
			"DMIC1", "MIC BIAS1 External",
			"MIC BIAS1 External", "Digital Mic1",
			"DMIC3", "MIC BIAS3 External",
			"MIC BIAS3 External", "Digital Mic3";

		qcom,top-spk-pamp-gpio = <&msmgpio 8 0>;
		qcom,top-spk-select-gpio = <&msmgpio 11 0>;
		qcom,bottom-spk-pamp-gpio = <&msmgpio 9 0>;
		qcom,hph-pamp-gpio = <&pm8941_gpios 9 0>;
	};
};
```

## drivers/misc/sensor/Kconfig
```kconfig
menu "Sensors"

config HALL_SENSOR
        tristate "Hall sensor"
        help
          If you say yes here, you will enable hall sensor.

endmenu
```

## drivers/usb/dwc3/Kconfig
```kconfig
config USB_DWC3
	tristate "DesignWare USB3 DRD Core Support"
	depends on (USB || USB_GADGET)
	select USB_OTG_UTILS
	select USB_XHCI_PLATFORM if USB_SUPPORT && USB_XHCI_HCD
	help
	  Say Y or M here if your system has a Dual Role SuperSpeed
	  USB controller based on the DesignWare USB3 IP Core.

	  If you choose to build this driver is a dynamically linked
	  module, the module will be called dwc3.ko.

if USB_DWC3

config USB_DWC3_DEBUG
	bool "Enable Debugging Messages"
	help
	  Say Y here to enable debugging messages on DWC3 Driver.

config USB_DWC3_VERBOSE
	bool "Enable Verbose Debugging Messages"
	depends on USB_DWC3_DEBUG
	help
	  Say Y here to enable verbose debugging messages on DWC3 Driver.

config FIH_PROTECT_DWC3_CTRL_FUNC
	bool "Enable Protect DWC3_CTRL_FUNC"
	default y
	help
	  Say Y here to enable Protect DWC3_CTRL_FUNC.
	  When use Proprietary Charger that is two USB port and there D+
	  or D- connect each other.
	  The device has opportunity fail when charging connect two devices
	  because the device 1 can interfere device 2 through D+ or D-.
	  The device miss detect to SDP(USB port), In fact that should detect CDP(Charging port).
	  The device start fast reset and check link status until connect down or
	  unknown reset in dwc3_gadget_interrupt.

endif
```

## drivers/video/msm/mdss/Kconfig
```kconfig
config FB_MSM_MDSS_WRITEBACK
	bool "MDSS Writeback Panel"
	---help---
	The MDSS Writeback Panel provides support for routing the output of
	MDSS frame buffer driver and MDP processing to memory.

config FB_MSM_MDSS_HDMI_PANEL
	depends on FB_MSM_MDSS
	bool "MDSS HDMI Tx Panel"
	default n
	---help---
	The MDSS HDMI Panel provides support for transmitting TMDS signals of
	MDSS frame buffer data to connected hdmi compliant TVs, monitors etc.

config FB_MSM_MDSS_HDMI_MHL_SII8334
	depends on FB_MSM_MDSS_HDMI_PANEL
	bool 'MHL SII8334 support '
	default n
	---help---
	  Support the HDMI to MHL conversion.
	  MHL (Mobile High-Definition Link) technology
	  uses USB connector to output HDMI content

config FB_MSM_MDSS_DSI_CTRL_STATUS
	tristate "DSI controller status check feature"
	---help---
	  Check DSI controller status periodically (default period is 5
	  seconds) by sending Bus-Turn-Around (BTA) command. If DSI controller
	  fails to acknowledge the BTA command, it sends PANEL_ALIVE=0 status
	  to HAL layer to reset the controller.

config FB_MSM_MDSS_MDP3
	depends on FB_MSM_MDSS
	bool "MDP3 display controller"
	---help---
	The MDP3 provides support for an older version display controller
	included in latest display sub-system, known as MDSS.

config FB_MSM_MDSS_CABC_CONTROL
	bool "Support for CABC control"
	default n
	---help---
	  Say Y here if you want to control the CABC function of your display.

config FB_MSM_MDSS_COLOR_TEMPERATURE
	bool "Support for color temperature"
	default n
	---help---
	  Say Y here if you want to control the color temperature function of your display.

config FB_MSM_MDSS_COLOR_MODE
	bool "Support for color mode control"
	default n
	---help---
	  Say Y here if you want to control the color enhancement function of your display.

config FB_MSM_MDSS_NO_OTP
	bool "Support for timing sending control"
	default n
	---help---
	  Say Y here if you want to control the timing of sending mipi command.


config MIPI_DSI_MDSS_REG_DUMP
	bool "DSI and MDSS register dump"
	default n
	---help---
	  Say Y here if you want to dump the DSI and MDSS register value.
```
