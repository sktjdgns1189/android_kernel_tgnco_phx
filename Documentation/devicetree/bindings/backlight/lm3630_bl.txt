## Documentation/devicetree/bindings/backlight/lm3630_bl.txt
```
* TI LM3630A High-Efficiency Dual-String White LED Driver

Required properties:
 - compatible: Should be "ti,lm3630"
 - reg: Should contain registers location and length

Optional properties:
 - ti,max-brt-led:  maximum brightness, should less or equal than 0xFF
 - ti,init-brt-led: initial brightness
 - ti,pwm-ctrl: 0 for disable pwm input, 1 for enable
 - ti,pwm-active: 0 for low active
 - ti,hwen-gpio: enable pin
 - ti,fs-current: full-scale current, refer to datasheet for setting

Example:
	lm3630_bl@36 {
		compatible = "ti,lm3630";
		reg = <0x36>;
		ti,max-brt-led = <0xFF>;
		ti,init-brt-led = <0xFF>;
		ti,pwm-ctrl = <0x01>;
		ti,pwm-active = <0x00>;
		ti,hwen-gpio = <&pm8941_gpios 24 0x00>;
		ti,fs-current = <0x14>;
	};
```

## Documentation/devicetree/bindings/input/touchscreen/ft5406-ts.txt
```
FocalTech touch controller

The focaltech controller is connected to host processor
via i2c. The controller generates interrupts when the
user touches the panel. The host controller is expected
to read the touch coordinates over i2c and pass the coordinates
to the rest of the system.

Required properties:

 - compatible		: should be "focaltech,5406"
 - reg			: i2c slave address of the device
 - interrupt-parent	: parent of interrupt
 - interrupts		: touch sample interrupt to indicate presense or release
				of fingers on the panel.
 - vdd_enable		: Power enable pin needed to power up the device
 - vcc_i2c-supply	: Power source required to power up i2c bus

Optional properties:

 - focaltech,name	: name of the controller
 - focaltech,reset-gpio	: reset gpio to control the reset of chip
 - focaltech,irq-gpio	: irq gpio which is to provide interrupts to host,
				same as "interrupts" node. It will also
				contain active low or active high information.
 - focaltech,family-id	: family identification of the controller
 - focaltech,display-coords : display coordinates in pixels. It is a four
				tuple consisting of min x, min y, max x and
				max y values
 - focaltech,fw-name	: Specify the firmware file name
 - focaltech,hard-reset-delay-ms	: reset timing between pull low and high (ms)
 - focaltech,soft-reset-delay-ms	: wait timing after reset chip (ms)
 - focaltech,num-max-touches	: This chip support how many touch event
 - focaltech,fw-delay-aa-ms : The delay timing after write 0xaa at register when upgrade firmware (ms)
 - focaltech,fw-delay-55-ms : The delay timing after write 0x55 at register when upgrade firmware (ms)
 - focaltech,fw-upgrade-id1 : The id1 will be read to check chip already go into bootloader mode
 - focaltech,fw-upgrade-id2 : The id2 will be read to check chip already go into bootloader mode
 - focaltech,fw-delay-readid-ms : The delay timing before read id1 and id2
 - focaltech,fw-delay-era-flsh-ms : The delay timing of erase flash data
 - focaltech,fw-auto-cal : This chip support auto calibration or not
 - focaltech,vcc-i2c-always-on: The vcc_i2c pin is always on or not,
				if it is always on, the "vcc_i2c-supply" term can be ignored and we need not to control the vcc_i2c pin in the driver

Example:
	i2c@f9923000{
		focaltech,touch@38 {
			compatible = "focaltech,5406";
			reg = <0x38>;
			interrupt-parent = <&msmgpio>;
			interrupts = <59 0x2>;
			vdd_enable = <&pm8941_gpios 1 1>;
			vcc_i2c-supply = <&pm8941_lvs1>;
			focaltech,name = "ft5406";
			focaltech,family-id = <0x55>;
			focaltech,reset-gpio = <&msmgpio 60 0x00>;
			focaltech,irq-gpio = <&msmgpio 59 0x00>;
			focaltech,display-coords = <0 0 1080 1920>;
			focaltech,panel-coords = <0 0 1080 2000>;
			focaltech,fw-name = "ft5x06_fw_0D.bin";
			focaltech,hard-reset-delay-ms = <3>;
			focaltech,soft-reset-delay-ms = <197>;
			focaltech,num-max-touches = <5>;
			focaltech,fw-delay-aa-ms = <50>;
			focaltech,fw-delay-55-ms = <30>;
			focaltech,fw-upgrade-id1 = <0x79>;
			focaltech,fw-upgrade-id2 = <0x03>;
			focaltech,fw-delay-readid-ms = <10>;
			focaltech,fw-delay-era-flsh-ms = <2000>;
			focaltech,fw-auto-cal;
		};
	};
```

## Documentation/devicetree/bindings/misc/drv2603_vibrator.txt
```
TI DRV2603 Haptics driver with LRA/ERM

The DRV2603 is a haptics driver designed specifically to solve common obstacles
in driving both Linear Resonance Actuator (LRA) and Eccentric Rotating Mass (ERM)
hpatic elements.

Required properties:

 - status: "okay" or "disabled" for this feature
 - compatible : Must be "ti,drv2603"
 - drv2603,en_gpio : Enable pin.
 - drv2603,pwm_gpio : PWM input pin.
 - drv2603,mode_ctrl : control mode: 0 or 1 means PWM or CLK.

Optional properties:

 - drv2603,default_level : The level which pwm percentage for turn on:
				range: 1 ~ 50 (Default: 50)

 - drv2603,max_timeout_ms : The max time for turn on vibrator, Default: 15000.

 - drv2603,vib_break_ms : The break time when turn off, Default: 10.

 - drv2603,pwm_channel : PWM channel index, need to check the PWM provider. (Only
				for PWM mode)

 - drv2603,pwm_freq_hz : The pwm specific freq, Default:3000. (Only for PWM mode)

Example:
&soc {
	ti,drv2603 {
		status = "okay";
		compatible = "ti,drv2603";
		drv2603,en_gpio = <&msmgpio 86 0>;
		drv2603,pwm_gpio = <&pm8941_gpios 16 0>;
		drv2603,mode_ctrl = <1>;

		drv2603,default_level = <50>;
		drv2603,max_timeout_ms = <15000>;
		drv2603,vib_break_ms = <10>;
	};
};
```

## Documentation/devicetree/bindings/power/battery_protection.txt
```
Battery Protection drivers

This is a software control driver for battery protection when temperature
is too high or too low, then try to limit charge functionality to avoid
to make battery demage

Required properties:

 - status: "okay" or "disabled" for this feature

 - compatible : Must be "battery_protection"

 - batt_protect,bat_name : The power-supply name for battery type, and
				this is used to get battery temperature.

 - batt_protect,chg_name : The power-supply name for charger type, and
				this is used to set charger limitation.

 - batt_protect,negative_offset : The negative offset for temperature threshold,
					used to calculate the real temperature by sub function.

Child node properties:

 - action,type : Define this child for which range temperature,
			0/1/2/3/4 means normal/hot/warm/cool/cold type, and temperature
			value is T-hot > T-warm > T-normal > T-cool > T-cold

 - action,enabled : Define this setting is used or not.

 - action,temp_c : Define the temperature threshold, the unit is 0.1 degree C.

 - action,vol_mv : Define the battery charge maximum voltage, the unit is mV.

 - action,cur_ma : Define the battery charge maximum current, the unit is mA.
			Note that if this value is 0, it means to disable charge feature.

Example:
&soc {
	batt_protect {
		status = "okay";
		compatible = "battery_protection";
		batt_protect,bat_name = "battery";
		batt_protect,chg_name = "wall";
		batt_protect,negative_offset = <0>;
		batt_protect,normal {
			action,type = <0>;
			action,enabled = <1>;
			action,temp_c = <0>;
			action,vol_mv = <4352>;
			action,cur_ma = <2048>;
		};
		batt_protect,hot {
			action,type = <1>;
			action,enabled = <1>;
			action,temp_c = <550>;
			action,vol_mv = <4352>;
			action,cur_ma = <0>;
		};
		batt_protect,warm {
			action,type = <2>;
			action,enabled = <1>;
			action,temp_c = <450>;
			action,vol_mv = <4112>;
			action,cur_ma = <2048>;
		};
		batt_protect,cool {
			action,type = <3>;
			action,enabled = <0>;
			action,temp_c = <0>;
			action,vol_mv = <0>;
			action,cur_ma = <0>;
		};
		batt_protect,cold {
			action,type = <4>;
			action,enabled = <1>;
			action,temp_c = <0>;
			action,vol_mv = <4352>;
			action,cur_ma = <0>;
		};
	};
};
```

## Documentation/devicetree/bindings/power/bq2419x_charger.txt
```
TI BQ2419X I2C Charger Chip

The device interface is I2C, its I2C slave 7-bit address is 0x6b.

Required properties:

 - status: "okay" or "disabled" for this feature
 - compatible : Must be "ti,bq2419x"
 - reg : I2C Address must be 0x6b.

Optional properties:

 - interrupt-parent :			Interrupt gpio group parent.

 - interrupts :				Specific gpio for interrupt, it should be same as gpio_int.

 - bq2419x,gpio_int :			Open-drain interrupt output pin, send active low, 256us pulse
					to host to report charger device status and fault.

 - bq2419x,gpio_ce :			Active low charge ennable pin, battery charging is enabled when
					REG01[5:4]=01 and CE pin = low. This must be pull high or low.

 - bq2419x,gpio_psel :			Power source select input pin, high indicates a USB host source,
					and low indicates an adapter source.

 - bq2419x,gpio_chgpg :			Open-drain active low power good indicator, Low indicates a good
					input source.

 - bq2419x,gpio_chgotg :		USB current limit selection pin during buck mode, and avtive high
					enable pin during boost mode.

 - bq2419x,gpio_chgstat :		Open-drain charge status output pin, low indicates charge in progress,
					high indicates charge complete or charge disabled, and blinks at
					1Hz when fault occurs.

 - bq2419x,psel_invert :		Invert psel control from Host to IC by HW design.

 - bq2419x,chgotg_invert :		Invert otg control from Host to IC by HW design.

 - bq2419x,input_voltage_mV :		Input voltage limit. Offset: 3880mV, Range: 3880~5080mV, Step: 80mV
					(Default: 4360mV)

 - bq2419x,input_current_mA_sdp :	Input current limit, It's an enum value:
						0: 100mA, 1: 150mA, 2: 500mA, 3: 900mA
						4: 1200mA, 5: 1500mA, 6: 2000mA, 7: 3000mA (Default:2)

 - bq2419x,input_current_mA_dcp :	Input current limit, and it's an enum value,
						0: 100mA, 1: 150mA, 2: 500mA, 3: 900mA
						4: 1200mA, 5: 1500mA, 6: 2000mA, 7: 3000mA (Default:7)

 - bq2419x,min_system_mV :		Minimum system voltage limit. Offset: 3000mV, Range: 3000~3700mV, Step: 100mV
					(Deafault: 3500mV)

 - bq2419x,prechg_current_mA :		Pre-charge current limit. Offset: 128mA, Range: 128~2048mA, Step: 128mA
					(Default: 256mA)

 - bq2419x,max_charge_current_mA :	Fast charge current limit. Offset: 512mA, Range: 512~4544mA, Step: 64mA
					(Default: 2048mA)

 - bq2419x,term_current_mA :		Termination current limit. Offset: 128mA, Range:128~2048mA, Step: 128mA
					(Default: 256mA)

 - bq2419x,max_charge_voltage_mV :	Charge voltage limit. Offset: 3504mV, Range: 3504~4400mV, Step: 16mV
					(Default: 4208mV)

 - bq2419x,pre_to_fast_mV :		Precharge to fast charge threshold voltage. It's an enum value:
						0: 2800mV, 1: 3000mV (Default:1)

 - bq2419x,otg_current_mA :		Boost mode current limit. It's an enum value:
						0: 500mA, 1: 1300mA (Default:1)

 - bq2419x,recharge_delta_mV :		Recharge threshold voltage. It's an enum value:
						0: 100mV, 1: 300mV (Default:0)

 - bq2419x,stimer_hr_sdp :		Fast charge safety timer. It's an enum value:
						0: 5hr, 1: 8hr, 2: 12hr, 3: 20hr (Default:1)

 - bq2419x,stimer_hr_dcp :		Fast charge safety timer. It's an enum value:
						0: 5hr, 1: 8hr, 2: 12hr, 3: 20hr (Default:1)

 - bq2419x,ir_resistor_mohm :		IR compensation resistor. Range: 0~70mOhm, Step: 10mOhm
					(Default: 0Ohm)

 - bq2419x,ir_voltage_mV :		IR compensation voltage. Range: 0~112mV, Step: 16mV
					(Default: 0mV)

 - bq2419x,thermal_threshold :		Thermal regulation thershold. It's an enum value:
						0: 60 degree, 1: 80 degree
						2: 100 degree, 3: 120 degree (Default:3)

 - bq2419x,jeita_current :		JEITA current for 0~10 degree. Percentage of max_charge_current_mA, it's an enum value:
						0: 50%, 1: 20% (Default:0)

 - bq2419x,jeita_voltage :		JEITA voltage for 45~60 degree. Change max charge voltage, it's an enum value:
						0: 4050mV, 1: 4200mV (Default:0)

 - bq2419x,dynamic_vindpm :		A flag to indicate that use dynamic vindpm method or not. (1: use / 0: not use)

Note: If an optional property is not specified, then the hardware default value
will be used.

Example:
&i2c_0 {
	ti,bq2419x@6b {
		reg = <0x6b>;
		compatible = "ti,bq2419x";
		interrupt-parent = <&msmgpio>;
		interrupts = <82 0x2>;

		/* Pin settings */
		bq2419x,gpio_int = <&msmgpio 82 0x00>;
		bq2419x,gpio_ce = <&msmgpio 131 0x00>;
		bq2419x,gpio_psel = <&pm8941_gpios 12 0x00>;
		bq2419x,gpio_chgpg = <&msmgpio 80 0x00>;
		bq2419x,gpio_chgotg = <&msmgpio 132 0x00>;
		bq2419x,gpio_chgstat = <&msmgpio 89 0x00>;

		/* Config data */
		bq2419x,input_voltage_mV = <4440>;
		bq2419x,input_current_mA_sdp = <2>;
		bq2419x,input_current_mA_dcp = <6>;
		bq2419x,min_system_mV = <3600>;
		bq2419x,prechg_current_mA = <512>;
		bq2419x,max_charge_current_mA = <2048>;
		bq2419x,term_current_mA = <256>;
		bq2419x,max_charge_voltage_mV = <4208>;
		bq2419x,pre_to_fast_mV = <1>;
		bq2419x,otg_current_mA = <0>;
		bq2419x,recharge_delta_mV = <0>;
		bq2419x,stimer_hr_sdp = <3>;
		bq2419x,stimer_hr_dcp = <2>;
		bq2419x,jeita_voltage = <1>;
		bq2419x,dynamic_vindpm = <1>;
	};
};
```

## Documentation/devicetree/bindings/power/bq24314c_ovp.txt
```
TI BQ24314C OVP detection chip

The bq24314c monitors input voltage, input current and battery voltage.
In case of an input overvoltage condition, the IC immediately removes power
from the charging circuit by turning off an internal switch. In the case of
an overcurrent condition, it limits the system current at the threshold value,
and if the overcurrent persists, switches the pass element OFF after a blanking
period. Additionally, the IC also monitors its own die temperature and switches
off if it exceeds 140 degree.

Required properties:

 - status: "okay" or "disabled" for this feature
 - compatible : Must be "ti,bq24314c"

Optional properties:

 - interrupt-parent :	Interrupt gpio group parent.

 - interrupts :		Specific gpio for interrupt, it should be same as fault_gpio.

 - bq24314c,enabled :	Specific the device has been enabled by HW or not.
			If use this, it means the device is enabled.

 - bq24314c,ce_gpio :	Internally pull-down chip enable pin, active low.

 - bq24314c,fault_gpio : Open-drain output, indicates device status, low means
			 input overvoltage, input overcurrent, battery overvoltage, or thermal shutdown.

Example:
&soc {
	ti,bq24314c {
		status = "okay";
		compatible = "ti,bq24314c";
		interrupt-parent = <&msmgpio>;
		interrupts = <27 0x2>;
		bq24314c,ce_gpio = <&msmgpio 13 0>;
		bq24314c,fault_gpio = <&msmgpio 27 0>;
	};
};
```

## Documentation/devicetree/bindings/power/bq27520_battery.txt
```
TI BQ27520 Battery Gas Gauge

The bq27520 monitors the battery temperature, capacity, voltage, current etc.
The device interface is I2C, its I2C slave 7-bit address is 0x55.

Required properties:

 - status: "okay" or "disabled" for this feature
 - compatible : Must be "ti,bq27520"
 - reg : I2C Address must be 0x55.

Optional properties:

 - interrupt-parent :	Interrupt gpio group parent.

 - interrupts :		Specific gpio for interrupt, it should be same as soc_gpio.

 - bq27520,rom_addr :	ROM address for flash firmware, it must be 0xB if needed.

 - bq27520,soc_gpio :	Open-drain output pin, indicates SOC state interrupt.

 - bq27520,blo_gpio :	Push-pull output pin, low battery indicator, default: active high.

 - bq27520,bgd_gpio :	Push-pull output pin, good battery indicator, default: active low.

 - bq27520,dffs_ver :	Set which version dffs to use, 0:BP5, 1:BP8, 2:VNA, 3:MO7, 4:BPC, 5:VN2

 - bq27520,design_vol :	Designed max battery voltage (mV), default: 4200

 - bq27520,use-batt-id:	Boolean value to decide get batt id or not.

 - bq27520,wrtemp :	Boolean value to decide the temperature is expected to written by the host or external thermistor.

 - qcom,batid-vadc :	When usb-batt-id is set, we need assign the vadc phandle to use.

Example:
&i2c_0 {
	bq27520@55 {
		status = "okay";
		reg = <0x55>;
		compatible = "ti,bq27520";
		interrupt-parent = <&msmgpio>;
		interrupts = <77 0x2>;
		bq27520,rom_addr = <0xB>;
		bq27520,soc_gpio = <&msmgpio 77 0x00>;
		bq27520,blo_gpio = <&pm8941_gpios 14 0x1>;
		bq27520,bgd_gpio = <&pm8941_gpios 13 0x1>;
		bq27520,dffs_ver = <2>;
		bq27520,design_vol = <4350>;
		bq27520,use-batt-id;
		qcom,batid-vadc = <&pm8941_vadc>;
	};
};
```
