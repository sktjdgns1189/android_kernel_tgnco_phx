&mdss_dsi0 {
	qcom,platform-enable-gpio = <&pm8941_gpios 20 1>;
};

&mdss_fb0 {
	qcom,memory-reservation-size = <0xFF0000>; /* 1088(w)*1920(h)*32(bpp)/8(byte)*2(fb_num) */
};

&mdss_mdp {
	dsi_truly_1080_cmd: qcom,mdss_dsi_truly_1080p_cmd {
		qcom,mdss-dsi-panel-name = "truly 1080p command mode dsi panel";
		qcom,mdss-dsi-panel-controller = <&mdss_dsi0>;
		qcom,mdss-dsi-panel-type = "dsi_cmd_mode";
		qcom,mdss-dsi-panel-destination = "display_1";
		qcom,cont-splash-enabled;
		qcom,mdss-dsi-panel-framerate = <60>;
		qcom,mdss-dsi-virtual-channel-id = <0>;
		qcom,mdss-dsi-stream = <0>;
		qcom,mdss-dsi-panel-width = <1080>;
		qcom,mdss-dsi-panel-height = <1920>;
		qcom,mdss-dsi-h-front-porch = <32>;
		qcom,mdss-dsi-h-back-porch = <32>;
		qcom,mdss-dsi-h-pulse-width = <8>;
		qcom,mdss-dsi-h-sync-skew = <0>;
		qcom,mdss-dsi-v-back-porch = <9>;
		qcom,mdss-dsi-v-front-porch = <4>;
		qcom,mdss-dsi-v-pulse-width = <2>;
		qcom,mdss-dsi-h-left-border = <0>;
		qcom,mdss-dsi-h-right-border = <0>;
		qcom,mdss-dsi-v-top-border = <0>;
		qcom,mdss-dsi-v-bottom-border = <0>;
		qcom,mdss-dsi-bpp = <24>;
		qcom,mdss-dsi-color-order = <0>;
		qcom,mdss-dsi-underflow-color = <0xff>;
		qcom,mdss-dsi-border-color = <0>;
		qcom,mdss-dsi-on-pre-command = [
				29 01 00 00 00 00 02 BB 10	/* 0x10: MIPI COMMAND MODE, 0x03: MIPI Video Mode */
				05 01 00 00 0A 00 02 11 00	/* sleep out, wait 10ms for ic turn on */
				29 01 00 00 01 00 02 FF 22
				29 01 00 00 00 00 02 FB 01
				29 01 00 00 00 00 02 00 00 	/* parameter to adjust saturation > 0.98 */
				29 01 00 00 00 00 02 01 04 	/* parameter to adjust  saturation 0.95~0.98 */
				29 01 00 00 00 00 02 02 08 	/* parameter to adjust  saturation 0.91~0.95 */
				29 01 00 00 00 00 02 03 0C 	/* parameter to adjust  saturation 0.88~0.91 */
				29 01 00 00 00 00 02 04 10 	/* parameter to adjust  saturation 0.85~0.88 */
				29 01 00 00 00 00 02 05 14 	/* parameter to adjust  saturation 0.82~0.85 */
				29 01 00 00 00 00 02 06 18 	/* parameter to adjust  saturation 0.79~0.82 */
				29 01 00 00 00 00 02 07 20 	/* parameter to adjust  saturation 0.76~0.79 */
				29 01 00 00 00 00 02 08 24 	/* parameter to adjust  saturation 0.73~0.76 */
				29 01 00 00 00 00 02 09 28 	/* parameter to adjust  saturation 0.7~0.73 */
				29 01 00 00 00 00 02 0A 30 	/* parameter to adjust  saturation 0.66~0.7 */
				29 01 00 00 00 00 02 0B 38 	/* parameter to adjust  saturation 0.6~0.66 */
				29 01 00 00 00 00 02 0C 38 	/* parameter to adjust  saturation 0.54~0.6 */
				29 01 00 00 00 00 02 0D 30 	/* parameter to adjust  saturation 0.48~0.54 */
				29 01 00 00 00 00 02 0E 28 	/* parameter to adjust  saturation 0.41~0.48 */
				29 01 00 00 00 00 02 0F 20 	/* parameter to adjust  saturation 0.35~0.41 */
				29 01 00 00 00 00 02 10 10 	/* parameter to adjust  saturation 0.26~0.35 */
				29 01 00 00 00 00 02 11 00 	/* parameter to adjust  saturation 0.16~0.26 */
				29 01 00 00 00 00 02 12 00 	/* parameter to adjust  saturation 0.07~0.16 */
				29 01 00 00 00 00 02 13 00 	/* parameter to adjust  saturation < 0.07 */
				29 01 00 00 00 00 02 14 10 	/* Vivid Color Ratio --> CMD1 55h = 0x8x */
				29 01 00 00 00 00 02 15 18 	/* Vivid Color Ratio --> CMD1 55h = 0x9x */
				29 01 00 00 00 00 02 16 20 	/* Vivid Color Ratio --> CMD1 55h = 0xBx */
				29 01 00 00 00 00 02 17 28 	/* Vivid Color Ratio --> CMD1 55h = 0x4x */
				29 01 00 00 00 00 02 18 30 	/* Vivid Color Ratio --> CMD1 55h = 0x5x */
				29 01 00 00 00 00 02 19 38 	/* Vivid Color Ratio --> CMD1 55h = 0x6x */
				29 01 00 00 00 00 02 56 00
				29 01 00 00 01 00 02 FF 20
				29 01 00 00 00 00 02 FB 01
				29 01 00 00 00 00 02 00 01
				29 01 00 00 00 00 02 01 55
				29 01 00 00 00 00 02 02 45
				29 01 00 00 00 00 02 03 55
				29 01 00 00 00 00 02 05 50
				29 01 00 00 00 00 02 06 9E
				29 01 00 00 00 00 02 07 A8
				29 01 00 00 00 00 02 08 0C
				29 01 00 00 00 00 02 0B 96
				29 01 00 00 00 00 02 0C 96
				29 01 00 00 00 00 02 0E 00
				29 01 00 00 00 00 02 0F 00
				29 01 00 00 00 00 02 11 36
				29 01 00 00 00 00 02 12 27
				29 01 00 00 00 00 02 13 03
				29 01 00 00 00 00 02 14 0A
				29 01 00 00 00 00 02 15 99
				29 01 00 00 00 00 02 16 99
				29 01 00 00 00 00 02 1B 39
				29 01 00 00 00 00 02 1C 39
				29 01 00 00 00 00 02 1D 47
				29 01 00 00 00 00 02 58 05
				29 01 00 00 00 00 02 59 05
				29 01 00 00 00 00 02 5A 05
				29 01 00 00 00 00 02 5B 05
				29 01 00 00 00 00 02 5C 00
				29 01 00 00 00 00 02 5D 00
				29 01 00 00 00 00 02 5E 00
				29 01 00 00 00 00 02 5F 00
				29 01 00 00 00 00 02 6D 44];

			qcom,mdss-dsi-setting-command = [
				29 01 00 00 01 00 02 FF 24
				29 01 00 00 00 00 02 FB 01
				29 01 00 00 00 00 02 00 0F
				29 01 00 00 00 00 02 01 00
				29 01 00 00 00 00 02 02 00
				29 01 00 00 00 00 02 03 00
				29 01 00 00 00 00 02 04 0B
				29 01 00 00 00 00 02 05 0C
				29 01 00 00 00 00 02 06 00
				29 01 00 00 00 00 02 07 00
				29 01 00 00 00 00 02 08 00
				29 01 00 00 00 00 02 09 00
				29 01 00 00 00 00 02 0A 03
				29 01 00 00 00 00 02 0B 04
				29 01 00 00 00 00 02 0C 01
				29 01 00 00 00 00 02 0D 13
				29 01 00 00 00 00 02 0E 15
				29 01 00 00 00 00 02 0F 17
				29 01 00 00 00 00 02 10 0F
				29 01 00 00 00 00 02 11 00
				29 01 00 00 00 00 02 12 00
				29 01 00 00 00 00 02 13 00
				29 01 00 00 00 00 02 14 0B
				29 01 00 00 00 00 02 15 0C
				29 01 00 00 00 00 02 16 00
				29 01 00 00 00 00 02 17 00
				29 01 00 00 00 00 02 18 00
				29 01 00 00 00 00 02 19 00
				29 01 00 00 00 00 02 1A 03
				29 01 00 00 00 00 02 1B 04
				29 01 00 00 00 00 02 1C 01
				29 01 00 00 00 00 02 1D 13
				29 01 00 00 00 00 02 1E 15
				29 01 00 00 00 00 02 1F 17
				29 01 00 00 00 00 02 20 09
				29 01 00 00 00 00 02 21 01
				29 01 00 00 00 00 02 22 00
				29 01 00 00 00 00 02 23 00
				29 01 00 00 00 00 02 24 00
				29 01 00 00 00 00 02 25 6D
				29 01 00 00 00 00 02 26 00
				29 01 00 00 00 00 02 27 00
				29 01 00 00 00 00 02 29 58
				29 01 00 00 00 00 02 2A 16
				29 01 00 00 00 00 02 2F 02
				29 01 00 00 00 00 02 30 04
				29 01 00 00 00 00 02 31 49
				29 01 00 00 00 00 02 32 23
				29 01 00 00 00 00 02 33 01
				29 01 00 00 00 00 02 34 00
				29 01 00 00 00 00 02 35 69
				29 01 00 00 00 00 02 36 00
				29 01 00 00 00 00 02 37 2D
				29 01 00 00 00 00 02 38 08
				29 01 00 00 00 00 02 39 00
				29 01 00 00 00 00 02 3A 69
				29 01 00 00 00 00 02 5B 00
				29 01 00 00 00 00 02 5F 75
				29 01 00 00 00 00 02 63 00
				29 01 00 00 00 00 02 67 04
				29 01 00 00 00 00 02 72 00
				29 01 00 00 00 00 02 74 10
				29 01 00 00 00 00 02 75 19
				29 01 00 00 00 00 02 76 06
				29 01 00 00 00 00 02 77 03
				29 01 00 00 00 00 02 78 00
				29 01 00 00 00 00 02 79 00
				29 01 00 00 00 00 02 7B 80
				29 01 00 00 00 00 02 7C D8
				29 01 00 00 00 00 02 7D 60
				29 01 00 00 00 00 02 7E 10
				29 01 00 00 00 00 02 7F 19
				29 01 00 00 00 00 02 80 00
				29 01 00 00 00 00 02 81 06
				29 01 00 00 00 00 02 82 03
				29 01 00 00 00 00 02 83 00
				29 01 00 00 00 00 02 84 03
				29 01 00 00 00 00 02 85 07
				29 01 00 00 00 00 02 86 1B
				29 01 00 00 00 00 02 87 39
				29 01 00 00 00 00 02 88 1B
				29 01 00 00 00 00 02 89 39
				29 01 00 00 00 00 02 8A 33
				29 01 00 00 00 00 02 8B F4
				29 01 00 00 00 00 02 8C 01
				29 01 00 00 00 00 02 92 79
				29 01 00 00 00 00 02 93 04
				29 01 00 00 00 00 02 94 04
				29 01 00 00 00 00 02 98 00
				29 01 00 00 00 00 02 99 33
				29 01 00 00 00 00 02 9B 0F
				29 01 00 00 00 00 02 9D B0
				29 01 00 00 00 00 02 DE FF
				29 01 00 00 00 00 02 B3 28
				29 01 00 00 00 00 02 B4 05
				29 01 00 00 00 00 02 B5 10
				29 01 00 00 00 00 02 E3 02	/* set as black screen if no data on ram */
				29 01 00 00 01 00 02 FF 10
				29 01 00 00 00 00 02 FB 01
				29 01 00 00 00 00 06 3B 03 04 04 04 04
				29 01 00 00 00 00 02 35 00
				29 01 00 00 00 00 02 51 FF
				29 01 00 00 00 00 02 53 24	/* 53h, Backlight Control: on, dimming function: disable */
				29 01 00 00 00 00 02 55 00];	/* 55h, CABC: off, IE : disable */

		qcom,mdss-dsi-on-command = [
				05 01 00 00 00 00 02 29 00];

		qcom,mdss-dsi-off-command = [
				05 01 00 00 14 00 02 28 00
				05 01 00 00 32 00 02 10 00];

		/* 55h, CABC and IE */
		fih,mdss-dsi-ie-pre-command = [
				29 01 00 00 01 00 02 FF 10];
		fih,mdss-dsi-ie-on-command = [
				29 01 00 00 00 00 02 55 00];
		fih,mdss-dsi-ie-mode = <0x80>;

		/* color temperature command */
		fih,mdss-dsi-color-pre-command = [
				29 01 00 00 01 00 02 FF 20];
		fih,mdss-dsi-color-warm-command = [
				29 01 00 00 00 00 02 75 00
				29 01 00 00 00 00 02 76 39
				29 01 00 00 00 00 02 77 00
				29 01 00 00 00 00 02 78 3C
				29 01 00 00 00 00 02 79 00
				29 01 00 00 00 00 02 7A 41
				29 01 00 00 00 00 02 7B 00
				29 01 00 00 00 00 02 7C 44
				29 01 00 00 00 00 02 7D 00
				29 01 00 00 00 00 02 7E 45
				29 01 00 00 00 00 02 7F 00
				29 01 00 00 00 00 02 80 59
				29 01 00 00 00 00 02 81 00
				29 01 00 00 00 00 02 82 5B
				29 01 00 00 00 00 02 83 00
				29 01 00 00 00 00 02 84 70
				29 01 00 00 00 00 02 85 00
				29 01 00 00 00 00 02 86 9C
				29 01 00 00 00 00 02 87 00
				29 01 00 00 00 00 02 88 EB
				29 01 00 00 00 00 02 89 01
				29 01 00 00 00 00 02 8A 19
				29 01 00 00 00 00 02 8B 01
				29 01 00 00 00 00 02 8C 5A
				29 01 00 00 00 00 02 8D 01
				29 01 00 00 00 00 02 8E 87
				29 01 00 00 00 00 02 8F 01
				29 01 00 00 00 00 02 90 CF
				29 01 00 00 00 00 02 91 02
				29 01 00 00 00 00 02 92 05
				29 01 00 00 00 00 02 93 02
				29 01 00 00 00 00 02 94 08
				29 01 00 00 00 00 02 95 02
				29 01 00 00 00 00 02 96 3B
				29 01 00 00 00 00 02 97 02
				29 01 00 00 00 00 02 98 73
				29 01 00 00 00 00 02 99 02
				29 01 00 00 00 00 02 9A 96
				29 01 00 00 00 00 02 9B 02
				29 01 00 00 00 00 02 9C C8
				29 01 00 00 00 00 02 9D 02
				29 01 00 00 00 00 02 9E E8
				29 01 00 00 00 00 02 9F 03
				29 01 00 00 00 00 02 A0 13
				29 01 00 00 00 00 02 A2 03
				29 01 00 00 00 00 02 A3 22
				29 01 00 00 00 00 02 A4 03
				29 01 00 00 00 00 02 A5 30
				29 01 00 00 00 00 02 A6 03
				29 01 00 00 00 00 02 A7 3E
				29 01 00 00 00 00 02 A9 03
				29 01 00 00 00 00 02 AA 68
				29 01 00 00 00 00 02 AB 03
				29 01 00 00 00 00 02 AC 93
				29 01 00 00 00 00 02 AD 03
				29 01 00 00 00 00 02 AE 98
				29 01 00 00 00 00 02 AF 03
				29 01 00 00 00 00 02 B0 AF
				29 01 00 00 00 00 02 B1 03
				29 01 00 00 00 00 02 B2 D0
				29 01 00 00 00 00 02 B3 00
				29 01 00 00 00 00 02 B4 39
				29 01 00 00 00 00 02 B5 00
				29 01 00 00 00 00 02 B6 3C
				29 01 00 00 00 00 02 B7 00
				29 01 00 00 00 00 02 B8 41
				29 01 00 00 00 00 02 B9 00
				29 01 00 00 00 00 02 BA 44
				29 01 00 00 00 00 02 BB 00
				29 01 00 00 00 00 02 BC 45
				29 01 00 00 00 00 02 BD 00
				29 01 00 00 00 00 02 BE 59
				29 01 00 00 00 00 02 BF 00
				29 01 00 00 00 00 02 C0 5B
				29 01 00 00 00 00 02 C1 00
				29 01 00 00 00 00 02 C2 70
				29 01 00 00 00 00 02 C3 00
				29 01 00 00 00 00 02 C4 9C
				29 01 00 00 00 00 02 C5 00
				29 01 00 00 00 00 02 C6 EB
				29 01 00 00 00 00 02 C7 01
				29 01 00 00 00 00 02 C8 19
				29 01 00 00 00 00 02 C9 01
				29 01 00 00 00 00 02 CA 5A
				29 01 00 00 00 00 02 CB 01
				29 01 00 00 00 00 02 CC 87
				29 01 00 00 00 00 02 CD 01
				29 01 00 00 00 00 02 CE CF
				29 01 00 00 00 00 02 CF 02
				29 01 00 00 00 00 02 D0 05
				29 01 00 00 00 00 02 D1 02
				29 01 00 00 00 00 02 D2 08
				29 01 00 00 00 00 02 D3 02
				29 01 00 00 00 00 02 D4 3B
				29 01 00 00 00 00 02 D5 02
				29 01 00 00 00 00 02 D6 73
				29 01 00 00 00 00 02 D7 02
				29 01 00 00 00 00 02 D8 96
				29 01 00 00 00 00 02 D9 02
				29 01 00 00 00 00 02 DA C8
				29 01 00 00 00 00 02 DB 02
				29 01 00 00 00 00 02 DC E8
				29 01 00 00 00 00 02 DD 03
				29 01 00 00 00 00 02 DE 13
				29 01 00 00 00 00 02 DF 03
				29 01 00 00 00 00 02 E0 22
				29 01 00 00 00 00 02 E1 03
				29 01 00 00 00 00 02 E2 30
				29 01 00 00 00 00 02 E3 03
				29 01 00 00 00 00 02 E4 3E
				29 01 00 00 00 00 02 E5 03
				29 01 00 00 00 00 02 E6 68
				29 01 00 00 00 00 02 E7 03
				29 01 00 00 00 00 02 E8 93
				29 01 00 00 00 00 02 E9 03
				29 01 00 00 00 00 02 EA 98
				29 01 00 00 00 00 02 EB 03
				29 01 00 00 00 00 02 EC AF
				29 01 00 00 00 00 02 ED 03
				29 01 00 00 00 00 02 EE D0
				29 01 00 00 00 00 02 EF 00
				29 01 00 00 00 00 02 F0 37
				29 01 00 00 00 00 02 F1 00
				29 01 00 00 00 00 02 F2 51
				29 01 00 00 00 00 02 F3 00
				29 01 00 00 00 00 02 F4 96
				29 01 00 00 00 00 02 F5 00
				29 01 00 00 00 00 02 F6 B7
				29 01 00 00 00 00 02 F7 00
				29 01 00 00 00 00 02 F8 D0
				29 01 00 00 00 00 02 F9 00
				29 01 00 00 00 00 02 FA E3
				29 01 00 00 00 00 02 FF 21
				29 01 00 00 00 00 02 00 00
				29 01 00 00 00 00 02 01 F4
				29 01 00 00 00 00 02 02 01
				29 01 00 00 00 00 02 03 02
				29 01 00 00 00 00 02 04 01
				29 01 00 00 00 00 02 05 0D
				29 01 00 00 00 00 02 06 01
				29 01 00 00 00 00 02 07 30
				29 01 00 00 00 00 02 08 01
				29 01 00 00 00 00 02 09 4D
				29 01 00 00 00 00 02 00 01
				29 01 00 00 00 00 02 0B 7B
				29 01 00 00 00 00 02 0C 01
				29 01 00 00 00 00 02 0D A1
				29 01 00 00 00 00 02 0E 01
				29 01 00 00 00 00 02 0F DE
				29 01 00 00 00 00 02 10 02
				29 01 00 00 00 00 02 11 11
				29 01 00 00 00 00 02 12 02
				29 01 00 00 00 00 02 13 12
				29 01 00 00 00 00 02 14 02
				29 01 00 00 00 00 02 15 42
				29 01 00 00 00 00 02 16 02
				29 01 00 00 00 00 02 17 79
				29 01 00 00 00 00 02 18 02
				29 01 00 00 00 00 02 19 9D
				29 01 00 00 00 00 02 1A 02
				29 01 00 00 00 00 02 1B CD
				29 01 00 00 00 00 02 1C 02
				29 01 00 00 00 00 02 1D EF
				29 01 00 00 00 00 02 1E 03
				29 01 00 00 00 00 02 1F 1C
				29 01 00 00 00 00 02 20 03
				29 01 00 00 00 00 02 21 29
				29 01 00 00 00 00 02 22 03
				29 01 00 00 00 00 02 23 39
				29 01 00 00 00 00 02 24 03
				29 01 00 00 00 00 02 25 42
				29 01 00 00 00 00 02 26 03
				29 01 00 00 00 00 02 27 6C
				29 01 00 00 00 00 02 28 03
				29 01 00 00 00 00 02 29 96
				29 01 00 00 00 00 02 2A 03
				29 01 00 00 00 00 02 2B 99
				29 01 00 00 00 00 02 2D 03
				29 01 00 00 00 00 02 2F F5
				29 01 00 00 00 00 02 30 03
				29 01 00 00 00 00 02 31 FD
				29 01 00 00 00 00 02 32 00
				29 01 00 00 00 00 02 33 37
				29 01 00 00 00 00 02 34 00
				29 01 00 00 00 00 02 35 51
				29 01 00 00 00 00 02 36 00
				29 01 00 00 00 00 02 37 96
				29 01 00 00 00 00 02 38 00
				29 01 00 00 00 00 02 39 B7
				29 01 00 00 00 00 02 3A 00
				29 01 00 00 00 00 02 3B D0
				29 01 00 00 00 00 02 3D 00
				29 01 00 00 00 00 02 3F E3
				29 01 00 00 00 00 02 40 00
				29 01 00 00 00 00 02 41 F4
				29 01 00 00 00 00 02 42 01
				29 01 00 00 00 00 02 43 02
				29 01 00 00 00 00 02 44 01
				29 01 00 00 00 00 02 45 0D
				29 01 00 00 00 00 02 46 01
				29 01 00 00 00 00 02 47 30
				29 01 00 00 00 00 02 48 01
				29 01 00 00 00 00 02 49 4D
				29 01 00 00 00 00 02 4A 01
				29 01 00 00 00 00 02 4B 7B
				29 01 00 00 00 00 02 4C 01
				29 01 00 00 00 00 02 4D A1
				29 01 00 00 00 00 02 4E 01
				29 01 00 00 00 00 02 4F DE
				29 01 00 00 00 00 02 50 02
				29 01 00 00 00 00 02 51 11
				29 01 00 00 00 00 02 52 02
				29 01 00 00 00 00 02 53 12
				29 01 00 00 00 00 02 54 02
				29 01 00 00 00 00 02 55 42
				29 01 00 00 00 00 02 56 02
				29 01 00 00 00 00 02 58 79
				29 01 00 00 00 00 02 59 02
				29 01 00 00 00 00 02 5A 9D
				29 01 00 00 00 00 02 5B 02
				29 01 00 00 00 00 02 5C CD
				29 01 00 00 00 00 02 5D 02
				29 01 00 00 00 00 02 5E EF
				29 01 00 00 00 00 02 5F 03
				29 01 00 00 00 00 02 60 1C
				29 01 00 00 00 00 02 61 03
				29 01 00 00 00 00 02 62 29
				29 01 00 00 00 00 02 63 03
				29 01 00 00 00 00 02 64 39
				29 01 00 00 00 00 02 65 03
				29 01 00 00 00 00 02 66 42
				29 01 00 00 00 00 02 67 03
				29 01 00 00 00 00 02 68 6C
				29 01 00 00 00 00 02 69 03
				29 01 00 00 00 00 02 6A 96
				29 01 00 00 00 00 02 6B 03
				29 01 00 00 00 00 02 6C 99
				29 01 00 00 00 00 02 6D 03
				29 01 00 00 00 00 02 6E F5
				29 01 00 00 00 00 02 6F 03
				29 01 00 00 00 00 02 70 FD
				29 01 00 00 00 00 02 71 01
				29 01 00 00 00 00 02 72 24
				29 01 00 00 00 00 02 73 01
				29 01 00 00 00 00 02 74 25
				29 01 00 00 00 00 02 75 01
				29 01 00 00 00 00 02 76 2E
				29 01 00 00 00 00 02 77 01
				29 01 00 00 00 00 02 78 37
				29 01 00 00 00 00 02 79 01
				29 01 00 00 00 00 02 7A 3F
				29 01 00 00 00 00 02 7B 01
				29 01 00 00 00 00 02 7C 46
				29 01 00 00 00 00 02 7D 01
				29 01 00 00 00 00 02 7E 4E
				29 01 00 00 00 00 02 7F 01
				29 01 00 00 00 00 02 80 55
				29 01 00 00 00 00 02 81 01
				29 01 00 00 00 00 02 82 5A
				29 01 00 00 00 00 02 83 01
				29 01 00 00 00 00 02 84 6F
				29 01 00 00 00 00 02 85 01
				29 01 00 00 00 00 02 86 81
				29 01 00 00 00 00 02 87 01
				29 01 00 00 00 00 02 88 A2
				29 01 00 00 00 00 02 89 01
				29 01 00 00 00 00 02 8A C0
				29 01 00 00 00 00 02 8B 01
				29 01 00 00 00 00 02 8C F2
				29 01 00 00 00 00 02 8D 02
				29 01 00 00 00 00 02 8E 1F
				29 01 00 00 00 00 02 8F 02
				29 01 00 00 00 00 02 90 21
				29 01 00 00 00 00 02 91 02
				29 01 00 00 00 00 02 92 4E
				29 01 00 00 00 00 02 93 02
				29 01 00 00 00 00 02 94 83
				29 01 00 00 00 00 02 95 02
				29 01 00 00 00 00 02 96 A8
				29 01 00 00 00 00 02 97 02
				29 01 00 00 00 00 02 98 DD
				29 01 00 00 00 00 02 99 03
				29 01 00 00 00 00 02 9A 03
				29 01 00 00 00 00 02 9B 03
				29 01 00 00 00 00 02 9C 42
				29 01 00 00 00 00 02 9D 03
				29 01 00 00 00 00 02 9E 5F
				29 01 00 00 00 00 02 9F 03
				29 01 00 00 00 00 02 A0 A5
				29 01 00 00 00 00 02 A2 03
				29 01 00 00 00 00 02 A3 E4
				29 01 00 00 00 00 02 A4 03
				29 01 00 00 00 00 02 A5 EA
				29 01 00 00 00 00 02 A6 03
				29 01 00 00 00 00 02 A7 F0
				29 01 00 00 00 00 02 A9 03
				29 01 00 00 00 00 02 AA F1
				29 01 00 00 00 00 02 AB 03
				29 01 00 00 00 00 02 AC FB
				29 01 00 00 00 00 02 AD 03
				29 01 00 00 00 00 02 AE FC
				29 01 00 00 00 00 02 AF 01
				29 01 00 00 00 00 02 B0 24
				29 01 00 00 00 00 02 B1 01
				29 01 00 00 00 00 02 B2 25
				29 01 00 00 00 00 02 B3 01
				29 01 00 00 00 00 02 B4 2E
				29 01 00 00 00 00 02 B5 01
				29 01 00 00 00 00 02 B6 37
				29 01 00 00 00 00 02 B7 01
				29 01 00 00 00 00 02 B8 3F
				29 01 00 00 00 00 02 B9 01
				29 01 00 00 00 00 02 BA 46
				29 01 00 00 00 00 02 BB 01
				29 01 00 00 00 00 02 BC 4E
				29 01 00 00 00 00 02 BD 01
				29 01 00 00 00 00 02 BE 55
				29 01 00 00 00 00 02 BF 01
				29 01 00 00 00 00 02 C0 5A
				29 01 00 00 00 00 02 C1 01
				29 01 00 00 00 00 02 C2 6F
				29 01 00 00 00 00 02 C3 01
				29 01 00 00 00 00 02 C4 81
				29 01 00 00 00 00 02 C5 01
				29 01 00 00 00 00 02 C6 A2
				29 01 00 00 00 00 02 C7 01
				29 01 00 00 00 00 02 C8 C0
				29 01 00 00 00 00 02 C9 01
				29 01 00 00 00 00 02 CA F2
				29 01 00 00 00 00 02 CB 02
				29 01 00 00 00 00 02 CC 1F
				29 01 00 00 00 00 02 CD 02
				29 01 00 00 00 00 02 CE 21
				29 01 00 00 00 00 02 CF 02
				29 01 00 00 00 00 02 D0 4E
				29 01 00 00 00 00 02 D1 02
				29 01 00 00 00 00 02 D2 83
				29 01 00 00 00 00 02 D3 02
				29 01 00 00 00 00 02 D4 A8
				29 01 00 00 00 00 02 D5 02
				29 01 00 00 00 00 02 D6 DD
				29 01 00 00 00 00 02 D7 03
				29 01 00 00 00 00 02 D8 03
				29 01 00 00 00 00 02 D9 03
				29 01 00 00 00 00 02 DA 42
				29 01 00 00 00 00 02 DB 03
				29 01 00 00 00 00 02 DC 5F
				29 01 00 00 00 00 02 DD 03
				29 01 00 00 00 00 02 DE A5
				29 01 00 00 00 00 02 DF 03
				29 01 00 00 00 00 02 E0 E4
				29 01 00 00 00 00 02 E1 03
				29 01 00 00 00 00 02 E2 EA
				29 01 00 00 00 00 02 E3 03
				29 01 00 00 00 00 02 E4 F0
				29 01 00 00 00 00 02 E5 03
				29 01 00 00 00 00 02 E6 F1
				29 01 00 00 00 00 02 E7 03
				29 01 00 00 00 00 02 E8 FB
				29 01 00 00 00 00 02 E9 03
				29 01 00 00 00 00 02 EA FC];
		fih,mdss-dsi-color-normal-command = [
				29 01 00 00 00 00 02 75 00
				29 01 00 00 00 00 02 76 39
				29 01 00 00 00 00 02 77 00
				29 01 00 00 00 00 02 78 3D
				29 01 00 00 00 00 02 79 00
				29 01 00 00 00 00 02 7A 45
				29 01 00 00 00 00 02 7B 00
				29 01 00 00 00 00 02 7C 5D
				29 01 00 00 00 00 02 7D 00
				29 01 00 00 00 00 02 7E 63
				29 01 00 00 00 00 02 7F 00
				29 01 00 00 00 00 02 80 8B
				29 01 00 00 00 00 02 81 00
				29 01 00 00 00 00 02 82 A9
				29 01 00 00 00 00 02 83 00
				29 01 00 00 00 00 02 84 C1
				29 01 00 00 00 00 02 85 00
				29 01 00 00 00 00 02 86 D1
				29 01 00 00 00 00 02 87 01
				29 01 00 00 00 00 02 88 0A
				29 01 00 00 00 00 02 89 01
				29 01 00 00 00 00 02 8A 30
				29 01 00 00 00 00 02 8B 01
				29 01 00 00 00 00 02 8C 65
				29 01 00 00 00 00 02 8D 01
				29 01 00 00 00 00 02 8E 91
				29 01 00 00 00 00 02 8F 01
				29 01 00 00 00 00 02 90 D5
				29 01 00 00 00 00 02 91 02
				29 01 00 00 00 00 02 92 0B
				29 01 00 00 00 00 02 93 02
				29 01 00 00 00 00 02 94 0E
				29 01 00 00 00 00 02 95 02
				29 01 00 00 00 00 02 96 3D
				29 01 00 00 00 00 02 97 02
				29 01 00 00 00 00 02 98 75
				29 01 00 00 00 00 02 99 02
				29 01 00 00 00 00 02 9A 9B
				29 01 00 00 00 00 02 9B 02
				29 01 00 00 00 00 02 9C CA
				29 01 00 00 00 00 02 9D 02
				29 01 00 00 00 00 02 9E EA
				29 01 00 00 00 00 02 9F 03
				29 01 00 00 00 00 02 A0 18
				29 01 00 00 00 00 02 A2 03
				29 01 00 00 00 00 02 A3 25
				29 01 00 00 00 00 02 A4 03
				29 01 00 00 00 00 02 A5 33
				29 01 00 00 00 00 02 A6 03
				29 01 00 00 00 00 02 A7 44
				29 01 00 00 00 00 02 A9 03
				29 01 00 00 00 00 02 AA 6D
				29 01 00 00 00 00 02 AB 03
				29 01 00 00 00 00 02 AC 96
				29 01 00 00 00 00 02 AD 03
				29 01 00 00 00 00 02 AE 9E
				29 01 00 00 00 00 02 AF 03
				29 01 00 00 00 00 02 B0 AF
				29 01 00 00 00 00 02 B1 03
				29 01 00 00 00 00 02 B2 D0
				29 01 00 00 00 00 02 B3 00
				29 01 00 00 00 00 02 B4 39
				29 01 00 00 00 00 02 B5 00
				29 01 00 00 00 00 02 B6 3D
				29 01 00 00 00 00 02 B7 00
				29 01 00 00 00 00 02 B8 45
				29 01 00 00 00 00 02 B9 00
				29 01 00 00 00 00 02 BA 5D
				29 01 00 00 00 00 02 BB 00
				29 01 00 00 00 00 02 BC 63
				29 01 00 00 00 00 02 BD 00
				29 01 00 00 00 00 02 BE 8B
				29 01 00 00 00 00 02 BF 00
				29 01 00 00 00 00 02 C0 A9
				29 01 00 00 00 00 02 C1 00
				29 01 00 00 00 00 02 C2 C1
				29 01 00 00 00 00 02 C3 00
				29 01 00 00 00 00 02 C4 D1
				29 01 00 00 00 00 02 C5 01
				29 01 00 00 00 00 02 C6 0A
				29 01 00 00 00 00 02 C7 01
				29 01 00 00 00 00 02 C8 30
				29 01 00 00 00 00 02 C9 01
				29 01 00 00 00 00 02 CA 65
				29 01 00 00 00 00 02 CB 01
				29 01 00 00 00 00 02 CC 91
				29 01 00 00 00 00 02 CD 01
				29 01 00 00 00 00 02 CE D5
				29 01 00 00 00 00 02 CF 02
				29 01 00 00 00 00 02 D0 0B
				29 01 00 00 00 00 02 D1 02
				29 01 00 00 00 00 02 D2 0E
				29 01 00 00 00 00 02 D3 02
				29 01 00 00 00 00 02 D4 3D
				29 01 00 00 00 00 02 D5 02
				29 01 00 00 00 00 02 D6 75
				29 01 00 00 00 00 02 D7 02
				29 01 00 00 00 00 02 D8 9B
				29 01 00 00 00 00 02 D9 02
				29 01 00 00 00 00 02 DA CA
				29 01 00 00 00 00 02 DB 02
				29 01 00 00 00 00 02 DC EA
				29 01 00 00 00 00 02 DD 03
				29 01 00 00 00 00 02 DE 18
				29 01 00 00 00 00 02 DF 03
				29 01 00 00 00 00 02 E0 25
				29 01 00 00 00 00 02 E1 03
				29 01 00 00 00 00 02 E2 33
				29 01 00 00 00 00 02 E3 03
				29 01 00 00 00 00 02 E4 44
				29 01 00 00 00 00 02 E5 03
				29 01 00 00 00 00 02 E6 6D
				29 01 00 00 00 00 02 E7 03
				29 01 00 00 00 00 02 E8 96
				29 01 00 00 00 00 02 E9 03
				29 01 00 00 00 00 02 EA 9E
				29 01 00 00 00 00 02 EB 03
				29 01 00 00 00 00 02 EC AF
				29 01 00 00 00 00 02 ED 03
				29 01 00 00 00 00 02 EE D0
				29 01 00 00 00 00 02 EF 00
				29 01 00 00 00 00 02 F0 37
				29 01 00 00 00 00 02 F1 00
				29 01 00 00 00 00 02 F2 73
				29 01 00 00 00 00 02 F3 00
				29 01 00 00 00 00 02 F4 A2
				29 01 00 00 00 00 02 F5 00
				29 01 00 00 00 00 02 F6 BF
				29 01 00 00 00 00 02 F7 00
				29 01 00 00 00 00 02 F8 D5
				29 01 00 00 00 00 02 F9 00
				29 01 00 00 00 00 02 FA E5
				29 01 00 00 00 00 02 FF 21
				29 01 00 00 00 00 02 00 00
				29 01 00 00 00 00 02 01 F2
				29 01 00 00 00 00 02 02 00
				29 01 00 00 00 00 02 03 FE
				29 01 00 00 00 00 02 04 01
				29 01 00 00 00 00 02 05 09
				29 01 00 00 00 00 02 06 01
				29 01 00 00 00 00 02 07 2D
				29 01 00 00 00 00 02 08 01
				29 01 00 00 00 00 02 09 4A
				29 01 00 00 00 00 02 0A 01
				29 01 00 00 00 00 02 0B 7A
				29 01 00 00 00 00 02 0C 01
				29 01 00 00 00 00 02 0D A0
				29 01 00 00 00 00 02 0E 01
				29 01 00 00 00 00 02 0F DD
				29 01 00 00 00 00 02 10 02
				29 01 00 00 00 00 02 11 10
				29 01 00 00 00 00 02 12 02
				29 01 00 00 00 00 02 13 11
				29 01 00 00 00 00 02 14 02
				29 01 00 00 00 00 02 15 42
				29 01 00 00 00 00 02 16 02
				29 01 00 00 00 00 02 17 79
				29 01 00 00 00 00 02 18 02
				29 01 00 00 00 00 02 19 9C
				29 01 00 00 00 00 02 1A 02
				29 01 00 00 00 00 02 1B CD
				29 01 00 00 00 00 02 1C 02
				29 01 00 00 00 00 02 1D EF
				29 01 00 00 00 00 02 1E 03
				29 01 00 00 00 00 02 1F 1B
				29 01 00 00 00 00 02 20 03
				29 01 00 00 00 00 02 21 29
				29 01 00 00 00 00 02 22 03
				29 01 00 00 00 00 02 23 38
				29 01 00 00 00 00 02 24 03
				29 01 00 00 00 00 02 25 4B
				29 01 00 00 00 00 02 26 03
				29 01 00 00 00 00 02 27 73
				29 01 00 00 00 00 02 28 03
				29 01 00 00 00 00 02 29 9B
				29 01 00 00 00 00 02 2A 03
				29 01 00 00 00 00 02 2B 9C
				29 01 00 00 00 00 02 2D 03
				29 01 00 00 00 00 02 2F F5
				29 01 00 00 00 00 02 30 03
				29 01 00 00 00 00 02 31 FD
				29 01 00 00 00 00 02 32 00
				29 01 00 00 00 00 02 33 37
				29 01 00 00 00 00 02 34 00
				29 01 00 00 00 00 02 35 73
				29 01 00 00 00 00 02 36 00
				29 01 00 00 00 00 02 37 A2
				29 01 00 00 00 00 02 38 00
				29 01 00 00 00 00 02 39 BF
				29 01 00 00 00 00 02 3A 00
				29 01 00 00 00 00 02 3B D5
				29 01 00 00 00 00 02 3D 00
				29 01 00 00 00 00 02 3F E5
				29 01 00 00 00 00 02 40 00
				29 01 00 00 00 00 02 41 F2
				29 01 00 00 00 00 02 42 00
				29 01 00 00 00 00 02 43 FE
				29 01 00 00 00 00 02 44 01
				29 01 00 00 00 00 02 45 09
				29 01 00 00 00 00 02 46 01
				29 01 00 00 00 00 02 47 2D
				29 01 00 00 00 00 02 48 01
				29 01 00 00 00 00 02 49 4A
				29 01 00 00 00 00 02 4A 01
				29 01 00 00 00 00 02 4B 7A
				29 01 00 00 00 00 02 4C 01
				29 01 00 00 00 00 02 4D A0
				29 01 00 00 00 00 02 4E 01
				29 01 00 00 00 00 02 4F DD
				29 01 00 00 00 00 02 50 02
				29 01 00 00 00 00 02 51 10
				29 01 00 00 00 00 02 52 02
				29 01 00 00 00 00 02 53 11
				29 01 00 00 00 00 02 54 02
				29 01 00 00 00 00 02 55 42
				29 01 00 00 00 00 02 56 02
				29 01 00 00 00 00 02 58 79
				29 01 00 00 00 00 02 59 02
				29 01 00 00 00 00 02 5A 9C
				29 01 00 00 00 00 02 5B 02
				29 01 00 00 00 00 02 5C CD
				29 01 00 00 00 00 02 5D 02
				29 01 00 00 00 00 02 5E EF
				29 01 00 00 00 00 02 5F 03
				29 01 00 00 00 00 02 60 1B
				29 01 00 00 00 00 02 61 03
				29 01 00 00 00 00 02 62 29
				29 01 00 00 00 00 02 63 03
				29 01 00 00 00 00 02 64 38
				29 01 00 00 00 00 02 65 03
				29 01 00 00 00 00 02 66 4B
				29 01 00 00 00 00 02 67 03
				29 01 00 00 00 00 02 68 73
				29 01 00 00 00 00 02 69 03
				29 01 00 00 00 00 02 6A 9B
				29 01 00 00 00 00 02 6B 03
				29 01 00 00 00 00 02 6C 9C
				29 01 00 00 00 00 02 6D 03
				29 01 00 00 00 00 02 6E F5
				29 01 00 00 00 00 02 6F 03
				29 01 00 00 00 00 02 70 FD
				29 01 00 00 00 00 02 71 00
				29 01 00 00 00 00 02 72 F9
				29 01 00 00 00 00 02 73 00
				29 01 00 00 00 00 02 74 FE
				29 01 00 00 00 00 02 75 01
				29 01 00 00 00 00 02 76 0A
				29 01 00 00 00 00 02 77 01
				29 01 00 00 00 00 02 78 14
				29 01 00 00 00 00 02 79 01
				29 01 00 00 00 00 02 7A 1F
				29 01 00 00 00 00 02 7B 01
				29 01 00 00 00 00 02 7C 26
				29 01 00 00 00 00 02 7D 01
				29 01 00 00 00 00 02 7E 2E
				29 01 00 00 00 00 02 7F 01
				29 01 00 00 00 00 02 80 35
				29 01 00 00 00 00 02 81 01
				29 01 00 00 00 00 02 82 3C
				29 01 00 00 00 00 02 83 01
				29 01 00 00 00 00 02 84 54
				29 01 00 00 00 00 02 85 01
				29 01 00 00 00 00 02 86 69
				29 01 00 00 00 00 02 87 01
				29 01 00 00 00 00 02 88 90
				29 01 00 00 00 00 02 89 01
				29 01 00 00 00 00 02 8A B0
				29 01 00 00 00 00 02 8B 01
				29 01 00 00 00 00 02 8C E8
				29 01 00 00 00 00 02 8D 02
				29 01 00 00 00 00 02 8E 18
				29 01 00 00 00 00 02 8F 02
				29 01 00 00 00 00 02 90 19
				29 01 00 00 00 00 02 91 02
				29 01 00 00 00 00 02 92 48
				29 01 00 00 00 00 02 93 02
				29 01 00 00 00 00 02 94 7E
				29 01 00 00 00 00 02 95 02
				29 01 00 00 00 00 02 96 A2
				29 01 00 00 00 00 02 97 02
				29 01 00 00 00 00 02 98 D6
				29 01 00 00 00 00 02 99 02
				29 01 00 00 00 00 02 9A FD
				29 01 00 00 00 00 02 9B 03
				29 01 00 00 00 00 02 9C 37
				29 01 00 00 00 00 02 9D 03
				29 01 00 00 00 00 02 9E 4F
				29 01 00 00 00 00 02 9F 03
				29 01 00 00 00 00 02 A0 77
				29 01 00 00 00 00 02 A2 03
				29 01 00 00 00 00 02 A3 EC
				29 01 00 00 00 00 02 A4 03
				29 01 00 00 00 00 02 A5 F0
				29 01 00 00 00 00 02 A6 03
				29 01 00 00 00 00 02 A7 F4
				29 01 00 00 00 00 02 A9 03
				29 01 00 00 00 00 02 AA F8
				29 01 00 00 00 00 02 AB 03
				29 01 00 00 00 00 02 AC FB
				29 01 00 00 00 00 02 AD 03
				29 01 00 00 00 00 02 AE FC
				29 01 00 00 00 00 02 AF 00
				29 01 00 00 00 00 02 B0 F9
				29 01 00 00 00 00 02 B1 00
				29 01 00 00 00 00 02 B2 FE
				29 01 00 00 00 00 02 B3 01
				29 01 00 00 00 00 02 B4 0A
				29 01 00 00 00 00 02 B5 01
				29 01 00 00 00 00 02 B6 14
				29 01 00 00 00 00 02 B7 01
				29 01 00 00 00 00 02 B8 1F
				29 01 00 00 00 00 02 B9 01
				29 01 00 00 00 00 02 BA 26
				29 01 00 00 00 00 02 BB 01
				29 01 00 00 00 00 02 BC 2E
				29 01 00 00 00 00 02 BD 01
				29 01 00 00 00 00 02 BE 35
				29 01 00 00 00 00 02 BF 01
				29 01 00 00 00 00 02 C0 3C
				29 01 00 00 00 00 02 C1 01
				29 01 00 00 00 00 02 C2 54
				29 01 00 00 00 00 02 C3 01
				29 01 00 00 00 00 02 C4 69
				29 01 00 00 00 00 02 C5 01
				29 01 00 00 00 00 02 C6 90
				29 01 00 00 00 00 02 C7 01
				29 01 00 00 00 00 02 C8 B0
				29 01 00 00 00 00 02 C9 01
				29 01 00 00 00 00 02 CA E8
				29 01 00 00 00 00 02 CB 02
				29 01 00 00 00 00 02 CC 18
				29 01 00 00 00 00 02 CD 02
				29 01 00 00 00 00 02 CE 19
				29 01 00 00 00 00 02 CF 02
				29 01 00 00 00 00 02 D0 48
				29 01 00 00 00 00 02 D1 02
				29 01 00 00 00 00 02 D2 7E
				29 01 00 00 00 00 02 D3 02
				29 01 00 00 00 00 02 D4 A2
				29 01 00 00 00 00 02 D5 02
				29 01 00 00 00 00 02 D6 D6
				29 01 00 00 00 00 02 D7 02
				29 01 00 00 00 00 02 D8 FD
				29 01 00 00 00 00 02 D9 03
				29 01 00 00 00 00 02 DA 37
				29 01 00 00 00 00 02 DB 03
				29 01 00 00 00 00 02 DC 4F
				29 01 00 00 00 00 02 DD 03
				29 01 00 00 00 00 02 DE 77
				29 01 00 00 00 00 02 DF 03
				29 01 00 00 00 00 02 E0 EC
				29 01 00 00 00 00 02 E1 03
				29 01 00 00 00 00 02 E2 F0
				29 01 00 00 00 00 02 E3 03
				29 01 00 00 00 00 02 E4 F4
				29 01 00 00 00 00 02 E5 03
				29 01 00 00 00 00 02 E6 F8
				29 01 00 00 00 00 02 E7 03
				29 01 00 00 00 00 02 E8 FB
				29 01 00 00 00 00 02 E9 03
				29 01 00 00 00 00 02 EA FC];
		fih,mdss-dsi-color-cold-command = [
				29 01 00 00 00 00 02 75 00
				29 01 00 00 00 00 02 76 3F
				29 01 00 00 00 00 02 77 00
				29 01 00 00 00 00 02 78 45
				29 01 00 00 00 00 02 79 00
				29 01 00 00 00 00 02 7A 89
				29 01 00 00 00 00 02 7B 00
				29 01 00 00 00 00 02 7C A9
				29 01 00 00 00 00 02 7D 00
				29 01 00 00 00 00 02 7E C0
				29 01 00 00 00 00 02 7F 00
				29 01 00 00 00 00 02 80 D3
				29 01 00 00 00 00 02 81 00
				29 01 00 00 00 00 02 82 E0
				29 01 00 00 00 00 02 83 00
				29 01 00 00 00 00 02 84 EE
				29 01 00 00 00 00 02 85 00
				29 01 00 00 00 00 02 86 FB
				29 01 00 00 00 00 02 87 01
				29 01 00 00 00 00 02 88 22
				29 01 00 00 00 00 02 89 01
				29 01 00 00 00 00 02 8A 44
				29 01 00 00 00 00 02 8B 01
				29 01 00 00 00 00 02 8C 76
				29 01 00 00 00 00 02 8D 01
				29 01 00 00 00 00 02 8E 9E
				29 01 00 00 00 00 02 8F 01
				29 01 00 00 00 00 02 90 DD
				29 01 00 00 00 00 02 91 02
				29 01 00 00 00 00 02 92 0E
				29 01 00 00 00 00 02 93 02
				29 01 00 00 00 00 02 94 10
				29 01 00 00 00 00 02 95 02
				29 01 00 00 00 00 02 96 42
				29 01 00 00 00 00 02 97 02
				29 01 00 00 00 00 02 98 79
				29 01 00 00 00 00 02 99 02
				29 01 00 00 00 00 02 9A 9D
				29 01 00 00 00 00 02 9B 02
				29 01 00 00 00 00 02 9C CC
				29 01 00 00 00 00 02 9D 02
				29 01 00 00 00 00 02 9E EF
				29 01 00 00 00 00 02 9F 03
				29 01 00 00 00 00 02 A0 1B
				29 01 00 00 00 00 02 A2 03
				29 01 00 00 00 00 02 A3 29
				29 01 00 00 00 00 02 A4 03
				29 01 00 00 00 00 02 A5 37
				29 01 00 00 00 00 02 A6 03
				29 01 00 00 00 00 02 A7 49
				29 01 00 00 00 00 02 A9 03
				29 01 00 00 00 00 02 AA 57
				29 01 00 00 00 00 02 AB 03
				29 01 00 00 00 00 02 AC 87
				29 01 00 00 00 00 02 AD 03
				29 01 00 00 00 00 02 AE 88
				29 01 00 00 00 00 02 AF 03
				29 01 00 00 00 00 02 B0 AF
				29 01 00 00 00 00 02 B1 03
				29 01 00 00 00 00 02 B2 D0
				29 01 00 00 00 00 02 B3 00
				29 01 00 00 00 00 02 B4 3F
				29 01 00 00 00 00 02 B5 00
				29 01 00 00 00 00 02 B6 45
				29 01 00 00 00 00 02 B7 00
				29 01 00 00 00 00 02 B8 89
				29 01 00 00 00 00 02 B9 00
				29 01 00 00 00 00 02 BA A9
				29 01 00 00 00 00 02 BB 00
				29 01 00 00 00 00 02 BC C0
				29 01 00 00 00 00 02 BD 00
				29 01 00 00 00 00 02 BE D3
				29 01 00 00 00 00 02 BF 00
				29 01 00 00 00 00 02 C0 E0
				29 01 00 00 00 00 02 C1 00
				29 01 00 00 00 00 02 C2 EE
				29 01 00 00 00 00 02 C3 00
				29 01 00 00 00 00 02 C4 FB
				29 01 00 00 00 00 02 C5 01
				29 01 00 00 00 00 02 C6 22
				29 01 00 00 00 00 02 C7 01
				29 01 00 00 00 00 02 C8 44
				29 01 00 00 00 00 02 C9 01
				29 01 00 00 00 00 02 CA 76
				29 01 00 00 00 00 02 CB 01
				29 01 00 00 00 00 02 CC 9E
				29 01 00 00 00 00 02 CD 01
				29 01 00 00 00 00 02 CE DD
				29 01 00 00 00 00 02 CF 02
				29 01 00 00 00 00 02 D0 0E
				29 01 00 00 00 00 02 D1 02
				29 01 00 00 00 00 02 D2 10
				29 01 00 00 00 00 02 D3 02
				29 01 00 00 00 00 02 D4 42
				29 01 00 00 00 00 02 D5 02
				29 01 00 00 00 00 02 D6 79
				29 01 00 00 00 00 02 D7 02
				29 01 00 00 00 00 02 D8 9D
				29 01 00 00 00 00 02 D9 02
				29 01 00 00 00 00 02 DA CC
				29 01 00 00 00 00 02 DB 02
				29 01 00 00 00 00 02 DC EF
				29 01 00 00 00 00 02 DD 03
				29 01 00 00 00 00 02 DE 1B
				29 01 00 00 00 00 02 DF 03
				29 01 00 00 00 00 02 E0 29
				29 01 00 00 00 00 02 E1 03
				29 01 00 00 00 00 02 E2 37
				29 01 00 00 00 00 02 E3 03
				29 01 00 00 00 00 02 E4 49
				29 01 00 00 00 00 02 E5 03
				29 01 00 00 00 00 02 E6 57
				29 01 00 00 00 00 02 E7 03
				29 01 00 00 00 00 02 E8 87
				29 01 00 00 00 00 02 E9 03
				29 01 00 00 00 00 02 EA 88
				29 01 00 00 00 00 02 EB 03
				29 01 00 00 00 00 02 EC AF
				29 01 00 00 00 00 02 ED 03
				29 01 00 00 00 00 02 EE D0
				29 01 00 00 00 00 02 EF 00
				29 01 00 00 00 00 02 F0 65
				29 01 00 00 00 00 02 F1 00
				29 01 00 00 00 00 02 F2 86
				29 01 00 00 00 00 02 F3 00
				29 01 00 00 00 00 02 F4 A6
				29 01 00 00 00 00 02 F5 00
				29 01 00 00 00 00 02 F6 BD
				29 01 00 00 00 00 02 F7 00
				29 01 00 00 00 00 02 F8 CF
				29 01 00 00 00 00 02 F9 00
				29 01 00 00 00 00 02 FA DE
				29 01 00 00 00 00 02 FF 21
				29 01 00 00 00 00 02 00 00
				29 01 00 00 00 00 02 01 ED
				29 01 00 00 00 00 02 02 00
				29 01 00 00 00 00 02 03 F9
				29 01 00 00 00 00 02 04 01
				29 01 00 00 00 00 02 05 04
				29 01 00 00 00 00 02 06 01
				29 01 00 00 00 00 02 07 2A
				29 01 00 00 00 00 02 08 01
				29 01 00 00 00 00 02 09 47
				29 01 00 00 00 00 02 00 01
				29 01 00 00 00 00 02 0B 77
				29 01 00 00 00 00 02 0C 01
				29 01 00 00 00 00 02 0D 9E
				29 01 00 00 00 00 02 0E 01
				29 01 00 00 00 00 02 0F DC
				29 01 00 00 00 00 02 10 02
				29 01 00 00 00 00 02 11 10
				29 01 00 00 00 00 02 12 02
				29 01 00 00 00 00 02 13 11
				29 01 00 00 00 00 02 14 02
				29 01 00 00 00 00 02 15 41
				29 01 00 00 00 00 02 16 02
				29 01 00 00 00 00 02 17 78
				29 01 00 00 00 00 02 18 02
				29 01 00 00 00 00 02 19 9C
				29 01 00 00 00 00 02 1A 02
				29 01 00 00 00 00 02 1B CD
				29 01 00 00 00 00 02 1C 02
				29 01 00 00 00 00 02 1D EE
				29 01 00 00 00 00 02 1E 03
				29 01 00 00 00 00 02 1F 1B
				29 01 00 00 00 00 02 20 03
				29 01 00 00 00 00 02 21 28
				29 01 00 00 00 00 02 22 03
				29 01 00 00 00 00 02 23 38
				29 01 00 00 00 00 02 24 03
				29 01 00 00 00 00 02 25 48
				29 01 00 00 00 00 02 26 03
				29 01 00 00 00 00 02 27 52
				29 01 00 00 00 00 02 28 03
				29 01 00 00 00 00 02 29 83
				29 01 00 00 00 00 02 2A 03
				29 01 00 00 00 00 02 2B A3
				29 01 00 00 00 00 02 2D 03
				29 01 00 00 00 00 02 2F F5
				29 01 00 00 00 00 02 30 03
				29 01 00 00 00 00 02 31 FD
				29 01 00 00 00 00 02 32 00
				29 01 00 00 00 00 02 33 65
				29 01 00 00 00 00 02 34 00
				29 01 00 00 00 00 02 35 86
				29 01 00 00 00 00 02 36 00
				29 01 00 00 00 00 02 37 A6
				29 01 00 00 00 00 02 38 00
				29 01 00 00 00 00 02 39 BD
				29 01 00 00 00 00 02 3A 00
				29 01 00 00 00 00 02 3B CF
				29 01 00 00 00 00 02 3D 00
				29 01 00 00 00 00 02 3F DE
				29 01 00 00 00 00 02 40 00
				29 01 00 00 00 00 02 41 ED
				29 01 00 00 00 00 02 42 00
				29 01 00 00 00 00 02 43 F9
				29 01 00 00 00 00 02 44 01
				29 01 00 00 00 00 02 45 04
				29 01 00 00 00 00 02 46 01
				29 01 00 00 00 00 02 47 2A
				29 01 00 00 00 00 02 48 01
				29 01 00 00 00 00 02 49 47
				29 01 00 00 00 00 02 4A 01
				29 01 00 00 00 00 02 4B 77
				29 01 00 00 00 00 02 4C 01
				29 01 00 00 00 00 02 4D 9E
				29 01 00 00 00 00 02 4E 01
				29 01 00 00 00 00 02 4F DC
				29 01 00 00 00 00 02 50 02
				29 01 00 00 00 00 02 51 10
				29 01 00 00 00 00 02 52 02
				29 01 00 00 00 00 02 53 11
				29 01 00 00 00 00 02 54 02
				29 01 00 00 00 00 02 55 41
				29 01 00 00 00 00 02 56 02
				29 01 00 00 00 00 02 58 78
				29 01 00 00 00 00 02 59 02
				29 01 00 00 00 00 02 5A 9C
				29 01 00 00 00 00 02 5B 02
				29 01 00 00 00 00 02 5C CD
				29 01 00 00 00 00 02 5D 02
				29 01 00 00 00 00 02 5E EE
				29 01 00 00 00 00 02 5F 03
				29 01 00 00 00 00 02 60 1B
				29 01 00 00 00 00 02 61 03
				29 01 00 00 00 00 02 62 28
				29 01 00 00 00 00 02 63 03
				29 01 00 00 00 00 02 64 38
				29 01 00 00 00 00 02 65 03
				29 01 00 00 00 00 02 66 48
				29 01 00 00 00 00 02 67 03
				29 01 00 00 00 00 02 68 52
				29 01 00 00 00 00 02 69 03
				29 01 00 00 00 00 02 6A 83
				29 01 00 00 00 00 02 6B 03
				29 01 00 00 00 00 02 6C A3
				29 01 00 00 00 00 02 6D 03
				29 01 00 00 00 00 02 6E F5
				29 01 00 00 00 00 02 6F 03
				29 01 00 00 00 00 02 70 FD
				29 01 00 00 00 00 02 71 00
				29 01 00 00 00 00 02 72 BF
				29 01 00 00 00 00 02 73 00
				29 01 00 00 00 00 02 74 C8
				29 01 00 00 00 00 02 75 00
				29 01 00 00 00 00 02 76 D6
				29 01 00 00 00 00 02 77 00
				29 01 00 00 00 00 02 78 E3
				29 01 00 00 00 00 02 79 00
				29 01 00 00 00 00 02 7A EF
				29 01 00 00 00 00 02 7B 00
				29 01 00 00 00 00 02 7C F9
				29 01 00 00 00 00 02 7D 01
				29 01 00 00 00 00 02 7E 02
				29 01 00 00 00 00 02 7F 01
				29 01 00 00 00 00 02 80 0D
				29 01 00 00 00 00 02 81 01
				29 01 00 00 00 00 02 82 15
				29 01 00 00 00 00 02 83 01
				29 01 00 00 00 00 02 84 35
				29 01 00 00 00 00 02 85 01
				29 01 00 00 00 00 02 86 4F
				29 01 00 00 00 00 02 87 01
				29 01 00 00 00 00 02 88 7C
				29 01 00 00 00 00 02 89 01
				29 01 00 00 00 00 02 8A A0
				29 01 00 00 00 00 02 8B 01
				29 01 00 00 00 00 02 8C DD
				29 01 00 00 00 00 02 8D 02
				29 01 00 00 00 00 02 8E 10
				29 01 00 00 00 00 02 8F 02
				29 01 00 00 00 00 02 90 11
				29 01 00 00 00 00 02 91 02
				29 01 00 00 00 00 02 92 41
				29 01 00 00 00 00 02 93 02
				29 01 00 00 00 00 02 94 79
				29 01 00 00 00 00 02 95 02
				29 01 00 00 00 00 02 96 9E
				29 01 00 00 00 00 02 97 02
				29 01 00 00 00 00 02 98 D0
				29 01 00 00 00 00 02 99 02
				29 01 00 00 00 00 02 9A F6
				29 01 00 00 00 00 02 9B 03
				29 01 00 00 00 00 02 9C 2E
				29 01 00 00 00 00 02 9D 03
				29 01 00 00 00 00 02 9E 44
				29 01 00 00 00 00 02 9F 03
				29 01 00 00 00 00 02 A0 63
				29 01 00 00 00 00 02 A2 03
				29 01 00 00 00 00 02 A3 C4
				29 01 00 00 00 00 02 A4 03
				29 01 00 00 00 00 02 A5 EF
				29 01 00 00 00 00 02 A6 03
				29 01 00 00 00 00 02 A7 F3
				29 01 00 00 00 00 02 A9 03
				29 01 00 00 00 00 02 AA F8
				29 01 00 00 00 00 02 AB 03
				29 01 00 00 00 00 02 AC FB
				29 01 00 00 00 00 02 AD 03
				29 01 00 00 00 00 02 AE FC
				29 01 00 00 00 00 02 AF 00
				29 01 00 00 00 00 02 B0 BF
				29 01 00 00 00 00 02 B1 00
				29 01 00 00 00 00 02 B2 C8
				29 01 00 00 00 00 02 B3 00
				29 01 00 00 00 00 02 B4 D6
				29 01 00 00 00 00 02 B5 00
				29 01 00 00 00 00 02 B6 E3
				29 01 00 00 00 00 02 B7 00
				29 01 00 00 00 00 02 B8 EF
				29 01 00 00 00 00 02 B9 00
				29 01 00 00 00 00 02 BA F9
				29 01 00 00 00 00 02 BB 01
				29 01 00 00 00 00 02 BC 02
				29 01 00 00 00 00 02 BD 01
				29 01 00 00 00 00 02 BE 0D
				29 01 00 00 00 00 02 BF 01
				29 01 00 00 00 00 02 C0 15
				29 01 00 00 00 00 02 C1 01
				29 01 00 00 00 00 02 C2 35
				29 01 00 00 00 00 02 C3 01
				29 01 00 00 00 00 02 C4 4F
				29 01 00 00 00 00 02 C5 01
				29 01 00 00 00 00 02 C6 7C
				29 01 00 00 00 00 02 C7 01
				29 01 00 00 00 00 02 C8 A0
				29 01 00 00 00 00 02 C9 01
				29 01 00 00 00 00 02 CA DD
				29 01 00 00 00 00 02 CB 02
				29 01 00 00 00 00 02 CC 10
				29 01 00 00 00 00 02 CD 02
				29 01 00 00 00 00 02 CE 11
				29 01 00 00 00 00 02 CF 02
				29 01 00 00 00 00 02 D0 41
				29 01 00 00 00 00 02 D1 02
				29 01 00 00 00 00 02 D2 79
				29 01 00 00 00 00 02 D3 02
				29 01 00 00 00 00 02 D4 9E
				29 01 00 00 00 00 02 D5 02
				29 01 00 00 00 00 02 D6 D0
				29 01 00 00 00 00 02 D7 02
				29 01 00 00 00 00 02 D8 F6
				29 01 00 00 00 00 02 D9 03
				29 01 00 00 00 00 02 DA 2E
				29 01 00 00 00 00 02 DB 03
				29 01 00 00 00 00 02 DC 44
				29 01 00 00 00 00 02 DD 03
				29 01 00 00 00 00 02 DE 63
				29 01 00 00 00 00 02 DF 03
				29 01 00 00 00 00 02 E0 C4
				29 01 00 00 00 00 02 E1 03
				29 01 00 00 00 00 02 E2 EF
				29 01 00 00 00 00 02 E3 03
				29 01 00 00 00 00 02 E4 F3
				29 01 00 00 00 00 02 E5 03
				29 01 00 00 00 00 02 E6 F8
				29 01 00 00 00 00 02 E7 03
				29 01 00 00 00 00 02 E8 FB
				29 01 00 00 00 00 02 E9 03
				29 01 00 00 00 00 02 EA FC];

		/* gamma setting command */
		fih,mdss-dsi-color-gamma-1-command = [
				 29 01 00 00 00 00 02 75 00
				 29 01 00 00 00 00 02 76 58
				 29 01 00 00 00 00 02 77 00
				 29 01 00 00 00 00 02 78 7C
				 29 01 00 00 00 00 02 79 00
				 29 01 00 00 00 00 02 7A A4
				 29 01 00 00 00 00 02 7B 00
				 29 01 00 00 00 00 02 7C BA
				 29 01 00 00 00 00 02 7D 00
				 29 01 00 00 00 00 02 7E D0
				 29 01 00 00 00 00 02 7F 00
				 29 01 00 00 00 00 02 80 DE
				 29 01 00 00 00 00 02 81 00
				 29 01 00 00 00 00 02 82 EC
				 29 01 00 00 00 00 02 83 00
				 29 01 00 00 00 00 02 84 F8
				 29 01 00 00 00 00 02 85 01
				 29 01 00 00 00 00 02 86 03
				 29 01 00 00 00 00 02 87 01
				 29 01 00 00 00 00 02 88 2A
				 29 01 00 00 00 00 02 89 01
				 29 01 00 00 00 00 02 8A 48
				 29 01 00 00 00 00 02 8B 01
				 29 01 00 00 00 00 02 8C 79
				 29 01 00 00 00 00 02 8D 01
				 29 01 00 00 00 00 02 8E A0
				 29 01 00 00 00 00 02 8F 01
				 29 01 00 00 00 00 02 90 DE
				 29 01 00 00 00 00 02 91 02
				 29 01 00 00 00 00 02 92 11
				 29 01 00 00 00 00 02 93 02
				 29 01 00 00 00 00 02 94 14
				 29 01 00 00 00 00 02 95 02
				 29 01 00 00 00 00 02 96 42
				 29 01 00 00 00 00 02 97 02
				 29 01 00 00 00 00 02 98 79
				 29 01 00 00 00 00 02 99 02
				 29 01 00 00 00 00 02 9A 9C
				 29 01 00 00 00 00 02 9B 02
				 29 01 00 00 00 00 02 9C CC
				 29 01 00 00 00 00 02 9D 02
				 29 01 00 00 00 00 02 9E EF
				 29 01 00 00 00 00 02 9F 03
				 29 01 00 00 00 00 02 A0 18
				 29 01 00 00 00 00 02 A2 03
				 29 01 00 00 00 00 02 A3 26
				 29 01 00 00 00 00 02 A4 03
				 29 01 00 00 00 00 02 A5 33
				 29 01 00 00 00 00 02 A6 03
				 29 01 00 00 00 00 02 A7 42
				 29 01 00 00 00 00 02 A9 03
				 29 01 00 00 00 00 02 AA 6C
				 29 01 00 00 00 00 02 AB 03
				 29 01 00 00 00 00 02 AC 96
				 29 01 00 00 00 00 02 AD 03
				 29 01 00 00 00 00 02 AE 9E
				 29 01 00 00 00 00 02 AF 03
				 29 01 00 00 00 00 02 B0 9F
				 29 01 00 00 00 00 02 B1 03
				 29 01 00 00 00 00 02 B2 A0
				 29 01 00 00 00 00 02 B3 00
				 29 01 00 00 00 00 02 B4 58
				 29 01 00 00 00 00 02 B5 00
				 29 01 00 00 00 00 02 B6 7C
				 29 01 00 00 00 00 02 B7 00
				 29 01 00 00 00 00 02 B8 A4
				 29 01 00 00 00 00 02 B9 00
				 29 01 00 00 00 00 02 BA BA
				 29 01 00 00 00 00 02 BB 00
				 29 01 00 00 00 00 02 BC D0
				 29 01 00 00 00 00 02 BD 00
				 29 01 00 00 00 00 02 BE DE
				 29 01 00 00 00 00 02 BF 00
				 29 01 00 00 00 00 02 C0 EC
				 29 01 00 00 00 00 02 C1 00
				 29 01 00 00 00 00 02 C2 F8
				 29 01 00 00 00 00 02 C3 01
				 29 01 00 00 00 00 02 C4 03
				 29 01 00 00 00 00 02 C5 01
				 29 01 00 00 00 00 02 C6 2A
				 29 01 00 00 00 00 02 C7 01
				 29 01 00 00 00 00 02 C8 48
				 29 01 00 00 00 00 02 C9 01
				 29 01 00 00 00 00 02 CA 79
				 29 01 00 00 00 00 02 CB 01
				 29 01 00 00 00 00 02 CC A0
				 29 01 00 00 00 00 02 CD 01
				 29 01 00 00 00 00 02 CE DE
				 29 01 00 00 00 00 02 CF 02
				 29 01 00 00 00 00 02 D0 11
				 29 01 00 00 00 00 02 D1 02
				 29 01 00 00 00 00 02 D2 14
				 29 01 00 00 00 00 02 D3 02
				 29 01 00 00 00 00 02 D4 42
				 29 01 00 00 00 00 02 D5 02
				 29 01 00 00 00 00 02 D6 79
				 29 01 00 00 00 00 02 D7 02
				 29 01 00 00 00 00 02 D8 9C
				 29 01 00 00 00 00 02 D9 02
				 29 01 00 00 00 00 02 DA CC
				 29 01 00 00 00 00 02 DB 02
				 29 01 00 00 00 00 02 DC EF
				 29 01 00 00 00 00 02 DD 03
				 29 01 00 00 00 00 02 DE 18
				 29 01 00 00 00 00 02 DF 03
				 29 01 00 00 00 00 02 E0 26
				 29 01 00 00 00 00 02 E1 03
				 29 01 00 00 00 00 02 E2 33
				 29 01 00 00 00 00 02 E3 03
				 29 01 00 00 00 00 02 E4 42
				 29 01 00 00 00 00 02 E5 03
				 29 01 00 00 00 00 02 E6 6C
				 29 01 00 00 00 00 02 E7 03
				 29 01 00 00 00 00 02 E8 96
				 29 01 00 00 00 00 02 E9 03
				 29 01 00 00 00 00 02 EA 9E
				 29 01 00 00 00 00 02 EB 03
				 29 01 00 00 00 00 02 EC 9F
				 29 01 00 00 00 00 02 ED 03
				 29 01 00 00 00 00 02 EE A0
				 29 01 00 00 00 00 02 EF 00
				 29 01 00 00 00 00 02 F0 B4
				 29 01 00 00 00 00 02 F1 00
				 29 01 00 00 00 00 02 F2 BE
				 29 01 00 00 00 00 02 F3 00
				 29 01 00 00 00 00 02 F4 CF
				 29 01 00 00 00 00 02 F5 00
				 29 01 00 00 00 00 02 F6 DF
				 29 01 00 00 00 00 02 F7 00
				 29 01 00 00 00 00 02 F8 EC
				 29 01 00 00 00 00 02 F9 00
				 29 01 00 00 00 00 02 FA F8
				 29 01 00 00 00 00 02 FF 21
				 29 01 00 00 00 00 02 00 01
				 29 01 00 00 00 00 02 01 03
				 29 01 00 00 00 00 02 02 01
				 29 01 00 00 00 00 02 03 0E
				 29 01 00 00 00 00 02 04 01
				 29 01 00 00 00 00 02 05 17
				 29 01 00 00 00 00 02 06 01
				 29 01 00 00 00 00 02 07 38
				 29 01 00 00 00 00 02 08 01
				 29 01 00 00 00 00 02 09 53
				 29 01 00 00 00 00 02 0A 01
				 29 01 00 00 00 00 02 0B 80
				 29 01 00 00 00 00 02 0C 01
				 29 01 00 00 00 00 02 0D A4
				 29 01 00 00 00 00 02 0E 01
				 29 01 00 00 00 00 02 0F E0
				 29 01 00 00 00 00 02 10 02
				 29 01 00 00 00 00 02 11 12
				 29 01 00 00 00 00 02 12 02
				 29 01 00 00 00 00 02 13 13
				 29 01 00 00 00 00 02 14 02
				 29 01 00 00 00 00 02 15 43
				 29 01 00 00 00 00 02 16 02
				 29 01 00 00 00 00 02 17 7A
				 29 01 00 00 00 00 02 18 02
				 29 01 00 00 00 00 02 19 9E
				 29 01 00 00 00 00 02 1A 02
				 29 01 00 00 00 00 02 1B CE
				 29 01 00 00 00 00 02 1C 02
				 29 01 00 00 00 00 02 1D EE
				 29 01 00 00 00 00 02 1E 03
				 29 01 00 00 00 00 02 1F 19
				 29 01 00 00 00 00 02 20 03
				 29 01 00 00 00 00 02 21 25
				 29 01 00 00 00 00 02 22 03
				 29 01 00 00 00 00 02 23 33
				 29 01 00 00 00 00 02 24 03
				 29 01 00 00 00 00 02 25 3E
				 29 01 00 00 00 00 02 26 03
				 29 01 00 00 00 00 02 27 68
				 29 01 00 00 00 00 02 28 03
				 29 01 00 00 00 00 02 29 93
				 29 01 00 00 00 00 02 2A 03
				 29 01 00 00 00 00 02 2B 96
				 29 01 00 00 00 00 02 2D 03
				 29 01 00 00 00 00 02 2F 97
				 29 01 00 00 00 00 02 30 03
				 29 01 00 00 00 00 02 31 99
				 29 01 00 00 00 00 02 32 00
				 29 01 00 00 00 00 02 33 B4
				 29 01 00 00 00 00 02 34 00
				 29 01 00 00 00 00 02 35 BE
				 29 01 00 00 00 00 02 36 00
				 29 01 00 00 00 00 02 37 CF
				 29 01 00 00 00 00 02 38 00
				 29 01 00 00 00 00 02 39 DF
				 29 01 00 00 00 00 02 3A 00
				 29 01 00 00 00 00 02 3B EC
				 29 01 00 00 00 00 02 3D 00
				 29 01 00 00 00 00 02 3F F8
				 29 01 00 00 00 00 02 40 01
				 29 01 00 00 00 00 02 41 03
				 29 01 00 00 00 00 02 42 01
				 29 01 00 00 00 00 02 43 0E
				 29 01 00 00 00 00 02 44 01
				 29 01 00 00 00 00 02 45 17
				 29 01 00 00 00 00 02 46 01
				 29 01 00 00 00 00 02 47 38
				 29 01 00 00 00 00 02 48 01
				 29 01 00 00 00 00 02 49 53
				 29 01 00 00 00 00 02 4A 01
				 29 01 00 00 00 00 02 4B 80
				 29 01 00 00 00 00 02 4C 01
				 29 01 00 00 00 00 02 4D A4
				 29 01 00 00 00 00 02 4E 01
				 29 01 00 00 00 00 02 4F E0
				 29 01 00 00 00 00 02 50 02
				 29 01 00 00 00 00 02 51 12
				 29 01 00 00 00 00 02 52 02
				 29 01 00 00 00 00 02 53 13
				 29 01 00 00 00 00 02 54 02
				 29 01 00 00 00 00 02 55 43
				 29 01 00 00 00 00 02 56 02
				 29 01 00 00 00 00 02 58 7A
				 29 01 00 00 00 00 02 59 02
				 29 01 00 00 00 00 02 5A 9E
				 29 01 00 00 00 00 02 5B 02
				 29 01 00 00 00 00 02 5C CE
				 29 01 00 00 00 00 02 5D 02
				 29 01 00 00 00 00 02 5E EE
				 29 01 00 00 00 00 02 5F 03
				 29 01 00 00 00 00 02 60 19
				 29 01 00 00 00 00 02 61 03
				 29 01 00 00 00 00 02 62 25
				 29 01 00 00 00 00 02 63 03
				 29 01 00 00 00 00 02 64 33
				 29 01 00 00 00 00 02 65 03
				 29 01 00 00 00 00 02 66 3E
				 29 01 00 00 00 00 02 67 03
				 29 01 00 00 00 00 02 68 68
				 29 01 00 00 00 00 02 69 03
				 29 01 00 00 00 00 02 6A 93
				 29 01 00 00 00 00 02 6B 03
				 29 01 00 00 00 00 02 6C 96
				 29 01 00 00 00 00 02 6D 03
				 29 01 00 00 00 00 02 6E 97
				 29 01 00 00 00 00 02 6F 03
				 29 01 00 00 00 00 02 70 99
				 29 01 00 00 00 00 02 71 01
				 29 01 00 00 00 00 02 72 53
				 29 01 00 00 00 00 02 73 01
				 29 01 00 00 00 00 02 74 56
				 29 01 00 00 00 00 02 75 01
				 29 01 00 00 00 00 02 76 5B
				 29 01 00 00 00 00 02 77 01
				 29 01 00 00 00 00 02 78 60
				 29 01 00 00 00 00 02 79 01
				 29 01 00 00 00 00 02 7A 65
				 29 01 00 00 00 00 02 7B 01
				 29 01 00 00 00 00 02 7C 69
				 29 01 00 00 00 00 02 7D 01
				 29 01 00 00 00 00 02 7E 6E
				 29 01 00 00 00 00 02 7F 01
				 29 01 00 00 00 00 02 80 72
				 29 01 00 00 00 00 02 81 01
				 29 01 00 00 00 00 02 82 77
				 29 01 00 00 00 00 02 83 01
				 29 01 00 00 00 00 02 84 88
				 29 01 00 00 00 00 02 85 01
				 29 01 00 00 00 00 02 86 98
				 29 01 00 00 00 00 02 87 01
				 29 01 00 00 00 00 02 88 B5
				 29 01 00 00 00 00 02 89 01
				 29 01 00 00 00 00 02 8A D0
				 29 01 00 00 00 00 02 8B 01
				 29 01 00 00 00 00 02 8C FE
				 29 01 00 00 00 00 02 8D 02
				 29 01 00 00 00 00 02 8E 28
				 29 01 00 00 00 00 02 8F 02
				 29 01 00 00 00 00 02 90 29
				 29 01 00 00 00 00 02 91 02
				 29 01 00 00 00 00 02 92 55
				 29 01 00 00 00 00 02 93 02
				 29 01 00 00 00 00 02 94 8A
				 29 01 00 00 00 00 02 95 02
				 29 01 00 00 00 00 02 96 AE
				 29 01 00 00 00 00 02 97 02
				 29 01 00 00 00 00 02 98 E1
				 29 01 00 00 00 00 02 99 03
				 29 01 00 00 00 00 02 9A 0A
				 29 01 00 00 00 00 02 9B 03
				 29 01 00 00 00 00 02 9C 49
				 29 01 00 00 00 00 02 9D 03
				 29 01 00 00 00 00 02 9E 69
				 29 01 00 00 00 00 02 9F 03
				 29 01 00 00 00 00 02 A0 C9
				 29 01 00 00 00 00 02 A2 03
				 29 01 00 00 00 00 02 A3 D3
				 29 01 00 00 00 00 02 A4 03
				 29 01 00 00 00 00 02 A5 DC
				 29 01 00 00 00 00 02 A6 03
				 29 01 00 00 00 00 02 A7 E6
				 29 01 00 00 00 00 02 A9 03
				 29 01 00 00 00 00 02 AA EC
				 29 01 00 00 00 00 02 AB 03
				 29 01 00 00 00 00 02 AC EF
				 29 01 00 00 00 00 02 AD 03
				 29 01 00 00 00 00 02 AE F8
				 29 01 00 00 00 00 02 AF 01
				 29 01 00 00 00 00 02 B0 53
				 29 01 00 00 00 00 02 B1 01
				 29 01 00 00 00 00 02 B2 56
				 29 01 00 00 00 00 02 B3 01
				 29 01 00 00 00 00 02 B4 5B
				 29 01 00 00 00 00 02 B5 01
				 29 01 00 00 00 00 02 B6 60
				 29 01 00 00 00 00 02 B7 01
				 29 01 00 00 00 00 02 B8 65
				 29 01 00 00 00 00 02 B9 01
				 29 01 00 00 00 00 02 BA 69
				 29 01 00 00 00 00 02 BB 01
				 29 01 00 00 00 00 02 BC 6E
				 29 01 00 00 00 00 02 BD 01
				 29 01 00 00 00 00 02 BE 72
				 29 01 00 00 00 00 02 BF 01
				 29 01 00 00 00 00 02 C0 77
				 29 01 00 00 00 00 02 C1 01
				 29 01 00 00 00 00 02 C2 88
				 29 01 00 00 00 00 02 C3 01
				 29 01 00 00 00 00 02 C4 98
				 29 01 00 00 00 00 02 C5 01
				 29 01 00 00 00 00 02 C6 B5
				 29 01 00 00 00 00 02 C7 01
				 29 01 00 00 00 00 02 C8 D0
				 29 01 00 00 00 00 02 C9 01
				 29 01 00 00 00 00 02 CA FE
				 29 01 00 00 00 00 02 CB 02
				 29 01 00 00 00 00 02 CC 28
				 29 01 00 00 00 00 02 CD 02
				 29 01 00 00 00 00 02 CE 29
				 29 01 00 00 00 00 02 CF 02
				 29 01 00 00 00 00 02 D0 55
				 29 01 00 00 00 00 02 D1 02
				 29 01 00 00 00 00 02 D2 8A
				 29 01 00 00 00 00 02 D3 02
				 29 01 00 00 00 00 02 D4 AE
				 29 01 00 00 00 00 02 D5 02
				 29 01 00 00 00 00 02 D6 E1
				 29 01 00 00 00 00 02 D7 03
				 29 01 00 00 00 00 02 D8 0A
				 29 01 00 00 00 00 02 D9 03
				 29 01 00 00 00 00 02 DA 49
				 29 01 00 00 00 00 02 DB 03
				 29 01 00 00 00 00 02 DC 69
				 29 01 00 00 00 00 02 DD 03
				 29 01 00 00 00 00 02 DE C9
				 29 01 00 00 00 00 02 DF 03
				 29 01 00 00 00 00 02 E0 D3
				 29 01 00 00 00 00 02 E1 03
				 29 01 00 00 00 00 02 E2 DC
				 29 01 00 00 00 00 02 E3 03
				 29 01 00 00 00 00 02 E4 E6
				 29 01 00 00 00 00 02 E5 03
				 29 01 00 00 00 00 02 E6 EC
				 29 01 00 00 00 00 02 E7 03
				 29 01 00 00 00 00 02 E8 EF
				 29 01 00 00 00 00 02 E9 03
				 29 01 00 00 00 00 02 EA F8];
		fih,mdss-dsi-color-gamma-2-command = [
				 29 01 00 00 00 00 02 75 01
				 29 01 00 00 00 00 02 76 32
				 29 01 00 00 00 00 02 77 01
				 29 01 00 00 00 00 02 78 36
				 29 01 00 00 00 00 02 79 01
				 29 01 00 00 00 00 02 7A 3D
				 29 01 00 00 00 00 02 7B 01
				 29 01 00 00 00 00 02 7C 44
				 29 01 00 00 00 00 02 7D 01
				 29 01 00 00 00 00 02 7E 4A
				 29 01 00 00 00 00 02 7F 01
				 29 01 00 00 00 00 02 80 50
				 29 01 00 00 00 00 02 81 01
				 29 01 00 00 00 00 02 82 56
				 29 01 00 00 00 00 02 83 01
				 29 01 00 00 00 00 02 84 5D
				 29 01 00 00 00 00 02 85 01
				 29 01 00 00 00 00 02 86 63
				 29 01 00 00 00 00 02 87 01
				 29 01 00 00 00 00 02 88 74
				 29 01 00 00 00 00 02 89 01
				 29 01 00 00 00 00 02 8A 87
				 29 01 00 00 00 00 02 8B 01
				 29 01 00 00 00 00 02 8C AA
				 29 01 00 00 00 00 02 8D 01
				 29 01 00 00 00 00 02 8E C7
				 29 01 00 00 00 00 02 8F 01
				 29 01 00 00 00 00 02 90 F8
				 29 01 00 00 00 00 02 91 02
				 29 01 00 00 00 00 02 92 23
				 29 01 00 00 00 00 02 93 02
				 29 01 00 00 00 00 02 94 25
				 29 01 00 00 00 00 02 95 02
				 29 01 00 00 00 00 02 96 52
				 29 01 00 00 00 00 02 97 02
				 29 01 00 00 00 00 02 98 85
				 29 01 00 00 00 00 02 99 02
				 29 01 00 00 00 00 02 9A A7
				 29 01 00 00 00 00 02 9B 02
				 29 01 00 00 00 00 02 9C D8
				 29 01 00 00 00 00 02 9D 02
				 29 01 00 00 00 00 02 9E F9
				 29 01 00 00 00 00 02 9F 03
				 29 01 00 00 00 00 02 A0 20
				 29 01 00 00 00 00 02 A2 03
				 29 01 00 00 00 00 02 A3 26
				 29 01 00 00 00 00 02 A4 03
				 29 01 00 00 00 00 02 A5 47
				 29 01 00 00 00 00 02 A6 03
				 29 01 00 00 00 00 02 A7 68
				 29 01 00 00 00 00 02 A9 03
				 29 01 00 00 00 00 02 AA 89
				 29 01 00 00 00 00 02 AB 03
				 29 01 00 00 00 00 02 AC AA
				 29 01 00 00 00 00 02 AD 03
				 29 01 00 00 00 00 02 AE AB
				 29 01 00 00 00 00 02 AF 03
				 29 01 00 00 00 00 02 B0 AC
				 29 01 00 00 00 00 02 B1 03
				 29 01 00 00 00 00 02 B2 AE
				 29 01 00 00 00 00 02 B3 01
				 29 01 00 00 00 00 02 B4 32
				 29 01 00 00 00 00 02 B5 01
				 29 01 00 00 00 00 02 B6 36
				 29 01 00 00 00 00 02 B7 01
				 29 01 00 00 00 00 02 B8 3D
				 29 01 00 00 00 00 02 B9 01
				 29 01 00 00 00 00 02 BA 44
				 29 01 00 00 00 00 02 BB 01
				 29 01 00 00 00 00 02 BC 4A
				 29 01 00 00 00 00 02 BD 01
				 29 01 00 00 00 00 02 BE 50
				 29 01 00 00 00 00 02 BF 01
				 29 01 00 00 00 00 02 C0 56
				 29 01 00 00 00 00 02 C1 01
				 29 01 00 00 00 00 02 C2 5D
				 29 01 00 00 00 00 02 C3 01
				 29 01 00 00 00 00 02 C4 63
				 29 01 00 00 00 00 02 C5 01
				 29 01 00 00 00 00 02 C6 74
				 29 01 00 00 00 00 02 C7 01
				 29 01 00 00 00 00 02 C8 87
				 29 01 00 00 00 00 02 C9 01
				 29 01 00 00 00 00 02 CA AA
				 29 01 00 00 00 00 02 CB 01
				 29 01 00 00 00 00 02 CC C7
				 29 01 00 00 00 00 02 CD 01
				 29 01 00 00 00 00 02 CE F8
				 29 01 00 00 00 00 02 CF 02
				 29 01 00 00 00 00 02 D0 23
				 29 01 00 00 00 00 02 D1 02
				 29 01 00 00 00 00 02 D2 25
				 29 01 00 00 00 00 02 D3 02
				 29 01 00 00 00 00 02 D4 52
				 29 01 00 00 00 00 02 D5 02
				 29 01 00 00 00 00 02 D6 85
				 29 01 00 00 00 00 02 D7 02
				 29 01 00 00 00 00 02 D8 A7
				 29 01 00 00 00 00 02 D9 02
				 29 01 00 00 00 00 02 DA D8
				 29 01 00 00 00 00 02 DB 02
				 29 01 00 00 00 00 02 DC F9
				 29 01 00 00 00 00 02 DD 03
				 29 01 00 00 00 00 02 DE 20
				 29 01 00 00 00 00 02 DF 03
				 29 01 00 00 00 00 02 E0 26
				 29 01 00 00 00 00 02 E1 03
				 29 01 00 00 00 00 02 E2 47
				 29 01 00 00 00 00 02 E3 03
				 29 01 00 00 00 00 02 E4 68
				 29 01 00 00 00 00 02 E5 03
				 29 01 00 00 00 00 02 E6 89
				 29 01 00 00 00 00 02 E7 03
				 29 01 00 00 00 00 02 E8 AA
				 29 01 00 00 00 00 02 E9 03
				 29 01 00 00 00 00 02 EA AB
				 29 01 00 00 00 00 02 EB 03
				 29 01 00 00 00 00 02 EC AC
				 29 01 00 00 00 00 02 ED 03
				 29 01 00 00 00 00 02 EE AE
				 29 01 00 00 00 00 02 EF 01
				 29 01 00 00 00 00 02 F0 47
				 29 01 00 00 00 00 02 F1 01
				 29 01 00 00 00 00 02 F2 4A
				 29 01 00 00 00 00 02 F3 01
				 29 01 00 00 00 00 02 F4 50
				 29 01 00 00 00 00 02 F5 01
				 29 01 00 00 00 00 02 F6 55
				 29 01 00 00 00 00 02 F7 01
				 29 01 00 00 00 00 02 F8 5B
				 29 01 00 00 00 00 02 F9 01
				 29 01 00 00 00 00 02 FA 60
				 29 01 00 00 00 00 02 FF 21
				 29 01 00 00 00 00 02 00 01
				 29 01 00 00 00 00 02 01 65
				 29 01 00 00 00 00 02 02 01
				 29 01 00 00 00 00 02 03 6A
				 29 01 00 00 00 00 02 04 01
				 29 01 00 00 00 00 02 05 6F
				 29 01 00 00 00 00 02 06 01
				 29 01 00 00 00 00 02 07 82
				 29 01 00 00 00 00 02 08 01
				 29 01 00 00 00 00 02 09 93
				 29 01 00 00 00 00 02 0A 01
				 29 01 00 00 00 00 02 0B B1
				 29 01 00 00 00 00 02 0C 01
				 29 01 00 00 00 00 02 0D CC
				 29 01 00 00 00 00 02 0E 01
				 29 01 00 00 00 00 02 0F FC
				 29 01 00 00 00 00 02 10 02
				 29 01 00 00 00 00 02 11 27
				 29 01 00 00 00 00 02 12 02
				 29 01 00 00 00 00 02 13 28
				 29 01 00 00 00 00 02 14 02
				 29 01 00 00 00 00 02 15 53
				 29 01 00 00 00 00 02 16 02
				 29 01 00 00 00 00 02 17 88
				 29 01 00 00 00 00 02 18 02
				 29 01 00 00 00 00 02 19 AB
				 29 01 00 00 00 00 02 1A 02
				 29 01 00 00 00 00 02 1B DA
				 29 01 00 00 00 00 02 1C 02
				 29 01 00 00 00 00 02 1D FA
				 29 01 00 00 00 00 02 1E 03
				 29 01 00 00 00 00 02 1F 23
				 29 01 00 00 00 00 02 20 03
				 29 01 00 00 00 00 02 21 32
				 29 01 00 00 00 00 02 22 03
				 29 01 00 00 00 00 02 23 51
				 29 01 00 00 00 00 02 24 03
				 29 01 00 00 00 00 02 25 70
				 29 01 00 00 00 00 02 26 03
				 29 01 00 00 00 00 02 27 8F
				 29 01 00 00 00 00 02 28 03
				 29 01 00 00 00 00 02 29 AF
				 29 01 00 00 00 00 02 2A 03
				 29 01 00 00 00 00 02 2B B0
				 29 01 00 00 00 00 02 2D 03
				 29 01 00 00 00 00 02 2F B1
				 29 01 00 00 00 00 02 30 03
				 29 01 00 00 00 00 02 31 B5
				 29 01 00 00 00 00 02 32 01
				 29 01 00 00 00 00 02 33 47
				 29 01 00 00 00 00 02 34 01
				 29 01 00 00 00 00 02 35 4A
				 29 01 00 00 00 00 02 36 01
				 29 01 00 00 00 00 02 37 50
				 29 01 00 00 00 00 02 38 01
				 29 01 00 00 00 00 02 39 55
				 29 01 00 00 00 00 02 3A 01
				 29 01 00 00 00 00 02 3B 5B
				 29 01 00 00 00 00 02 3D 01
				 29 01 00 00 00 00 02 3F 60
				 29 01 00 00 00 00 02 40 01
				 29 01 00 00 00 00 02 41 65
				 29 01 00 00 00 00 02 42 01
				 29 01 00 00 00 00 02 43 6A
				 29 01 00 00 00 00 02 44 01
				 29 01 00 00 00 00 02 45 6F
				 29 01 00 00 00 00 02 46 01
				 29 01 00 00 00 00 02 47 82
				 29 01 00 00 00 00 02 48 01
				 29 01 00 00 00 00 02 49 93
				 29 01 00 00 00 00 02 4A 01
				 29 01 00 00 00 00 02 4B B1
				 29 01 00 00 00 00 02 4C 01
				 29 01 00 00 00 00 02 4D CC
				 29 01 00 00 00 00 02 4E 01
				 29 01 00 00 00 00 02 4F FC
				 29 01 00 00 00 00 02 50 02
				 29 01 00 00 00 00 02 51 27
				 29 01 00 00 00 00 02 52 02
				 29 01 00 00 00 00 02 53 28
				 29 01 00 00 00 00 02 54 02
				 29 01 00 00 00 00 02 55 53
				 29 01 00 00 00 00 02 56 02
				 29 01 00 00 00 00 02 58 88
				 29 01 00 00 00 00 02 59 02
				 29 01 00 00 00 00 02 5A AB
				 29 01 00 00 00 00 02 5B 02
				 29 01 00 00 00 00 02 5C DA
				 29 01 00 00 00 00 02 5D 02
				 29 01 00 00 00 00 02 5E FA
				 29 01 00 00 00 00 02 5F 03
				 29 01 00 00 00 00 02 60 23
				 29 01 00 00 00 00 02 61 03
				 29 01 00 00 00 00 02 62 32
				 29 01 00 00 00 00 02 63 03
				 29 01 00 00 00 00 02 64 51
				 29 01 00 00 00 00 02 65 03
				 29 01 00 00 00 00 02 66 70
				 29 01 00 00 00 00 02 67 03
				 29 01 00 00 00 00 02 68 8F
				 29 01 00 00 00 00 02 69 03
				 29 01 00 00 00 00 02 6A AF
				 29 01 00 00 00 00 02 6B 03
				 29 01 00 00 00 00 02 6C B0
				 29 01 00 00 00 00 02 6D 03
				 29 01 00 00 00 00 02 6E B1
				 29 01 00 00 00 00 02 6F 03
				 29 01 00 00 00 00 02 70 B5
				 29 01 00 00 00 00 02 71 01
				 29 01 00 00 00 00 02 72 AD
				 29 01 00 00 00 00 02 73 01
				 29 01 00 00 00 00 02 74 AE
				 29 01 00 00 00 00 02 75 01
				 29 01 00 00 00 00 02 76 B1
				 29 01 00 00 00 00 02 77 01
				 29 01 00 00 00 00 02 78 B4
				 29 01 00 00 00 00 02 79 01
				 29 01 00 00 00 00 02 7A B7
				 29 01 00 00 00 00 02 7B 01
				 29 01 00 00 00 00 02 7C BA
				 29 01 00 00 00 00 02 7D 01
				 29 01 00 00 00 00 02 7E BD
				 29 01 00 00 00 00 02 7F 01
				 29 01 00 00 00 00 02 80 BF
				 29 01 00 00 00 00 02 81 01
				 29 01 00 00 00 00 02 82 C1
				 29 01 00 00 00 00 02 83 01
				 29 01 00 00 00 00 02 84 CD
				 29 01 00 00 00 00 02 85 01
				 29 01 00 00 00 00 02 86 D7
				 29 01 00 00 00 00 02 87 01
				 29 01 00 00 00 00 02 88 EB
				 29 01 00 00 00 00 02 89 01
				 29 01 00 00 00 00 02 8A FD
				 29 01 00 00 00 00 02 8B 02
				 29 01 00 00 00 00 02 8C 21
				 29 01 00 00 00 00 02 8D 02
				 29 01 00 00 00 00 02 8E 44
				 29 01 00 00 00 00 02 8F 02
				 29 01 00 00 00 00 02 90 45
				 29 01 00 00 00 00 02 91 02
				 29 01 00 00 00 00 02 92 6D
				 29 01 00 00 00 00 02 93 02
				 29 01 00 00 00 00 02 94 A0
				 29 01 00 00 00 00 02 95 02
				 29 01 00 00 00 00 02 96 C5
				 29 01 00 00 00 00 02 97 02
				 29 01 00 00 00 00 02 98 FB
				 29 01 00 00 00 00 02 99 03
				 29 01 00 00 00 00 02 9A 24
				 29 01 00 00 00 00 02 9B 03
				 29 01 00 00 00 00 02 9C 88
				 29 01 00 00 00 00 02 9D 03
				 29 01 00 00 00 00 02 9E BF
				 29 01 00 00 00 00 02 9F 03
				 29 01 00 00 00 00 02 A0 C8
				 29 01 00 00 00 00 02 A2 03
				 29 01 00 00 00 00 02 A3 D2
				 29 01 00 00 00 00 02 A4 03
				 29 01 00 00 00 00 02 A5 DC
				 29 01 00 00 00 00 02 A6 03
				 29 01 00 00 00 00 02 A7 E6
				 29 01 00 00 00 00 02 A9 03
				 29 01 00 00 00 00 02 AA EC
				 29 01 00 00 00 00 02 AB 03
				 29 01 00 00 00 00 02 AC EF
				 29 01 00 00 00 00 02 AD 03
				 29 01 00 00 00 00 02 AE F8
				 29 01 00 00 00 00 02 AF 01
				 29 01 00 00 00 00 02 B0 AD
				 29 01 00 00 00 00 02 B1 01
				 29 01 00 00 00 00 02 B2 AE
				 29 01 00 00 00 00 02 B3 01
				 29 01 00 00 00 00 02 B4 B1
				 29 01 00 00 00 00 02 B5 01
				 29 01 00 00 00 00 02 B6 B4
				 29 01 00 00 00 00 02 B7 01
				 29 01 00 00 00 00 02 B8 B7
				 29 01 00 00 00 00 02 B9 01
				 29 01 00 00 00 00 02 BA BA
				 29 01 00 00 00 00 02 BB 01
				 29 01 00 00 00 00 02 BC BD
				 29 01 00 00 00 00 02 BD 01
				 29 01 00 00 00 00 02 BE BF
				 29 01 00 00 00 00 02 BF 01
				 29 01 00 00 00 00 02 C0 C1
				 29 01 00 00 00 00 02 C1 01
				 29 01 00 00 00 00 02 C2 CD
				 29 01 00 00 00 00 02 C3 01
				 29 01 00 00 00 00 02 C4 D7
				 29 01 00 00 00 00 02 C5 01
				 29 01 00 00 00 00 02 C6 EB
				 29 01 00 00 00 00 02 C7 01
				 29 01 00 00 00 00 02 C8 FD
				 29 01 00 00 00 00 02 C9 02
				 29 01 00 00 00 00 02 CA 21
				 29 01 00 00 00 00 02 CB 02
				 29 01 00 00 00 00 02 CC 44
				 29 01 00 00 00 00 02 CD 02
				 29 01 00 00 00 00 02 CE 45
				 29 01 00 00 00 00 02 CF 02
				 29 01 00 00 00 00 02 D0 6D
				 29 01 00 00 00 00 02 D1 02
				 29 01 00 00 00 00 02 D2 A0
				 29 01 00 00 00 00 02 D3 02
				 29 01 00 00 00 00 02 D4 C5
				 29 01 00 00 00 00 02 D5 02
				 29 01 00 00 00 00 02 D6 FB
				 29 01 00 00 00 00 02 D7 03
				 29 01 00 00 00 00 02 D8 24
				 29 01 00 00 00 00 02 D9 03
				 29 01 00 00 00 00 02 DA 88
				 29 01 00 00 00 00 02 DB 03
				 29 01 00 00 00 00 02 DC BF
				 29 01 00 00 00 00 02 DD 03
				 29 01 00 00 00 00 02 DE C8
				 29 01 00 00 00 00 02 DF 03
				 29 01 00 00 00 00 02 E0 D2
				 29 01 00 00 00 00 02 E1 03
				 29 01 00 00 00 00 02 E2 DC
				 29 01 00 00 00 00 02 E3 03
				 29 01 00 00 00 00 02 E4 E6
				 29 01 00 00 00 00 02 E5 03
				 29 01 00 00 00 00 02 E6 EC
				 29 01 00 00 00 00 02 E7 03
				 29 01 00 00 00 00 02 E8 EF
				 29 01 00 00 00 00 02 E9 03
				 29 01 00 00 00 00 02 EA F8];
		fih,mdss-dsi-color-gamma-3-command = [
				29 01 00 00 00 00 02 75 01
				29 01 00 00 00 00 02 76 9A
				29 01 00 00 00 00 02 77 01
				29 01 00 00 00 00 02 78 9D
				29 01 00 00 00 00 02 79 01
				29 01 00 00 00 00 02 7A 9F
				29 01 00 00 00 00 02 7B 01
				29 01 00 00 00 00 02 7C A3
				29 01 00 00 00 00 02 7D 01
				29 01 00 00 00 00 02 7E A7
				29 01 00 00 00 00 02 7F 01
				29 01 00 00 00 00 02 80 AA
				29 01 00 00 00 00 02 81 01
				29 01 00 00 00 00 02 82 AC
				29 01 00 00 00 00 02 83 01
				29 01 00 00 00 00 02 84 B0
				29 01 00 00 00 00 02 85 01
				29 01 00 00 00 00 02 86 B3
				29 01 00 00 00 00 02 87 01
				29 01 00 00 00 00 02 88 BF
				29 01 00 00 00 00 02 89 01
				29 01 00 00 00 00 02 8A CA
				29 01 00 00 00 00 02 8B 01
				29 01 00 00 00 00 02 8C E1
				29 01 00 00 00 00 02 8D 01
				29 01 00 00 00 00 02 8E F5
				29 01 00 00 00 00 02 8F 02
				29 01 00 00 00 00 02 90 1B
				29 01 00 00 00 00 02 91 02
				29 01 00 00 00 00 02 92 3F
				29 01 00 00 00 00 02 93 02
				29 01 00 00 00 00 02 94 40
				29 01 00 00 00 00 02 95 02
				29 01 00 00 00 00 02 96 68
				29 01 00 00 00 00 02 97 02
				29 01 00 00 00 00 02 98 9A
				29 01 00 00 00 00 02 99 02
				29 01 00 00 00 00 02 9A BD
				29 01 00 00 00 00 02 9B 02
				29 01 00 00 00 00 02 9C EC
				29 01 00 00 00 00 02 9D 03
				29 01 00 00 00 00 02 9E 0A
				29 01 00 00 00 00 02 9F 03
				29 01 00 00 00 00 02 A0 27
				29 01 00 00 00 00 02 A2 03
				29 01 00 00 00 00 02 A3 43
				29 01 00 00 00 00 02 A4 03
				29 01 00 00 00 00 02 A5 5F
				29 01 00 00 00 00 02 A6 03
				29 01 00 00 00 00 02 A7 7C
				29 01 00 00 00 00 02 A9 03
				29 01 00 00 00 00 02 AA 99
				29 01 00 00 00 00 02 AB 03
				29 01 00 00 00 00 02 AC B6
				29 01 00 00 00 00 02 AD 03
				29 01 00 00 00 00 02 AE BC
				29 01 00 00 00 00 02 AF 03
				29 01 00 00 00 00 02 B0 C6
				29 01 00 00 00 00 02 B1 03
				29 01 00 00 00 00 02 B2 D0
				29 01 00 00 00 00 02 B3 01
				29 01 00 00 00 00 02 B4 9A
				29 01 00 00 00 00 02 B5 01
				29 01 00 00 00 00 02 B6 9D
				29 01 00 00 00 00 02 B7 01
				29 01 00 00 00 00 02 B8 9F
				29 01 00 00 00 00 02 B9 01
				29 01 00 00 00 00 02 BA A3
				29 01 00 00 00 00 02 BB 01
				29 01 00 00 00 00 02 BC A7
				29 01 00 00 00 00 02 BD 01
				29 01 00 00 00 00 02 BE AA
				29 01 00 00 00 00 02 BF 01
				29 01 00 00 00 00 02 C0 AC
				29 01 00 00 00 00 02 C1 01
				29 01 00 00 00 00 02 C2 B0
				29 01 00 00 00 00 02 C3 01
				29 01 00 00 00 00 02 C4 B3
				29 01 00 00 00 00 02 C5 01
				29 01 00 00 00 00 02 C6 BF
				29 01 00 00 00 00 02 C7 01
				29 01 00 00 00 00 02 C8 CA
				29 01 00 00 00 00 02 C9 01
				29 01 00 00 00 00 02 CA E1
				29 01 00 00 00 00 02 CB 01
				29 01 00 00 00 00 02 CC F5
				29 01 00 00 00 00 02 CD 02
				29 01 00 00 00 00 02 CE 1B
				29 01 00 00 00 00 02 CF 02
				29 01 00 00 00 00 02 D0 3F
				29 01 00 00 00 00 02 D1 02
				29 01 00 00 00 00 02 D2 40
				29 01 00 00 00 00 02 D3 02
				29 01 00 00 00 00 02 D4 68
				29 01 00 00 00 00 02 D5 02
				29 01 00 00 00 00 02 D6 9A
				29 01 00 00 00 00 02 D7 02
				29 01 00 00 00 00 02 D8 BD
				29 01 00 00 00 00 02 D9 02
				29 01 00 00 00 00 02 DA EC
				29 01 00 00 00 00 02 DB 03
				29 01 00 00 00 00 02 DC 0A
				29 01 00 00 00 00 02 DD 03
				29 01 00 00 00 00 02 DE 27
				29 01 00 00 00 00 02 DF 03
				29 01 00 00 00 00 02 E0 43
				29 01 00 00 00 00 02 E1 03
				29 01 00 00 00 00 02 E2 5F
				29 01 00 00 00 00 02 E3 03
				29 01 00 00 00 00 02 E4 7C
				29 01 00 00 00 00 02 E5 03
				29 01 00 00 00 00 02 E6 99
				29 01 00 00 00 00 02 E7 03
				29 01 00 00 00 00 02 E8 B6
				29 01 00 00 00 00 02 E9 03
				29 01 00 00 00 00 02 EA BC
				29 01 00 00 00 00 02 EB 03
				29 01 00 00 00 00 02 EC C6
				29 01 00 00 00 00 02 ED 03
				29 01 00 00 00 00 02 EE D0
				29 01 00 00 00 00 02 EF 01
				29 01 00 00 00 00 02 F0 A1
				29 01 00 00 00 00 02 F1 01
				29 01 00 00 00 00 02 F2 A2
				29 01 00 00 00 00 02 F3 01
				29 01 00 00 00 00 02 F4 A6
				29 01 00 00 00 00 02 F5 01
				29 01 00 00 00 00 02 F6 A9
				29 01 00 00 00 00 02 F7 01
				29 01 00 00 00 00 02 F8 AC
				29 01 00 00 00 00 02 F9 01
				29 01 00 00 00 00 02 FA AF
				29 01 00 00 00 00 02 FF 21
				29 01 00 00 00 00 02 00 01
				29 01 00 00 00 00 02 01 B2
				29 01 00 00 00 00 02 02 01
				29 01 00 00 00 00 02 03 B5
				29 01 00 00 00 00 02 04 01
				29 01 00 00 00 00 02 05 B8
				29 01 00 00 00 00 02 06 01
				29 01 00 00 00 00 02 07 C3
				29 01 00 00 00 00 02 08 01
				29 01 00 00 00 00 02 09 CF
				29 01 00 00 00 00 02 0A 01
				29 01 00 00 00 00 02 0B E3
				29 01 00 00 00 00 02 0C 01
				29 01 00 00 00 00 02 0D F7
				29 01 00 00 00 00 02 0E 02
				29 01 00 00 00 00 02 0F 1C
				29 01 00 00 00 00 02 10 02
				29 01 00 00 00 00 02 11 40
				29 01 00 00 00 00 02 12 02
				29 01 00 00 00 00 02 13 41
				29 01 00 00 00 00 02 14 02
				29 01 00 00 00 00 02 15 69
				29 01 00 00 00 00 02 16 02
				29 01 00 00 00 00 02 17 9C
				29 01 00 00 00 00 02 18 02
				29 01 00 00 00 00 02 19 BE
				29 01 00 00 00 00 02 1A 02
				29 01 00 00 00 00 02 1B ED
				29 01 00 00 00 00 02 1C 03
				29 01 00 00 00 00 02 1D 0D
				29 01 00 00 00 00 02 1E 03
				29 01 00 00 00 00 02 1F 27
				29 01 00 00 00 00 02 20 03
				29 01 00 00 00 00 02 21 43
				29 01 00 00 00 00 02 22 03
				29 01 00 00 00 00 02 23 5F
				29 01 00 00 00 00 02 24 03
				29 01 00 00 00 00 02 25 7C
				29 01 00 00 00 00 02 26 03
				29 01 00 00 00 00 02 27 99
				29 01 00 00 00 00 02 28 03
				29 01 00 00 00 00 02 29 B6
				29 01 00 00 00 00 02 2A 03
				29 01 00 00 00 00 02 2B B8
				29 01 00 00 00 00 02 2D 03
				29 01 00 00 00 00 02 2F F5
				29 01 00 00 00 00 02 30 03
				29 01 00 00 00 00 02 31 FD
				29 01 00 00 00 00 02 32 01
				29 01 00 00 00 00 02 33 A1
				29 01 00 00 00 00 02 34 01
				29 01 00 00 00 00 02 35 A2
				29 01 00 00 00 00 02 36 01
				29 01 00 00 00 00 02 37 A6
				29 01 00 00 00 00 02 38 01
				29 01 00 00 00 00 02 39 A9
				29 01 00 00 00 00 02 3A 01
				29 01 00 00 00 00 02 3B AC
				29 01 00 00 00 00 02 3D 01
				29 01 00 00 00 00 02 3F AF
				29 01 00 00 00 00 02 40 01
				29 01 00 00 00 00 02 41 B2
				29 01 00 00 00 00 02 42 01
				29 01 00 00 00 00 02 43 B5
				29 01 00 00 00 00 02 44 01
				29 01 00 00 00 00 02 45 B8
				29 01 00 00 00 00 02 46 01
				29 01 00 00 00 00 02 47 C3
				29 01 00 00 00 00 02 48 01
				29 01 00 00 00 00 02 49 CF
				29 01 00 00 00 00 02 4A 01
				29 01 00 00 00 00 02 4B E3
				29 01 00 00 00 00 02 4C 01
				29 01 00 00 00 00 02 4D F7
				29 01 00 00 00 00 02 4E 02
				29 01 00 00 00 00 02 4F 1C
				29 01 00 00 00 00 02 50 02
				29 01 00 00 00 00 02 51 40
				29 01 00 00 00 00 02 52 02
				29 01 00 00 00 00 02 53 41
				29 01 00 00 00 00 02 54 02
				29 01 00 00 00 00 02 55 69
				29 01 00 00 00 00 02 56 02
				29 01 00 00 00 00 02 58 9C
				29 01 00 00 00 00 02 59 02
				29 01 00 00 00 00 02 5A BE
				29 01 00 00 00 00 02 5B 02
				29 01 00 00 00 00 02 5C ED
				29 01 00 00 00 00 02 5D 03
				29 01 00 00 00 00 02 5E 0D
				29 01 00 00 00 00 02 5F 03
				29 01 00 00 00 00 02 60 27
				29 01 00 00 00 00 02 61 03
				29 01 00 00 00 00 02 62 43
				29 01 00 00 00 00 02 63 03
				29 01 00 00 00 00 02 64 5F
				29 01 00 00 00 00 02 65 03
				29 01 00 00 00 00 02 66 7C
				29 01 00 00 00 00 02 67 03
				29 01 00 00 00 00 02 68 99
				29 01 00 00 00 00 02 69 03
				29 01 00 00 00 00 02 6A B6
				29 01 00 00 00 00 02 6B 03
				29 01 00 00 00 00 02 6C B8
				29 01 00 00 00 00 02 6D 03
				29 01 00 00 00 00 02 6E F5
				29 01 00 00 00 00 02 6F 03
				29 01 00 00 00 00 02 70 FD
				29 01 00 00 00 00 02 71 01
				29 01 00 00 00 00 02 72 E7
				29 01 00 00 00 00 02 73 01
				29 01 00 00 00 00 02 74 E9
				29 01 00 00 00 00 02 75 01
				29 01 00 00 00 00 02 76 EA
				29 01 00 00 00 00 02 77 01
				29 01 00 00 00 00 02 78 ED
				29 01 00 00 00 00 02 79 01
				29 01 00 00 00 00 02 7A EF
				29 01 00 00 00 00 02 7B 01
				29 01 00 00 00 00 02 7C F0
				29 01 00 00 00 00 02 7D 01
				29 01 00 00 00 00 02 7E F2
				29 01 00 00 00 00 02 7F 01
				29 01 00 00 00 00 02 80 F4
				29 01 00 00 00 00 02 81 01
				29 01 00 00 00 00 02 82 F6
				29 01 00 00 00 00 02 83 01
				29 01 00 00 00 00 02 84 FE
				29 01 00 00 00 00 02 85 02
				29 01 00 00 00 00 02 86 05
				29 01 00 00 00 00 02 87 02
				29 01 00 00 00 00 02 88 13
				29 01 00 00 00 00 02 89 02
				29 01 00 00 00 00 02 8A 22
				29 01 00 00 00 00 02 8B 02
				29 01 00 00 00 00 02 8C 40
				29 01 00 00 00 00 02 8D 02
				29 01 00 00 00 00 02 8E 5F
				29 01 00 00 00 00 02 8F 02
				29 01 00 00 00 00 02 90 60
				29 01 00 00 00 00 02 91 02
				29 01 00 00 00 00 02 92 85
				29 01 00 00 00 00 02 93 02
				29 01 00 00 00 00 02 94 B8
				29 01 00 00 00 00 02 95 02
				29 01 00 00 00 00 02 96 DE
				29 01 00 00 00 00 02 97 03
				29 01 00 00 00 00 02 98 18
				29 01 00 00 00 00 02 99 03
				29 01 00 00 00 00 02 9A 4C
				29 01 00 00 00 00 02 9B 03
				29 01 00 00 00 00 02 9C CE
				29 01 00 00 00 00 02 9D 03
				29 01 00 00 00 00 02 9E D4
				29 01 00 00 00 00 02 9F 03
				29 01 00 00 00 00 02 A0 DA
				29 01 00 00 00 00 02 A2 03
				29 01 00 00 00 00 02 A3 E0
				29 01 00 00 00 00 02 A4 03
				29 01 00 00 00 00 02 A5 E6
				29 01 00 00 00 00 02 A6 03
				29 01 00 00 00 00 02 A7 ED
				29 01 00 00 00 00 02 A9 03
				29 01 00 00 00 00 02 AA EF
				29 01 00 00 00 00 02 AB 03
				29 01 00 00 00 00 02 AC F1
				29 01 00 00 00 00 02 AD 03
				29 01 00 00 00 00 02 AE F6
				29 01 00 00 00 00 02 AF 01
				29 01 00 00 00 00 02 B0 E7
				29 01 00 00 00 00 02 B1 01
				29 01 00 00 00 00 02 B2 E9
				29 01 00 00 00 00 02 B3 01
				29 01 00 00 00 00 02 B4 EA
				29 01 00 00 00 00 02 B5 01
				29 01 00 00 00 00 02 B6 ED
				29 01 00 00 00 00 02 B7 01
				29 01 00 00 00 00 02 B8 EF
				29 01 00 00 00 00 02 B9 01
				29 01 00 00 00 00 02 BA F0
				29 01 00 00 00 00 02 BB 01
				29 01 00 00 00 00 02 BC F2
				29 01 00 00 00 00 02 BD 01
				29 01 00 00 00 00 02 BE F4
				29 01 00 00 00 00 02 BF 01
				29 01 00 00 00 00 02 C0 F6
				29 01 00 00 00 00 02 C1 01
				29 01 00 00 00 00 02 C2 FE
				29 01 00 00 00 00 02 C3 02
				29 01 00 00 00 00 02 C4 05
				29 01 00 00 00 00 02 C5 02
				29 01 00 00 00 00 02 C6 13
				29 01 00 00 00 00 02 C7 02
				29 01 00 00 00 00 02 C8 22
				29 01 00 00 00 00 02 C9 02
				29 01 00 00 00 00 02 CA 40
				29 01 00 00 00 00 02 CB 02
				29 01 00 00 00 00 02 CC 5F
				29 01 00 00 00 00 02 CD 02
				29 01 00 00 00 00 02 CE 60
				29 01 00 00 00 00 02 CF 02
				29 01 00 00 00 00 02 D0 85
				29 01 00 00 00 00 02 D1 02
				29 01 00 00 00 00 02 D2 B8
				29 01 00 00 00 00 02 D3 02
				29 01 00 00 00 00 02 D4 DE
				29 01 00 00 00 00 02 D5 03
				29 01 00 00 00 00 02 D6 18
				29 01 00 00 00 00 02 D7 03
				29 01 00 00 00 00 02 D8 4C
				29 01 00 00 00 00 02 D9 03
				29 01 00 00 00 00 02 DA CE
				29 01 00 00 00 00 02 DB 03
				29 01 00 00 00 00 02 DC D4
				29 01 00 00 00 00 02 DD 03
				29 01 00 00 00 00 02 DE DA
				29 01 00 00 00 00 02 DF 03
				29 01 00 00 00 00 02 E0 E0
				29 01 00 00 00 00 02 E1 03
				29 01 00 00 00 00 02 E2 E6
				29 01 00 00 00 00 02 E3 03
				29 01 00 00 00 00 02 E4 ED
				29 01 00 00 00 00 02 E5 03
				29 01 00 00 00 00 02 E6 EF
				29 01 00 00 00 00 02 E7 03
				29 01 00 00 00 00 02 E8 F1
				29 01 00 00 00 00 02 E9 03
				29 01 00 00 00 00 02 EA F6];
		fih,mdss-dsi-color-gamma-4-command = [
				29 01 00 00 00 00 02 75 01
				29 01 00 00 00 00 02 76 F2
				29 01 00 00 00 00 02 77 01
				29 01 00 00 00 00 02 78 F3
				29 01 00 00 00 00 02 79 01
				29 01 00 00 00 00 02 7A F4
				29 01 00 00 00 00 02 7B 01
				29 01 00 00 00 00 02 7C F6
				29 01 00 00 00 00 02 7D 01
				29 01 00 00 00 00 02 7E F7
				29 01 00 00 00 00 02 7F 01
				29 01 00 00 00 00 02 80 FA
				29 01 00 00 00 00 02 81 01
				29 01 00 00 00 00 02 82 FE
				29 01 00 00 00 00 02 83 01
				29 01 00 00 00 00 02 84 FF
				29 01 00 00 00 00 02 85 02
				29 01 00 00 00 00 02 86 00
				29 01 00 00 00 00 02 87 02
				29 01 00 00 00 00 02 88 08
				29 01 00 00 00 00 02 89 02
				29 01 00 00 00 00 02 8A 0D
				29 01 00 00 00 00 02 8B 02
				29 01 00 00 00 00 02 8C 1E
				29 01 00 00 00 00 02 8D 02
				29 01 00 00 00 00 02 8E 2B
				29 01 00 00 00 00 02 8F 02
				29 01 00 00 00 00 02 90 45
				29 01 00 00 00 00 02 91 02
				29 01 00 00 00 00 02 92 64
				29 01 00 00 00 00 02 93 02
				29 01 00 00 00 00 02 94 65
				29 01 00 00 00 00 02 95 02
				29 01 00 00 00 00 02 96 89
				29 01 00 00 00 00 02 97 02
				29 01 00 00 00 00 02 98 BB
				29 01 00 00 00 00 02 99 02
				29 01 00 00 00 00 02 9A DB
				29 01 00 00 00 00 02 9B 03
				29 01 00 00 00 00 02 9C 09
				29 01 00 00 00 00 02 9D 03
				29 01 00 00 00 00 02 9E 21
				29 01 00 00 00 00 02 9F 03
				29 01 00 00 00 00 02 A0 22
				29 01 00 00 00 00 02 A2 03
				29 01 00 00 00 00 02 A3 3F
				29 01 00 00 00 00 02 A4 03
				29 01 00 00 00 00 02 A5 5C
				29 01 00 00 00 00 02 A6 03
				29 01 00 00 00 00 02 A7 79
				29 01 00 00 00 00 02 A9 03
				29 01 00 00 00 00 02 AA 96
				29 01 00 00 00 00 02 AB 03
				29 01 00 00 00 00 02 AC B4
				29 01 00 00 00 00 02 AD 03
				29 01 00 00 00 00 02 AE B9
				29 01 00 00 00 00 02 AF 03
				29 01 00 00 00 00 02 B0 D0
				29 01 00 00 00 00 02 B1 03
				29 01 00 00 00 00 02 B2 E8
				29 01 00 00 00 00 02 B3 01
				29 01 00 00 00 00 02 B4 F2
				29 01 00 00 00 00 02 B5 01
				29 01 00 00 00 00 02 B6 F3
				29 01 00 00 00 00 02 B7 01
				29 01 00 00 00 00 02 B8 F4
				29 01 00 00 00 00 02 B9 01
				29 01 00 00 00 00 02 BA F6
				29 01 00 00 00 00 02 BB 01
				29 01 00 00 00 00 02 BC F7
				29 01 00 00 00 00 02 BD 01
				29 01 00 00 00 00 02 BE FA
				29 01 00 00 00 00 02 BF 01
				29 01 00 00 00 00 02 C0 FE
				29 01 00 00 00 00 02 C1 01
				29 01 00 00 00 00 02 C2 FF
				29 01 00 00 00 00 02 C3 02
				29 01 00 00 00 00 02 C4 00
				29 01 00 00 00 00 02 C5 02
				29 01 00 00 00 00 02 C6 08
				29 01 00 00 00 00 02 C7 02
				29 01 00 00 00 00 02 C8 0D
				29 01 00 00 00 00 02 C9 02
				29 01 00 00 00 00 02 CA 1E
				29 01 00 00 00 00 02 CB 02
				29 01 00 00 00 00 02 CC 2B
				29 01 00 00 00 00 02 CD 02
				29 01 00 00 00 00 02 CE 45
				29 01 00 00 00 00 02 CF 02
				29 01 00 00 00 00 02 D0 64
				29 01 00 00 00 00 02 D1 02
				29 01 00 00 00 00 02 D2 65
				29 01 00 00 00 00 02 D3 02
				29 01 00 00 00 00 02 D4 89
				29 01 00 00 00 00 02 D5 02
				29 01 00 00 00 00 02 D6 BB
				29 01 00 00 00 00 02 D7 02
				29 01 00 00 00 00 02 D8 DB
				29 01 00 00 00 00 02 D9 03
				29 01 00 00 00 00 02 DA 09
				29 01 00 00 00 00 02 DB 03
				29 01 00 00 00 00 02 DC 21
				29 01 00 00 00 00 02 DD 03
				29 01 00 00 00 00 02 DE 22
				29 01 00 00 00 00 02 DF 03
				29 01 00 00 00 00 02 E0 3F
				29 01 00 00 00 00 02 E1 03
				29 01 00 00 00 00 02 E2 5C
				29 01 00 00 00 00 02 E3 03
				29 01 00 00 00 00 02 E4 79
				29 01 00 00 00 00 02 E5 03
				29 01 00 00 00 00 02 E6 96
				29 01 00 00 00 00 02 E7 03
				29 01 00 00 00 00 02 E8 B4
				29 01 00 00 00 00 02 E9 03
				29 01 00 00 00 00 02 EA B9
				29 01 00 00 00 00 02 EB 03
				29 01 00 00 00 00 02 EC D0
				29 01 00 00 00 00 02 ED 03
				29 01 00 00 00 00 02 EE E8
				29 01 00 00 00 00 02 EF 01
				29 01 00 00 00 00 02 F0 F8
				29 01 00 00 00 00 02 F1 01
				29 01 00 00 00 00 02 F2 F9
				29 01 00 00 00 00 02 F3 01
				29 01 00 00 00 00 02 F4 FB
				29 01 00 00 00 00 02 F5 01
				29 01 00 00 00 00 02 F6 FD
				29 01 00 00 00 00 02 F7 01
				29 01 00 00 00 00 02 F8 FF
				29 01 00 00 00 00 02 F9 02
				29 01 00 00 00 00 02 FA 00
				29 01 00 00 00 00 02 FF 21
				29 01 00 00 00 00 02 00 02
				29 01 00 00 00 00 02 01 01
				29 01 00 00 00 00 02 02 02
				29 01 00 00 00 00 02 03 03
				29 01 00 00 00 00 02 04 02
				29 01 00 00 00 00 02 05 05
				29 01 00 00 00 00 02 06 02
				29 01 00 00 00 00 02 07 0C
				29 01 00 00 00 00 02 08 02
				29 01 00 00 00 00 02 09 13
				29 01 00 00 00 00 02 0A 02
				29 01 00 00 00 00 02 0B 20
				29 01 00 00 00 00 02 0C 02
				29 01 00 00 00 00 02 0D 2E
				29 01 00 00 00 00 02 0E 02
				29 01 00 00 00 00 02 0F 4A
				29 01 00 00 00 00 02 10 02
				29 01 00 00 00 00 02 11 68
				29 01 00 00 00 00 02 12 02
				29 01 00 00 00 00 02 13 69
				29 01 00 00 00 00 02 14 02
				29 01 00 00 00 00 02 15 8D
				29 01 00 00 00 00 02 16 02
				29 01 00 00 00 00 02 17 BD
				29 01 00 00 00 00 02 18 02
				29 01 00 00 00 00 02 19 DF
				29 01 00 00 00 00 02 1A 03
				29 01 00 00 00 00 02 1B 0B
				29 01 00 00 00 00 02 1C 03
				29 01 00 00 00 00 02 1D 22
				29 01 00 00 00 00 02 1E 03
				29 01 00 00 00 00 02 1F 23
				29 01 00 00 00 00 02 20 03
				29 01 00 00 00 00 02 21 40
				29 01 00 00 00 00 02 22 03
				29 01 00 00 00 00 02 23 5D
				29 01 00 00 00 00 02 24 03
				29 01 00 00 00 00 02 25 7A
				29 01 00 00 00 00 02 26 03
				29 01 00 00 00 00 02 27 97
				29 01 00 00 00 00 02 28 03
				29 01 00 00 00 00 02 29 B4
				29 01 00 00 00 00 02 2A 03
				29 01 00 00 00 00 02 2B B8
				29 01 00 00 00 00 02 2D 03
				29 01 00 00 00 00 02 2F D7
				29 01 00 00 00 00 02 30 03
				29 01 00 00 00 00 02 31 EC
				29 01 00 00 00 00 02 32 01
				29 01 00 00 00 00 02 33 F8
				29 01 00 00 00 00 02 34 01
				29 01 00 00 00 00 02 35 F9
				29 01 00 00 00 00 02 36 01
				29 01 00 00 00 00 02 37 FB
				29 01 00 00 00 00 02 38 01
				29 01 00 00 00 00 02 39 FD
				29 01 00 00 00 00 02 3A 01
				29 01 00 00 00 00 02 3B FF
				29 01 00 00 00 00 02 3D 02
				29 01 00 00 00 00 02 3F 00
				29 01 00 00 00 00 02 40 02
				29 01 00 00 00 00 02 41 01
				29 01 00 00 00 00 02 42 02
				29 01 00 00 00 00 02 43 03
				29 01 00 00 00 00 02 44 02
				29 01 00 00 00 00 02 45 05
				29 01 00 00 00 00 02 46 02
				29 01 00 00 00 00 02 47 0C
				29 01 00 00 00 00 02 48 02
				29 01 00 00 00 00 02 49 13
				29 01 00 00 00 00 02 4A 02
				29 01 00 00 00 00 02 4B 20
				29 01 00 00 00 00 02 4C 02
				29 01 00 00 00 00 02 4D 2E
				29 01 00 00 00 00 02 4E 02
				29 01 00 00 00 00 02 4F 4A
				29 01 00 00 00 00 02 50 02
				29 01 00 00 00 00 02 51 68
				29 01 00 00 00 00 02 52 02
				29 01 00 00 00 00 02 53 69
				29 01 00 00 00 00 02 54 02
				29 01 00 00 00 00 02 55 8D
				29 01 00 00 00 00 02 56 02
				29 01 00 00 00 00 02 58 BD
				29 01 00 00 00 00 02 59 02
				29 01 00 00 00 00 02 5A DF
				29 01 00 00 00 00 02 5B 03
				29 01 00 00 00 00 02 5C 0B
				29 01 00 00 00 00 02 5D 03
				29 01 00 00 00 00 02 5E 22
				29 01 00 00 00 00 02 5F 03
				29 01 00 00 00 00 02 60 23
				29 01 00 00 00 00 02 61 03
				29 01 00 00 00 00 02 62 40
				29 01 00 00 00 00 02 63 03
				29 01 00 00 00 00 02 64 5D
				29 01 00 00 00 00 02 65 03
				29 01 00 00 00 00 02 66 7A
				29 01 00 00 00 00 02 67 03
				29 01 00 00 00 00 02 68 97
				29 01 00 00 00 00 02 69 03
				29 01 00 00 00 00 02 6A B4
				29 01 00 00 00 00 02 6B 03
				29 01 00 00 00 00 02 6C B8
				29 01 00 00 00 00 02 6D 03
				29 01 00 00 00 00 02 6E D7
				29 01 00 00 00 00 02 6F 03
				29 01 00 00 00 00 02 70 EC
				29 01 00 00 00 00 02 71 02
				29 01 00 00 00 00 02 72 27
				29 01 00 00 00 00 02 73 02
				29 01 00 00 00 00 02 74 28
				29 01 00 00 00 00 02 75 02
				29 01 00 00 00 00 02 76 29
				29 01 00 00 00 00 02 77 02
				29 01 00 00 00 00 02 78 2A
				29 01 00 00 00 00 02 79 02
				29 01 00 00 00 00 02 7A 2C
				29 01 00 00 00 00 02 7B 02
				29 01 00 00 00 00 02 7C 2D
				29 01 00 00 00 00 02 7D 02
				29 01 00 00 00 00 02 7E 2E
				29 01 00 00 00 00 02 7F 02
				29 01 00 00 00 00 02 80 30
				29 01 00 00 00 00 02 81 02
				29 01 00 00 00 00 02 82 31
				29 01 00 00 00 00 02 83 02
				29 01 00 00 00 00 02 84 37
				29 01 00 00 00 00 02 85 02
				29 01 00 00 00 00 02 86 3C
				29 01 00 00 00 00 02 87 02
				29 01 00 00 00 00 02 88 46
				29 01 00 00 00 00 02 89 02
				29 01 00 00 00 00 02 8A 51
				29 01 00 00 00 00 02 8B 02
				29 01 00 00 00 00 02 8C 6A
				29 01 00 00 00 00 02 8D 02
				29 01 00 00 00 00 02 8E 86
				29 01 00 00 00 00 02 8F 02
				29 01 00 00 00 00 02 90 88
				29 01 00 00 00 00 02 91 02
				29 01 00 00 00 00 02 92 AC
				29 01 00 00 00 00 02 93 02
				29 01 00 00 00 00 02 94 E1
				29 01 00 00 00 00 02 95 03
				29 01 00 00 00 00 02 96 07
				29 01 00 00 00 00 02 97 03
				29 01 00 00 00 00 02 98 50
				29 01 00 00 00 00 02 99 03
				29 01 00 00 00 00 02 9A C1
				29 01 00 00 00 00 02 9B 03
				29 01 00 00 00 00 02 9C E5
				29 01 00 00 00 00 02 9D 03
				29 01 00 00 00 00 02 9E E8
				29 01 00 00 00 00 02 9F 03
				29 01 00 00 00 00 02 A0 EB
				29 01 00 00 00 00 02 A2 03
				29 01 00 00 00 00 02 A3 EE
				29 01 00 00 00 00 02 A4 03
				29 01 00 00 00 00 02 A5 F1
				29 01 00 00 00 00 02 A6 03
				29 01 00 00 00 00 02 A7 F5
				29 01 00 00 00 00 02 A9 03
				29 01 00 00 00 00 02 AA F6
				29 01 00 00 00 00 02 AB 03
				29 01 00 00 00 00 02 AC FB
				29 01 00 00 00 00 02 AD 03
				29 01 00 00 00 00 02 AE FC
				29 01 00 00 00 00 02 AF 02
				29 01 00 00 00 00 02 B0 27
				29 01 00 00 00 00 02 B1 02
				29 01 00 00 00 00 02 B2 28
				29 01 00 00 00 00 02 B3 02
				29 01 00 00 00 00 02 B4 29
				29 01 00 00 00 00 02 B5 02
				29 01 00 00 00 00 02 B6 2A
				29 01 00 00 00 00 02 B7 02
				29 01 00 00 00 00 02 B8 2C
				29 01 00 00 00 00 02 B9 02
				29 01 00 00 00 00 02 BA 2D
				29 01 00 00 00 00 02 BB 02
				29 01 00 00 00 00 02 BC 2E
				29 01 00 00 00 00 02 BD 02
				29 01 00 00 00 00 02 BE 30
				29 01 00 00 00 00 02 BF 02
				29 01 00 00 00 00 02 C0 31
				29 01 00 00 00 00 02 C1 02
				29 01 00 00 00 00 02 C2 37
				29 01 00 00 00 00 02 C3 02
				29 01 00 00 00 00 02 C4 3C
				29 01 00 00 00 00 02 C5 02
				29 01 00 00 00 00 02 C6 46
				29 01 00 00 00 00 02 C7 02
				29 01 00 00 00 00 02 C8 51
				29 01 00 00 00 00 02 C9 02
				29 01 00 00 00 00 02 CA 6A
				29 01 00 00 00 00 02 CB 02
				29 01 00 00 00 00 02 CC 86
				29 01 00 00 00 00 02 CD 02
				29 01 00 00 00 00 02 CE 88
				29 01 00 00 00 00 02 CF 02
				29 01 00 00 00 00 02 D0 AC
				29 01 00 00 00 00 02 D1 02
				29 01 00 00 00 00 02 D2 E1
				29 01 00 00 00 00 02 D3 03
				29 01 00 00 00 00 02 D4 07
				29 01 00 00 00 00 02 D5 03
				29 01 00 00 00 00 02 D6 50
				29 01 00 00 00 00 02 D7 03
				29 01 00 00 00 00 02 D8 C1
				29 01 00 00 00 00 02 D9 03
				29 01 00 00 00 00 02 DA E5
				29 01 00 00 00 00 02 DB 03
				29 01 00 00 00 00 02 DC E8
				29 01 00 00 00 00 02 DD 03
				29 01 00 00 00 00 02 DE EB
				29 01 00 00 00 00 02 DF 03
				29 01 00 00 00 00 02 E0 EE
				29 01 00 00 00 00 02 E1 03
				29 01 00 00 00 00 02 E2 F1
				29 01 00 00 00 00 02 E3 03
				29 01 00 00 00 00 02 E4 F5
				29 01 00 00 00 00 02 E5 03
				29 01 00 00 00 00 02 E6 F6
				29 01 00 00 00 00 02 E7 03
				29 01 00 00 00 00 02 E8 FB
				29 01 00 00 00 00 02 E9 03
				29 01 00 00 00 00 02 EA FC];

		qcom,mdss-dsi-on-command-state = "dsi_lp_mode";
		qcom,mdss-dsi-off-command-state = "dsi_hs_mode";
		fih,mdss-dsi-color-command-state = "dsi_lp_mode";
		qcom,mdss-dsi-h-sync-pulse = <1>;
		qcom,mdss-dsi-traffic-mode = "burst_mode";
		qcom,mdss-dsi-lane-map = <0>;
		qcom,mdss-dsi-bllp-eof-power-mode;
		qcom,mdss-dsi-bllp-power-mode;
		qcom,mdss-dsi-lane-0-state;
		qcom,mdss-dsi-lane-1-state;
		qcom,mdss-dsi-lane-2-state;
		qcom,mdss-dsi-lane-3-state;
		/* command mode*/
		qcom,mdss-dsi-te-pin-select = <1>;
		qcom,mdss-dsi-te-v-sync-rd-ptr-irq-line = <0x2c>;
		qcom,mdss-dsi-te-v-sync-continue-lines = <0x3c>;
		qcom,mdss-dsi-te-dcs-command = <1>;
		qcom,mdss-dsi-te-check-enable;
		qcom,mdss-dsi-te-using-te-pin;
		/* command mode */
		qcom,mdss-dsi-panel-timings = [E7 36 24 00 66 6A 2A 3A 2D 03 04 00];
		qcom,mdss-dsi-t-clk-post = <0x03>;
		qcom,mdss-dsi-t-clk-pre = <0x2B>;
		qcom,mdss-dsi-bl-min-level = <1>;
		qcom,mdss-dsi-bl-max-level = <255>;
		qcom,mdss-dsi-dma-trigger = <0x04>;
		qcom,mdss-dsi-mdp-trigger = <0x0>;
		qcom,mdss-dsi-bl-pmic-control-type = "bl_i2c_lm3630";
		qcom,mdss-dsi-bias-p-en-gpio = <&msmgpio 129 0>;
		qcom,mdss-dsi-bias-n-en-gpio = <&msmgpio 130 0>;
		qcom,mdss-dsi-reset-sequence = <0 11>, <1 11>, <0 1>, <1 11>;
		qcom,mdss-pan-physical-width-dimension = <68>;	/* 68.04mm */
		qcom,mdss-pan-physical-height-dimension = <121>;	/* 120.96mm */
	};
};
