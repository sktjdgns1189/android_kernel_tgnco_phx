&soc {
        /* controller */
        i2c_3: i2c@f9964000 { /* BLSP#8 */
                cell-index = <3>;
                compatible = "qcom,i2c-qup";
                reg = <0xf9964000 0x1000>;
                #address-cells = <1>;
                #size-cells = <0>;
                reg-names = "qup_phys_addr";
                interrupts = <0 102 0>;
                interrupt-names = "qup_err_intr";
                qcom,i2c-bus-freq = <100000>;
                qcom,i2c-src-freq = <19200000>;
                qcom,scl-gpio = <&msmgpio 48 0>;        /* I2C CLK */
                qcom,sda-gpio = <&msmgpio 47 0>;        /* I2C DAT */
                qcom,master-id = <84>;
        };

        /* device */
        i2c@f9964000 {
		rt4501@22 {
			compatible = "rt,rt4501";
			reg = <0x22>;
			rt,en_pin = <&pm8941_gpios 24 0x00>;
			rt,ovp_sel;
			rt,max_curr;
			rt,pwm_en;
			rt,up_ramprate = <0>;
			rt,down_ramprate = <0>;
		};
        };
};
