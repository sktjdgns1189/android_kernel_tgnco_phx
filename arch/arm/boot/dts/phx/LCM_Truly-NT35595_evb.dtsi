&mdss_dsi0 {
	qcom,platform-enable-gpio = <&pm8941_gpios 20 1>;
};

&mdss_fb0 {
	qcom,memory-reservation-size = <0xFF0000>; /* 1088(w)*1920(h)*32(bpp)/8(byte)*2(fb_num) */
};

&mdss_mdp {
	dsi_truly_1080_vid: qcom,mdss_dsi_truly_1080p_video {
		qcom,mdss-dsi-panel-name = "truly 1080p video mode dsi panel";
		qcom,cont-splash-enabled;
		qcom,mdss-dsi-panel-controller = <&mdss_dsi0>;
		qcom,mdss-dsi-panel-type = "dsi_video_mode";
		qcom,mdss-dsi-panel-destination = "display_1";
		qcom,mdss-dsi-panel-framerate = <60>;
		qcom,mdss-dsi-virtual-channel-id = <0>;
		qcom,mdss-dsi-stream = <0>;
		qcom,mdss-dsi-panel-width = <1080>;
		qcom,mdss-dsi-panel-height = <1920>;
		qcom,mdss-dsi-h-front-porch = <100>;
		qcom,mdss-dsi-h-back-porch = <58>;
		qcom,mdss-dsi-h-pulse-width = <10>;
		qcom,mdss-dsi-h-sync-skew = <0>;
		qcom,mdss-dsi-v-back-porch = <4>;
		qcom,mdss-dsi-v-front-porch = <4>;
		qcom,mdss-dsi-v-pulse-width = <2>;
		qcom,mdss-dsi-h-left-border = <0>;
		qcom,mdss-dsi-h-right-border = <0>;
		qcom,mdss-dsi-v-top-border = <0>;
		qcom,mdss-dsi-v-bottom-border = <0>;
		qcom,mdss-dsi-bpp = <24>;
		qcom,mdss-dsi-color-order = <0>;
		qcom,mdss-dsi-underflow-color = <0x0>;
		qcom,mdss-dsi-border-color = <0>;
		qcom,mdss-dsi-on-command = [
		29 01 00 00 00 00 02 FF 20
		29 01 00 00 00 00 02 FB 01
		29 01 00 00 00 00 02 00 01
		29 01 00 00 00 00 02 01 55
		29 01 00 00 00 00 02 02 45
		29 01 00 00 00 00 02 03 55
		29 01 00 00 00 00 02 05 50
		29 01 00 00 00 00 02 06 A8
		29 01 00 00 00 00 02 07 B2
		29 01 00 00 00 00 02 08 0C
		29 01 00 00 00 00 02 0B 88
		29 01 00 00 00 00 02 0C 88
		29 01 00 00 00 00 02 0E BF
		29 01 00 00 00 00 02 0F C2
		29 01 00 00 00 00 02 11 1F
		29 01 00 00 00 00 02 12 1F
		29 01 00 00 00 00 02 13 03
		29 01 00 00 00 00 02 14 0A
		29 01 00 00 00 00 02 15 95
		29 01 00 00 00 00 02 16 95
		29 01 00 00 00 00 02 1B 39
		29 01 00 00 00 00 02 1C 39
		29 01 00 00 00 00 02 1D 47
		29 01 00 00 00 00 02 58 05
		29 01 00 00 00 00 02 59 05
		29 01 00 00 00 00 02 5A 05
		29 01 00 00 00 00 02 5B 05
		29 01 00 00 00 00 02 5C 00
		29 01 00 00 00 00 02 5D 00
		29 01 00 00 00 00 02 5E 00
		29 01 00 00 00 00 02 5F 00
		29 01 00 00 00 00 02 6D 44
		29 01 00 00 00 00 02 75 00
		29 01 00 00 00 00 02 76 00
		29 01 00 00 00 00 02 77 00
		29 01 00 00 00 00 02 78 10
		29 01 00 00 00 00 02 79 00
		29 01 00 00 00 00 02 7A 24
		29 01 00 00 00 00 02 7B 00
		29 01 00 00 00 00 02 7C 38
		29 01 00 00 00 00 02 7D 00
		29 01 00 00 00 00 02 7E 4B
		29 01 00 00 00 00 02 7F 00
		29 01 00 00 00 00 02 80 5C
		29 01 00 00 00 00 02 81 00
		29 01 00 00 00 00 02 82 68
		29 01 00 00 00 00 02 83 00
		29 01 00 00 00 00 02 84 75
		29 01 00 00 00 00 02 85 00
		29 01 00 00 00 00 02 86 83
		29 01 00 00 00 00 02 87 00
		29 01 00 00 00 00 02 88 AC
		29 01 00 00 00 00 02 89 00
		29 01 00 00 00 00 02 8A D0
		29 01 00 00 00 00 02 8B 01
		29 01 00 00 00 00 02 8C 0A
		29 01 00 00 00 00 02 8D 01
		29 01 00 00 00 00 02 8E 3C
		29 01 00 00 00 00 02 8F 01
		29 01 00 00 00 00 02 90 90
		29 01 00 00 00 00 02 91 01
		29 01 00 00 00 00 02 92 D9
		29 01 00 00 00 00 02 93 01
		29 01 00 00 00 00 02 94 DB
		29 01 00 00 00 00 02 95 02
		29 01 00 00 00 00 02 96 1D
		29 01 00 00 00 00 02 97 02
		29 01 00 00 00 00 02 98 6D
		29 01 00 00 00 00 02 99 02
		29 01 00 00 00 00 02 9A 9F
		29 01 00 00 00 00 02 9B 02
		29 01 00 00 00 00 02 9C F5
		29 01 00 00 00 00 02 9D 03
		29 01 00 00 00 00 02 9E 1F
		29 01 00 00 00 00 02 9F 03
		29 01 00 00 00 00 02 A0 58
		29 01 00 00 00 00 02 A2 03
		29 01 00 00 00 00 02 A3 64
		29 01 00 00 00 00 02 A4 03
		29 01 00 00 00 00 02 A5 75
		29 01 00 00 00 00 02 A6 03
		29 01 00 00 00 00 02 A7 89
		29 01 00 00 00 00 02 A9 03
		29 01 00 00 00 00 02 AA 99
		29 01 00 00 00 00 02 AB 03
		29 01 00 00 00 00 02 AC AC
		29 01 00 00 00 00 02 AD 03
		29 01 00 00 00 00 02 AE C3
		29 01 00 00 00 00 02 AF 03
		29 01 00 00 00 00 02 B0 DD
		29 01 00 00 00 00 02 B1 03
		29 01 00 00 00 00 02 B2 E8
		29 01 00 00 00 00 02 B3 00
		29 01 00 00 00 00 02 B4 00
		29 01 00 00 00 00 02 B5 00
		29 01 00 00 00 00 02 B6 10
		29 01 00 00 00 00 02 B7 00
		29 01 00 00 00 00 02 B8 24
		29 01 00 00 00 00 02 B9 00
		29 01 00 00 00 00 02 BA 38
		29 01 00 00 00 00 02 BB 00
		29 01 00 00 00 00 02 BC 4B
		29 01 00 00 00 00 02 BD 00
		29 01 00 00 00 00 02 BE 5C
		29 01 00 00 00 00 02 BF 00
		29 01 00 00 00 00 02 C0 68
		29 01 00 00 00 00 02 C1 00
		29 01 00 00 00 00 02 C2 75
		29 01 00 00 00 00 02 C3 00
		29 01 00 00 00 00 02 C4 83
		29 01 00 00 00 00 02 C5 00
		29 01 00 00 00 00 02 C6 AC
		29 01 00 00 00 00 02 C7 00
		29 01 00 00 00 00 02 C8 D0
		29 01 00 00 00 00 02 C9 01
		29 01 00 00 00 00 02 CA 0A
		29 01 00 00 00 00 02 CB 01
		29 01 00 00 00 00 02 CC 3C
		29 01 00 00 00 00 02 CD 01
		29 01 00 00 00 00 02 CE 90
		29 01 00 00 00 00 02 CF 01
		29 01 00 00 00 00 02 D0 D9
		29 01 00 00 00 00 02 D1 01
		29 01 00 00 00 00 02 D2 DB
		29 01 00 00 00 00 02 D3 02
		29 01 00 00 00 00 02 D4 1D
		29 01 00 00 00 00 02 D5 02
		29 01 00 00 00 00 02 D6 6D
		29 01 00 00 00 00 02 D7 02
		29 01 00 00 00 00 02 D8 9F
		29 01 00 00 00 00 02 D9 02
		29 01 00 00 00 00 02 DA F5
		29 01 00 00 00 00 02 DB 03
		29 01 00 00 00 00 02 DC 1F
		29 01 00 00 00 00 02 DD 03
		29 01 00 00 00 00 02 DE 58
		29 01 00 00 00 00 02 DF 03
		29 01 00 00 00 00 02 E0 64
		29 01 00 00 00 00 02 E1 03
		29 01 00 00 00 00 02 E2 75
		29 01 00 00 00 00 02 E3 03
		29 01 00 00 00 00 02 E4 89
		29 01 00 00 00 00 02 E5 03
		29 01 00 00 00 00 02 E6 99
		29 01 00 00 00 00 02 E7 03
		29 01 00 00 00 00 02 E8 AC
		29 01 00 00 00 00 02 E9 03
		29 01 00 00 00 00 02 EA C3
		29 01 00 00 00 00 02 EB 03
		29 01 00 00 00 00 02 EC DD
		29 01 00 00 00 00 02 ED 03
		29 01 00 00 00 00 02 EE E8
		29 01 00 00 00 00 02 EF 00
		29 01 00 00 00 00 02 F0 00
		29 01 00 00 00 00 02 F1 00
		29 01 00 00 00 00 02 F2 10
		29 01 00 00 00 00 02 F3 00
		29 01 00 00 00 00 02 F4 24
		29 01 00 00 00 00 02 F5 00
		29 01 00 00 00 00 02 F6 38
		29 01 00 00 00 00 02 F7 00
		29 01 00 00 00 00 02 F8 4B
		29 01 00 00 00 00 02 F9 00
		29 01 00 00 00 00 02 FA 5C
		29 01 00 00 00 00 02 FF 21
		29 01 00 00 00 00 02 FB 01
		29 01 00 00 00 00 02 00 00
		29 01 00 00 00 00 02 01 68
		29 01 00 00 00 00 02 02 00
		29 01 00 00 00 00 02 03 75
		29 01 00 00 00 00 02 04 00
		29 01 00 00 00 00 02 05 83
		29 01 00 00 00 00 02 06 00
		29 01 00 00 00 00 02 07 AC
		29 01 00 00 00 00 02 08 00
		29 01 00 00 00 00 02 09 D0
		29 01 00 00 00 00 02 0A 01
		29 01 00 00 00 00 02 0B 0A
		29 01 00 00 00 00 02 0C 01
		29 01 00 00 00 00 02 0D 3C
		29 01 00 00 00 00 02 0E 01
		29 01 00 00 00 00 02 0F 90
		29 01 00 00 00 00 02 10 01
		29 01 00 00 00 00 02 11 D9
		29 01 00 00 00 00 02 12 01
		29 01 00 00 00 00 02 13 DB
		29 01 00 00 00 00 02 14 02
		29 01 00 00 00 00 02 15 1D
		29 01 00 00 00 00 02 16 02
		29 01 00 00 00 00 02 17 6D
		29 01 00 00 00 00 02 18 02
		29 01 00 00 00 00 02 19 9F
		29 01 00 00 00 00 02 1A 02
		29 01 00 00 00 00 02 1B F5
		29 01 00 00 00 00 02 1C 03
		29 01 00 00 00 00 02 1D 1F
		29 01 00 00 00 00 02 1E 03
		29 01 00 00 00 00 02 1F 58
		29 01 00 00 00 00 02 20 03
		29 01 00 00 00 00 02 21 64
		29 01 00 00 00 00 02 22 03
		29 01 00 00 00 00 02 23 75
		29 01 00 00 00 00 02 24 03
		29 01 00 00 00 00 02 25 89
		29 01 00 00 00 00 02 26 03
		29 01 00 00 00 00 02 27 99
		29 01 00 00 00 00 02 28 03
		29 01 00 00 00 00 02 29 AC
		29 01 00 00 00 00 02 2A 03
		29 01 00 00 00 00 02 2B C3
		29 01 00 00 00 00 02 2D 03
		29 01 00 00 00 00 02 2F DD
		29 01 00 00 00 00 02 30 03
		29 01 00 00 00 00 02 31 E8
		29 01 00 00 00 00 02 32 00
		29 01 00 00 00 00 02 33 00
		29 01 00 00 00 00 02 34 00
		29 01 00 00 00 00 02 35 10
		29 01 00 00 00 00 02 36 00
		29 01 00 00 00 00 02 37 24
		29 01 00 00 00 00 02 38 00
		29 01 00 00 00 00 02 39 38
		29 01 00 00 00 00 02 3A 00
		29 01 00 00 00 00 02 3B 4B
		29 01 00 00 00 00 02 3D 00
		29 01 00 00 00 00 02 3F 5C
		29 01 00 00 00 00 02 40 00
		29 01 00 00 00 00 02 41 68
		29 01 00 00 00 00 02 42 00
		29 01 00 00 00 00 02 43 75
		29 01 00 00 00 00 02 44 00
		29 01 00 00 00 00 02 45 83
		29 01 00 00 00 00 02 46 00
		29 01 00 00 00 00 02 47 AC
		29 01 00 00 00 00 02 48 00
		29 01 00 00 00 00 02 49 D0
		29 01 00 00 00 00 02 4A 01
		29 01 00 00 00 00 02 4B 0A
		29 01 00 00 00 00 02 4C 01
		29 01 00 00 00 00 02 4D 3C
		29 01 00 00 00 00 02 4E 01
		29 01 00 00 00 00 02 4F 90
		29 01 00 00 00 00 02 50 01
		29 01 00 00 00 00 02 51 D9
		29 01 00 00 00 00 02 52 01
		29 01 00 00 00 00 02 53 DB
		29 01 00 00 00 00 02 54 02
		29 01 00 00 00 00 02 55 1D
		29 01 00 00 00 00 02 56 02
		29 01 00 00 00 00 02 58 6D
		29 01 00 00 00 00 02 59 02
		29 01 00 00 00 00 02 5A 9F
		29 01 00 00 00 00 02 5B 02
		29 01 00 00 00 00 02 5C F5
		29 01 00 00 00 00 02 5D 03
		29 01 00 00 00 00 02 5E 1F
		29 01 00 00 00 00 02 5F 03
		29 01 00 00 00 00 02 60 58
		29 01 00 00 00 00 02 61 03
		29 01 00 00 00 00 02 62 64
		29 01 00 00 00 00 02 63 03
		29 01 00 00 00 00 02 64 75
		29 01 00 00 00 00 02 65 03
		29 01 00 00 00 00 02 66 89
		29 01 00 00 00 00 02 67 03
		29 01 00 00 00 00 02 68 99
		29 01 00 00 00 00 02 69 03
		29 01 00 00 00 00 02 6A AC
		29 01 00 00 00 00 02 6B 03
		29 01 00 00 00 00 02 6C C3
		29 01 00 00 00 00 02 6D 03
		29 01 00 00 00 00 02 6E DD
		29 01 00 00 00 00 02 6F 03
		29 01 00 00 00 00 02 70 E8
		29 01 00 00 00 00 02 71 00
		29 01 00 00 00 00 02 72 00
		29 01 00 00 00 00 02 73 00
		29 01 00 00 00 00 02 74 10
		29 01 00 00 00 00 02 75 00
		29 01 00 00 00 00 02 76 24
		29 01 00 00 00 00 02 77 00
		29 01 00 00 00 00 02 78 38
		29 01 00 00 00 00 02 79 00
		29 01 00 00 00 00 02 7A 4B
		29 01 00 00 00 00 02 7B 00
		29 01 00 00 00 00 02 7C 5C
		29 01 00 00 00 00 02 7D 00
		29 01 00 00 00 00 02 7E 68
		29 01 00 00 00 00 02 7F 00
		29 01 00 00 00 00 02 80 75
		29 01 00 00 00 00 02 81 00
		29 01 00 00 00 00 02 82 83
		29 01 00 00 00 00 02 83 00
		29 01 00 00 00 00 02 84 AC
		29 01 00 00 00 00 02 85 00
		29 01 00 00 00 00 02 86 D0
		29 01 00 00 00 00 02 87 01
		29 01 00 00 00 00 02 88 0A
		29 01 00 00 00 00 02 89 01
		29 01 00 00 00 00 02 8A 3C
		29 01 00 00 00 00 02 8B 01
		29 01 00 00 00 00 02 8C 90
		29 01 00 00 00 00 02 8D 01
		29 01 00 00 00 00 02 8E D9
		29 01 00 00 00 00 02 8F 01
		29 01 00 00 00 00 02 90 DB
		29 01 00 00 00 00 02 91 02
		29 01 00 00 00 00 02 92 1D
		29 01 00 00 00 00 02 93 02
		29 01 00 00 00 00 02 94 6D
		29 01 00 00 00 00 02 95 02
		29 01 00 00 00 00 02 96 9F
		29 01 00 00 00 00 02 97 02
		29 01 00 00 00 00 02 98 F5
		29 01 00 00 00 00 02 99 03
		29 01 00 00 00 00 02 9A 1F
		29 01 00 00 00 00 02 9B 03
		29 01 00 00 00 00 02 9C 58
		29 01 00 00 00 00 02 9D 03
		29 01 00 00 00 00 02 9E 64
		29 01 00 00 00 00 02 9F 03
		29 01 00 00 00 00 02 A0 75
		29 01 00 00 00 00 02 A2 03
		29 01 00 00 00 00 02 A3 89
		29 01 00 00 00 00 02 A4 03
		29 01 00 00 00 00 02 A5 99
		29 01 00 00 00 00 02 A6 03
		29 01 00 00 00 00 02 A7 AC
		29 01 00 00 00 00 02 A9 03
		29 01 00 00 00 00 02 AA C3
		29 01 00 00 00 00 02 AB 03
		29 01 00 00 00 00 02 AC DD
		29 01 00 00 00 00 02 AD 03
		29 01 00 00 00 00 02 AE E8
		29 01 00 00 00 00 02 AF 00
		29 01 00 00 00 00 02 B0 00
		29 01 00 00 00 00 02 B1 00
		29 01 00 00 00 00 02 B2 10
		29 01 00 00 00 00 02 B3 00
		29 01 00 00 00 00 02 B4 24
		29 01 00 00 00 00 02 B5 00
		29 01 00 00 00 00 02 B6 38
		29 01 00 00 00 00 02 B7 00
		29 01 00 00 00 00 02 B8 4B
		29 01 00 00 00 00 02 B9 00
		29 01 00 00 00 00 02 BA 5C
		29 01 00 00 00 00 02 BB 00
		29 01 00 00 00 00 02 BC 68
		29 01 00 00 00 00 02 BD 00
		29 01 00 00 00 00 02 BE 75
		29 01 00 00 00 00 02 BF 00
		29 01 00 00 00 00 02 C0 83
		29 01 00 00 00 00 02 C1 00
		29 01 00 00 00 00 02 C2 AC
		29 01 00 00 00 00 02 C3 00
		29 01 00 00 00 00 02 C4 D0
		29 01 00 00 00 00 02 C5 01
		29 01 00 00 00 00 02 C6 0A
		29 01 00 00 00 00 02 C7 01
		29 01 00 00 00 00 02 C8 3C
		29 01 00 00 00 00 02 C9 01
		29 01 00 00 00 00 02 CA 90
		29 01 00 00 00 00 02 CB 01
		29 01 00 00 00 00 02 CC D9
		29 01 00 00 00 00 02 CD 01
		29 01 00 00 00 00 02 CE DB
		29 01 00 00 00 00 02 CF 02
		29 01 00 00 00 00 02 D0 1D
		29 01 00 00 00 00 02 D1 02
		29 01 00 00 00 00 02 D2 6D
		29 01 00 00 00 00 02 D3 02
		29 01 00 00 00 00 02 D4 9F
		29 01 00 00 00 00 02 D5 02
		29 01 00 00 00 00 02 D6 F5
		29 01 00 00 00 00 02 D7 03
		29 01 00 00 00 00 02 D8 1F
		29 01 00 00 00 00 02 D9 03
		29 01 00 00 00 00 02 DA 58
		29 01 00 00 00 00 02 DB 03
		29 01 00 00 00 00 02 DC 64
		29 01 00 00 00 00 02 DD 03
		29 01 00 00 00 00 02 DE 75
		29 01 00 00 00 00 02 DF 03
		29 01 00 00 00 00 02 E0 89
		29 01 00 00 00 00 02 E1 03
		29 01 00 00 00 00 02 E2 99
		29 01 00 00 00 00 02 E3 03
		29 01 00 00 00 00 02 E4 AC
		29 01 00 00 00 00 02 E5 03
		29 01 00 00 00 00 02 E6 C3
		29 01 00 00 00 00 02 E7 03
		29 01 00 00 00 00 02 E8 DD
		29 01 00 00 00 00 02 E9 03
		29 01 00 00 00 00 02 EA E8
		29 01 00 00 00 00 02 FF 24
		29 01 00 00 00 00 02 FB 01
		29 01 00 00 00 00 02 00 0F
		29 01 00 00 00 00 02 01 00
		29 01 00 00 00 00 02 02 00
		29 01 00 00 00 00 02 03 00
		29 01 00 00 00 00 02 04 0B
		29 01 00 00 00 00 02 05 0C
		29 01 00 00 00 00 02 06 00
		29 01 00 00 00 00 02 07 00
		29 01 00 00 00 00 02 08 00
		29 01 00 00 00 00 02 09 00
		29 01 00 00 00 00 02 0A 03
		29 01 00 00 00 00 02 0B 04
		29 01 00 00 00 00 02 0C 01
		29 01 00 00 00 00 02 0D 13
		29 01 00 00 00 00 02 0E 15
		29 01 00 00 00 00 02 0F 17
		29 01 00 00 00 00 02 10 0F
		29 01 00 00 00 00 02 11 00
		29 01 00 00 00 00 02 12 00
		29 01 00 00 00 00 02 13 00
		29 01 00 00 00 00 02 14 0B
		29 01 00 00 00 00 02 15 0C
		29 01 00 00 00 00 02 16 00
		29 01 00 00 00 00 02 17 00
		29 01 00 00 00 00 02 18 00
		29 01 00 00 00 00 02 19 00
		29 01 00 00 00 00 02 1A 03
		29 01 00 00 00 00 02 1B 04
		29 01 00 00 00 00 02 1C 01
		29 01 00 00 00 00 02 1D 13
		29 01 00 00 00 00 02 1E 15
		29 01 00 00 00 00 02 1F 17
		29 01 00 00 00 00 02 20 09
		29 01 00 00 00 00 02 21 01
		29 01 00 00 00 00 02 22 00
		29 01 00 00 00 00 02 23 00
		29 01 00 00 00 00 02 24 00
		29 01 00 00 00 00 02 25 6D
		29 01 00 00 00 00 02 26 00
		29 01 00 00 00 00 02 27 00
		29 01 00 00 00 00 02 29 58
		29 01 00 00 00 00 02 2A 16
		29 01 00 00 00 00 02 2F 02
		29 01 00 00 00 00 02 30 04
		29 01 00 00 00 00 02 31 49
		29 01 00 00 00 00 02 32 23
		29 01 00 00 00 00 02 33 01
		29 01 00 00 00 00 02 34 00
		29 01 00 00 00 00 02 35 69
		29 01 00 00 00 00 02 36 00
		29 01 00 00 00 00 02 37 2D
		29 01 00 00 00 00 02 38 08
		29 01 00 00 00 00 02 39 00
		29 01 00 00 00 00 02 3A 69
		29 01 00 00 00 00 02 5B 00
		29 01 00 00 00 00 02 5F 75
		29 01 00 00 00 00 02 63 00
		29 01 00 00 00 00 02 67 04
		29 01 00 00 00 00 02 72 00
		29 01 00 00 00 00 02 74 10
		29 01 00 00 00 00 02 75 19
		29 01 00 00 00 00 02 76 06
		29 01 00 00 00 00 02 77 03
		29 01 00 00 00 00 02 78 00
		29 01 00 00 00 00 02 79 00
		29 01 00 00 00 00 02 7B 80
		29 01 00 00 00 00 02 7C D8
		29 01 00 00 00 00 02 7D 60
		29 01 00 00 00 00 02 7E 10
		29 01 00 00 00 00 02 7F 19
		29 01 00 00 00 00 02 80 00
		29 01 00 00 00 00 02 81 06
		29 01 00 00 00 00 02 82 03
		29 01 00 00 00 00 02 83 00
		29 01 00 00 00 00 02 84 03
		29 01 00 00 00 00 02 85 07
		29 01 00 00 00 00 02 86 1B
		29 01 00 00 00 00 02 87 39
		29 01 00 00 00 00 02 88 1B
		29 01 00 00 00 00 02 89 39
		29 01 00 00 00 00 02 8A 33
		29 01 00 00 00 00 02 8B F4
		29 01 00 00 00 00 02 8C 01
		29 01 00 00 00 00 02 92 79
		29 01 00 00 00 00 02 93 04
		29 01 00 00 00 00 02 94 04
		29 01 00 00 00 00 02 98 00
		29 01 00 00 00 00 02 99 33
		29 01 00 00 00 00 02 9B 0F
		29 01 00 00 00 00 02 9D B0
		29 01 00 00 00 00 02 DE FF
		29 01 00 00 00 00 02 DF 82
		29 01 00 00 00 00 02 B3 28
		29 01 00 00 00 00 02 B4 05
		29 01 00 00 00 00 02 B5 10
		29 01 00 00 00 00 02 C4 24
		29 01 00 00 00 00 02 C5 30
		29 01 00 00 00 00 02 C6 00
		29 01 00 00 00 00 02 FF 23
		29 01 00 00 00 00 02 FB 01
		29 01 00 00 00 00 02 07 20
		29 01 00 00 00 00 02 08 05
		29 01 00 00 00 00 02 46 18
		29 01 00 00 00 00 02 FF 10
		39 01 00 00 00 00 06 3B 03 0A 0A 0A 0A
		15 01 00 00 00 00 02 35 00
		15 01 00 00 00 00 02 51 50
		15 01 00 00 00 00 02 53 24
		15 01 00 00 00 00 02 55 00
		15 01 00 00 00 00 02 BB 03 /* 10: command mode, 03:video mode */
		05 01 00 00 78 00 02 11 00
		05 01 00 00 00 00 02 29 00];
		qcom,mdss-dsi-off-command = [05 01 00 00 14 00 02 28 00
				05 01 00 00 32 00 02 10 00];
		qcom,mdss-dsi-on-command-state = "dsi_lp_mode";
		qcom,mdss-dsi-off-command-state = "dsi_hs_mode";
		qcom,mdss-dsi-h-sync-pulse = <0>;
		qcom,mdss-dsi-traffic-mode = <1>;
		qcom,mdss-dsi-lane-map = <0>;
		qcom,mdss-dsi-bllp-eof-power-mode;
		qcom,mdss-dsi-bllp-power-mode;
		qcom,mdss-dsi-lane-0-state;
		qcom,mdss-dsi-lane-1-state;
		qcom,mdss-dsi-lane-2-state;
		qcom,mdss-dsi-lane-3-state;
		qcom,mdss-dsi-panel-timings = [b0 23 1b 00 94 93 1e 25 15 03 04 00];
		qcom,mdss-dsi-t-clk-post = <0x05>;
		qcom,mdss-dsi-t-clk-pre = <0x2D>;
		qcom,mdss-dsi-bl-min-level = <1>;
		qcom,mdss-dsi-bl-max-level = <255>;
		qcom,mdss-dsi-dma-trigger = <0x04>;
		qcom,mdss-dsi-mdp-trigger = <0x04>;
		qcom,mdss-dsi-bl-pmic-control-type = "bl_i2c_lm3630";
		qcom,mdss-dsi-bias-p-en-gpio = <&msmgpio 129 0>;
		qcom,mdss-dsi-bias-n-en-gpio = <&msmgpio 130 0>;
		qcom,mdss-dsi-reset-sequence = <1 10>, <0 20>, <1 15>;
	};
};
