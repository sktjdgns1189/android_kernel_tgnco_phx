/* Copyright (c) 2013, The Linux Foundation. All rights reserved.
 *
 * This program is free software; you can redistribute it and/or modify
 * it under the terms of the GNU General Public License version 2 and
 * only version 2 as published by the Free Software Foundation.
 *
 * This program is distributed in the hope that it will be useful,
 * but WITHOUT ANY WARRANTY; without even the implied warranty of
 * MERCHANTABILITY or FITNESS FOR A PARTICULAR PURPOSE.  See the
 * GNU General Public License for more details.
 */

qcom,atl-2950mah {
	qcom,fcc-mah = <2900>;
	qcom,default-rbatt-mohm = <110>;
	qcom,max-voltage-uv = <4350000>;
	qcom,rbatt-capacitive-mohm = <0>;
	qcom,v-cutoff-uv = <3400000>;
	qcom,chg-term-ua = <100000>;
	qcom,batt-id-kohm = <100>;

	qcom,fcc-temp-lut {
		qcom,lut-col-legend = <(-10) 0 25 40 55>;
		qcom,lut-data = <2828 2898 2900 2900 2900>;
	};

	qcom,pc-temp-ocv-lut {
		qcom,lut-col-legend = <(-10) 0 25 40 55>;
		qcom,lut-row-legend = <100 95 90 85 80>,
				<75 70 65 60 55>,
				<50 45 40 35 30>,
				<25 20 15 10 9>,
				<8 7 6 5 4>,
				<3 2 1 0>;
		qcom,lut-data = <4327 4315 4313 4308 4304>,
				<4235 4245 4250 4246 4242>,
				<4163 4186 4193 4189 4184>,
				<4100 4131 4138 4134 4130>,
				<4040 4079 4086 4083 4078>,
				<3978 4026 4039 4035 4031>,
				<3934 3969 3993 3991 3987>,
				<3894 3926 3953 3951 3947>,
				<3859 3886 3912 3912 3909>,
				<3830 3852 3864 3863 3860>,
				<3808 3825 3832 3831 3828>,
				<3793 3803 3810 3808 3806>,
				<3781 3785 3792 3790 3788>,
				<3770 3773 3777 3776 3773>,
				<3758 3764 3765 3763 3760>,
				<3743 3752 3752 3742 3731>,
				<3724 3734 3732 3722 3712>,
				<3701 3707 3707 3698 3687>,
				<3674 3676 3673 3665 3657>,
				<3670 3670 3670 3663 3654>,
				<3663 3664 3668 3660 3651>,
				<3656 3658 3665 3658 3648>,
				<3646 3649 3661 3653 3644>,
				<3634 3637 3653 3646 3635>,
				<3625 3618 3639 3629 3613>,
				<3618 3585 3609 3597 3576>,
				<3612 3534 3562 3548 3523>,
				<3607 3462 3498 3482 3453>,
				<3602 3375 3405 3386 3348>;
	};

	qcom,rbatt-sf-lut {
		qcom,lut-col-legend = <(-10) 0 25 40 55>;
		qcom,lut-row-legend = <100 95 90 85 80>,
				<75 70 65 60 55>,
				<50 45 40 35 30>,
				<25 20 15 10 9>,
				<8 7 6 5 4>,
				<3 2 1 0>;
		qcom,lut-data = <599 447 157 146 136>,
				<1129 447 157 125 115>,
				<1101 455 160 128 113>,
				<1068 465 166 129 116>,
				<1047 474 167 132 119>,
				<993 484 174 138 121>,
				<987 458 184 142 125>,
				<979 445 199 149 128>,
				<982 433 206 162 138>,
				<999 423 172 139 121>,
				<1024 427 159 129 115>,
				<1068 434 160 126 118>,
				<1135 435 160 129 119>,
				<1211 455 167 138 123>,
				<1308 477 172 142 129>,
				<1441 511 167 129 113>,
				<1626 555 162 129 118>,
				<1878 620 170 130 119>,
				<2211 773 177 133 119>,
				<2143 776 174 135 121>,
				<2224 810 179 133 121>,
				<2328 865 186 140 121>,
				<2447 932 193 142 128>,
				<2580 1016 200 148 130>,
				<2617 1111 206 148 123>,
				<2628 1231 213 146 128>,
				<2604 1391 217 152 132>,
				<2583 1611 233 159 138>,
				<2562 2004 261 172 153>;
	};
};
