&mdss_dsi0 {
	qcom,platform-enable-gpio = <&pm8941_gpios 20 1>;
};

&mdss_fb0 {
	qcom,memory-reservation-size = <0xFF0000>; /* 1088(w)*1920(h)*32(bpp)/8(byte)*2(fb_num) */
};

&mdss_mdp {
	dsi_nt35595_innolux_1080_cmd: qcom,mdss_dsi_nt35595_innolux_1080p_cmd {
		qcom,mdss-dsi-panel-name = "nt35595 innolux 1080p command mode dsi panel";
		qcom,mdss-dsi-panel-controller = <&mdss_dsi0>;
		qcom,mdss-dsi-panel-type = "dsi_cmd_mode";
		qcom,mdss-dsi-panel-destination = "display_1";
		qcom,cont-splash-enabled;
		qcom,mdss-dsi-panel-framerate = <60>;
		qcom,mdss-dsi-virtual-channel-id = <0>;
		qcom,mdss-dsi-stream = <0>;
		qcom,mdss-dsi-panel-width = <1080>;
		qcom,mdss-dsi-panel-height = <1920>;
		qcom,mdss-dsi-h-front-porch = <32>;
		qcom,mdss-dsi-h-back-porch = <32>;
		qcom,mdss-dsi-h-pulse-width = <8>;
		qcom,mdss-dsi-h-sync-skew = <0>;
		qcom,mdss-dsi-v-back-porch = <9>;
		qcom,mdss-dsi-v-front-porch = <4>;
		qcom,mdss-dsi-v-pulse-width = <2>;
		qcom,mdss-dsi-h-left-border = <0>;
		qcom,mdss-dsi-h-right-border = <0>;
		qcom,mdss-dsi-v-top-border = <0>;
		qcom,mdss-dsi-v-bottom-border = <0>;
		qcom,mdss-dsi-bpp = <24>;
		qcom,mdss-dsi-color-order = <0>;
		qcom,mdss-dsi-underflow-color = <0xff>;
		qcom,mdss-dsi-border-color = <0>;

		qcom,mdss-dsi-on-pre-command = [
				29 01 00 00 01 00 02 FF 22
				29 01 00 00 00 00 02 FB 01
				29 01 00 00 00 00 02 00 00 	/* parameter to adjust saturation > 0.98 */
				29 01 00 00 00 00 02 01 04 	/* parameter to adjust saturation 0.95~0.98 */
				29 01 00 00 00 00 02 02 08 	/* parameter to adjust saturation 0.91~0.95 */
				29 01 00 00 00 00 02 03 0C 	/* parameter to adjust saturation 0.88~0.91 */
				29 01 00 00 00 00 02 04 10 	/* parameter to adjust saturation 0.85~0.88 */
				29 01 00 00 00 00 02 05 14 	/* parameter to adjust saturation 0.82~0.85 */
				29 01 00 00 00 00 02 06 18 	/* parameter to adjust saturation 0.79~0.82 */
				29 01 00 00 00 00 02 07 20 	/* parameter to adjust saturation 0.76~0.79 */
				29 01 00 00 00 00 02 08 24 	/* parameter to adjust saturation 0.73~0.76 */
				29 01 00 00 00 00 02 09 28 	/* parameter to adjust saturation 0.7~0.73 */
				29 01 00 00 00 00 02 0A 30 	/* parameter to adjust saturation 0.66~0.7 */
				29 01 00 00 00 00 02 0B 38 	/* parameter to adjust saturation 0.6~0.66 */
				29 01 00 00 00 00 02 0C 38 	/* parameter to adjust saturation 0.54~0.6 */
				29 01 00 00 00 00 02 0D 30 	/* parameter to adjust saturation 0.48~0.54 */
				29 01 00 00 00 00 02 0E 28 	/* parameter to adjust saturation 0.41~0.48 */
				29 01 00 00 00 00 02 0F 20 	/* parameter to adjust saturation 0.35~0.41 */
				29 01 00 00 00 00 02 10 10 	/* parameter to adjust saturation 0.26~0.35 */
				29 01 00 00 00 00 02 11 00 	/* parameter to adjust saturation 0.16~0.26 */
				29 01 00 00 00 00 02 12 00 	/* parameter to adjust saturation 0.07~0.16 */
				29 01 00 00 00 00 02 13 00 	/* parameter to adjust saturation < 0.07 */
				29 01 00 00 00 00 02 32	00	/* parameter to adjust HUE 0~15 degree */
				29 01 00 00 00 00 02 33	00	/* parameter to adjust HUE 15~30 degree */
				29 01 00 00 00 00 02 34	00	/* parameter to adjust HUE 30~45 degree */
				29 01 00 00 00 00 02 35	02	/* parameter to adjust HUE 45~60 degree */
				29 01 00 00 00 00 02 36	04	/* parameter to adjust HUE 60~75 degree */
				29 01 00 00 00 00 02 37	06	/* parameter to adjust HUE 75~90 degree */
				29 01 00 00 00 00 02 38	08	/* parameter to adjust HUE 90~105 degree */
				29 01 00 00 00 00 02 39	0A	/* parameter to adjust HUE 105~120 degree */
				29 01 00 00 00 00 02 3A	0C	/* parameter to adjust HUE 120~135 degree */
				29 01 00 00 00 00 02 3B	0E	/* parameter to adjust HUE 135~150 degree */
				29 01 00 00 00 00 02 3F	10	/* parameter to adjust HUE 150~165 degree */
				29 01 00 00 00 00 02 40	12	/* parameter to adjust HUE 165~180 degree */
				29 01 00 00 00 00 02 41	14	/* parameter to adjust HUE 180~195 degree */
				29 01 00 00 00 00 02 42	14	/* parameter to adjust HUE 195~210 degree */
				29 01 00 00 00 00 02 43	12	/* parameter to adjust HUE 210~225 degree */
				29 01 00 00 00 00 02 44	10	/* parameter to adjust HUE 225~240 degree */
				29 01 00 00 00 00 02 45	0E	/* parameter to adjust HUE 240~255 degree */
				29 01 00 00 00 00 02 46	0C	/* parameter to adjust HUE 255~270 degree */
				29 01 00 00 00 00 02 47	0A	/* parameter to adjust HUE 270~285 degree */
				29 01 00 00 00 00 02 48	08	/* parameter to adjust HUE 285~300 degree */
				29 01 00 00 00 00 02 49	06	/* parameter to adjust HUE 300~315 degree */
				29 01 00 00 00 00 02 4A	04	/* parameter to adjust HUE 315~330 degree */
				29 01 00 00 00 00 02 4B	02	/* parameter to adjust HUE 330~345 degree */
				29 01 00 00 00 00 02 4C	00	/* parameter to adjust HUE 345~360 degree */
				29 01 00 00 00 00 02 4D	00	/* Smart Color Ratio --> CMD1 55h = 0x8x */
				29 01 00 00 00 00 02 4E	08	/* Smart Color Ratio --> CMD1 55h = 0x9x */
				29 01 00 00 00 00 02 4F	10	/* Smart Color Ratio --> CMD1 55h = 0xBx */
				29 01 00 00 00 00 02 50	18	/* Smart Color Ratio --> CMD1 55h = 0x4x */
				29 01 00 00 00 00 02 51	20	/* Smart Color Ratio --> CMD1 55h = 0x5x */
				29 01 00 00 00 00 02 52	28	/* Smart Color Ratio --> CMD1 55h = 0x6x */
				29 01 00 00 00 00 02 1A	00	/* Vivid Color Disable */
				29 01 00 00 00 00 02 53	77	/* Smart Color Enable */
				29 01 00 00 00 00 02 56	00	/* Contrast Disable */
				29 01 00 00 00 00 02 68	00	/* Sharpness Disable */
				29 01 00 00 00 00 02 A2	20	/* EN_Dither */
				29 01 00 00 01 00 02 FF 24	/* CMD2_P4 */
				29 01 00 00 00 00 02 FB 01
				29 01 00 00 00 00 02 20 49	/* Forward: R->L; Backward: L->R */
				29 01 00 00 00 00 02 5B 1A	/* RESET(CTRL1) has pulse(5~6 frame) in power on sequence */
				29 01 00 00 00 00 02 67 06
				29 01 00 00 00 00 02 68 06
				29 01 00 00 00 00 02 7D 10	/* reg 20h, 5Bh, 67h, 68h and 7Dh to fix display blinking issue to override OTP */
				29 01 00 00 01 00 02 FF 23	/* PWM 20kHz +++ */
				29 01 00 00 00 00 02 FB 01
				29 01 00 00 00 00 02 07 00
				29 01 00 00 00 00 02 08 04
				29 01 00 00 00 00 02 46 06	/* PWM 20kHz --- */
				29 01 00 00 00 00 02 FB 01
				29 01 00 00 01 00 02 FF 10
				29 01 00 00 00 00 02 35 00
				29 01 00 00 00 00 02 53 24	/* 53h, Backlight Control: on, dimming function: disable */
				29 01 00 00 00 00 02 55 00	/* 55h, CABC: off, IE : disable */
				29 01 00 00 00 00 02 BB 10
				05 01 00 00 0A 00 02 11 00];

		qcom,mdss-dsi-on-command = [
				05 01 00 00 00 00 02 29 00];

		qcom,mdss-dsi-off-command = [
				05 01 00 00 14 00 02 28 00
				05 01 00 00 32 00 02 10 00];

		/* 55h, CABC and IE */
		fih,mdss-dsi-ie-pre-command = [
				29 01 00 00 01 00 02 FF 10];
		fih,mdss-dsi-ie-on-command = [
				29 01 00 00 00 00 02 55 00];
		fih,mdss-dsi-ie-mode = <0x90>;

		/* color temperature command */
		fih,mdss-dsi-color-pre-command = [
				29 01 00 00 01 00 02 FF 20];
		fih,mdss-dsi-color-warm-command = [
				29 01 00 00 00 00 02 75 00
				29 01 00 00 00 00 02 76 7B
				29 01 00 00 00 00 02 77 00
				29 01 00 00 00 00 02 78 8A
				29 01 00 00 00 00 02 79 00
				29 01 00 00 00 00 02 7A A4
				29 01 00 00 00 00 02 7B 00
				29 01 00 00 00 00 02 7C B9
				29 01 00 00 00 00 02 7D 00
				29 01 00 00 00 00 02 7E CB
				29 01 00 00 00 00 02 7F 00
				29 01 00 00 00 00 02 80 DD
				29 01 00 00 00 00 02 81 00
				29 01 00 00 00 00 02 82 EB
				29 01 00 00 00 00 02 83 00
				29 01 00 00 00 00 02 84 F8
				29 01 00 00 00 00 02 85 01
				29 01 00 00 00 00 02 86 05
				29 01 00 00 00 00 02 87 01
				29 01 00 00 00 00 02 88 30
				29 01 00 00 00 00 02 89 01
				29 01 00 00 00 00 02 8A 54
				29 01 00 00 00 00 02 8B 01
				29 01 00 00 00 00 02 8C 8D
				29 01 00 00 00 00 02 8D 01
				29 01 00 00 00 00 02 8E BA
				29 01 00 00 00 00 02 8F 02
				29 01 00 00 00 00 02 90 02
				29 01 00 00 00 00 02 91 02
				29 01 00 00 00 00 02 92 3B
				29 01 00 00 00 00 02 93 02
				29 01 00 00 00 00 02 94 3D
				29 01 00 00 00 00 02 95 02
				29 01 00 00 00 00 02 96 72
				29 01 00 00 00 00 02 97 02
				29 01 00 00 00 00 02 98 A9
				29 01 00 00 00 00 02 99 02
				29 01 00 00 00 00 02 9A CA
				29 01 00 00 00 00 02 9B 02
				29 01 00 00 00 00 02 9C F9
				29 01 00 00 00 00 02 9D 03
				29 01 00 00 00 00 02 9E 17
				29 01 00 00 00 00 02 9F 03
				29 01 00 00 00 00 02 A0 3C
				29 01 00 00 00 00 02 A2 03
				29 01 00 00 00 00 02 A3 48
				29 01 00 00 00 00 02 A4 03
				29 01 00 00 00 00 02 A5 51
				29 01 00 00 00 00 02 A6 03
				29 01 00 00 00 00 02 A7 5D
				29 01 00 00 00 00 02 A9 03
				29 01 00 00 00 00 02 AA 6B
				29 01 00 00 00 00 02 AB 03
				29 01 00 00 00 00 02 AC 7C
				29 01 00 00 00 00 02 AD 03
				29 01 00 00 00 00 02 AE 90
				29 01 00 00 00 00 02 AF 03
				29 01 00 00 00 00 02 B0 CD
				29 01 00 00 00 00 02 B1 03
				29 01 00 00 00 00 02 B2 D3
				29 01 00 00 00 00 02 B3 00
				29 01 00 00 00 00 02 B4 7B
				29 01 00 00 00 00 02 B5 00
				29 01 00 00 00 00 02 B6 8A
				29 01 00 00 00 00 02 B7 00
				29 01 00 00 00 00 02 B8 A4
				29 01 00 00 00 00 02 B9 00
				29 01 00 00 00 00 02 BA B9
				29 01 00 00 00 00 02 BB 00
				29 01 00 00 00 00 02 BC CB
				29 01 00 00 00 00 02 BD 00
				29 01 00 00 00 00 02 BE DD
				29 01 00 00 00 00 02 BF 00
				29 01 00 00 00 00 02 C0 EB
				29 01 00 00 00 00 02 C1 00
				29 01 00 00 00 00 02 C2 F8
				29 01 00 00 00 00 02 C3 01
				29 01 00 00 00 00 02 C4 05
				29 01 00 00 00 00 02 C5 01
				29 01 00 00 00 00 02 C6 30
				29 01 00 00 00 00 02 C7 01
				29 01 00 00 00 00 02 C8 54
				29 01 00 00 00 00 02 C9 01
				29 01 00 00 00 00 02 CA 8D
				29 01 00 00 00 00 02 CB 01
				29 01 00 00 00 00 02 CC BA
				29 01 00 00 00 00 02 CD 02
				29 01 00 00 00 00 02 CE 02
				29 01 00 00 00 00 02 CF 02
				29 01 00 00 00 00 02 D0 3B
				29 01 00 00 00 00 02 D1 02
				29 01 00 00 00 00 02 D2 3D
				29 01 00 00 00 00 02 D3 02
				29 01 00 00 00 00 02 D4 72
				29 01 00 00 00 00 02 D5 02
				29 01 00 00 00 00 02 D6 A9
				29 01 00 00 00 00 02 D7 02
				29 01 00 00 00 00 02 D8 CA
				29 01 00 00 00 00 02 D9 02
				29 01 00 00 00 00 02 DA F9
				29 01 00 00 00 00 02 DB 03
				29 01 00 00 00 00 02 DC 17
				29 01 00 00 00 00 02 DD 03
				29 01 00 00 00 00 02 DE 3C
				29 01 00 00 00 00 02 DF 03
				29 01 00 00 00 00 02 E0 48
				29 01 00 00 00 00 02 E1 03
				29 01 00 00 00 00 02 E2 51
				29 01 00 00 00 00 02 E3 03
				29 01 00 00 00 00 02 E4 5D
				29 01 00 00 00 00 02 E5 03
				29 01 00 00 00 00 02 E6 6B
				29 01 00 00 00 00 02 E7 03
				29 01 00 00 00 00 02 E8 7C
				29 01 00 00 00 00 02 E9 03
				29 01 00 00 00 00 02 EA 90
				29 01 00 00 00 00 02 EB 03
				29 01 00 00 00 00 02 EC CD
				29 01 00 00 00 00 02 ED 03
				29 01 00 00 00 00 02 EE D3
				29 01 00 00 00 00 02 EF 00
				29 01 00 00 00 00 02 F0 13
				29 01 00 00 00 00 02 F1 00
				29 01 00 00 00 00 02 F2 31
				29 01 00 00 00 00 02 F3 00
				29 01 00 00 00 00 02 F4 58
				29 01 00 00 00 00 02 F5 00
				29 01 00 00 00 00 02 F6 75
				29 01 00 00 00 00 02 F7 00
				29 01 00 00 00 00 02 F8 8E
				29 01 00 00 00 00 02 F9 00
				29 01 00 00 00 00 02 FA A5
				29 01 00 00 00 00 02 FF 21
				29 01 00 00 00 00 02 00 00
				29 01 00 00 00 00 02 01 B7
				29 01 00 00 00 00 02 02 00
				29 01 00 00 00 00 02 03 C7
				29 01 00 00 00 00 02 04 00
				29 01 00 00 00 00 02 05 D7
				29 01 00 00 00 00 02 06 01
				29 01 00 00 00 00 02 07 0B
				29 01 00 00 00 00 02 08 01
				29 01 00 00 00 00 02 09 35
				29 01 00 00 00 00 02 0A 01
				29 01 00 00 00 00 02 0B 76
				29 01 00 00 00 00 02 0C 01
				29 01 00 00 00 00 02 0D A7
				29 01 00 00 00 00 02 0E 01
				29 01 00 00 00 00 02 0F F5
				29 01 00 00 00 00 02 10 02
				29 01 00 00 00 00 02 11 32
				29 01 00 00 00 00 02 12 02
				29 01 00 00 00 00 02 13 34
				29 01 00 00 00 00 02 14 02
				29 01 00 00 00 00 02 15 6B
				29 01 00 00 00 00 02 16 02
				29 01 00 00 00 00 02 17 A3
				29 01 00 00 00 00 02 18 02
				29 01 00 00 00 00 02 19 C4
				29 01 00 00 00 00 02 1A 02
				29 01 00 00 00 00 02 1B F3
				29 01 00 00 00 00 02 1C 03
				29 01 00 00 00 00 02 1D 13
				29 01 00 00 00 00 02 1E 03
				29 01 00 00 00 00 02 1F 37
				29 01 00 00 00 00 02 20 03
				29 01 00 00 00 00 02 21 43
				29 01 00 00 00 00 02 22 03
				29 01 00 00 00 00 02 23 50
				29 01 00 00 00 00 02 24 03
				29 01 00 00 00 00 02 25 5D
				29 01 00 00 00 00 02 26 03
				29 01 00 00 00 00 02 27 6E
				29 01 00 00 00 00 02 28 03
				29 01 00 00 00 00 02 29 82
				29 01 00 00 00 00 02 2A 03
				29 01 00 00 00 00 02 2B A1
				29 01 00 00 00 00 02 2D 03
				29 01 00 00 00 00 02 2F CC
				29 01 00 00 00 00 02 30 03
				29 01 00 00 00 00 02 31 D3
				29 01 00 00 00 00 02 32 00
				29 01 00 00 00 00 02 33 13
				29 01 00 00 00 00 02 34 00
				29 01 00 00 00 00 02 35 31
				29 01 00 00 00 00 02 36 00
				29 01 00 00 00 00 02 37 58
				29 01 00 00 00 00 02 38 00
				29 01 00 00 00 00 02 39 75
				29 01 00 00 00 00 02 3A 00
				29 01 00 00 00 00 02 3B 8E
				29 01 00 00 00 00 02 3D 00
				29 01 00 00 00 00 02 3F A5
				29 01 00 00 00 00 02 40 00
				29 01 00 00 00 00 02 41 B7
				29 01 00 00 00 00 02 42 00
				29 01 00 00 00 00 02 43 C7
				29 01 00 00 00 00 02 44 00
				29 01 00 00 00 00 02 45 D7
				29 01 00 00 00 00 02 46 01
				29 01 00 00 00 00 02 47 0B
				29 01 00 00 00 00 02 48 01
				29 01 00 00 00 00 02 49 35
				29 01 00 00 00 00 02 4A 01
				29 01 00 00 00 00 02 4B 76
				29 01 00 00 00 00 02 4C 01
				29 01 00 00 00 00 02 4D A7
				29 01 00 00 00 00 02 4E 01
				29 01 00 00 00 00 02 4F F5
				29 01 00 00 00 00 02 50 02
				29 01 00 00 00 00 02 51 32
				29 01 00 00 00 00 02 52 02
				29 01 00 00 00 00 02 53 34
				29 01 00 00 00 00 02 54 02
				29 01 00 00 00 00 02 55 6B
				29 01 00 00 00 00 02 56 02
				29 01 00 00 00 00 02 58 A3
				29 01 00 00 00 00 02 59 02
				29 01 00 00 00 00 02 5A C4
				29 01 00 00 00 00 02 5B 02
				29 01 00 00 00 00 02 5C F3
				29 01 00 00 00 00 02 5D 03
				29 01 00 00 00 00 02 5E 13
				29 01 00 00 00 00 02 5F 03
				29 01 00 00 00 00 02 60 37
				29 01 00 00 00 00 02 61 03
				29 01 00 00 00 00 02 62 43
				29 01 00 00 00 00 02 63 03
				29 01 00 00 00 00 02 64 50
				29 01 00 00 00 00 02 65 03
				29 01 00 00 00 00 02 66 5D
				29 01 00 00 00 00 02 67 03
				29 01 00 00 00 00 02 68 6E
				29 01 00 00 00 00 02 69 03
				29 01 00 00 00 00 02 6A 82
				29 01 00 00 00 00 02 6B 03
				29 01 00 00 00 00 02 6C A1
				29 01 00 00 00 00 02 6D 03
				29 01 00 00 00 00 02 6E CC
				29 01 00 00 00 00 02 6F 03
				29 01 00 00 00 00 02 70 D3
				29 01 00 00 00 00 02 71 00
				29 01 00 00 00 00 02 72 AA
				29 01 00 00 00 00 02 73 00
				29 01 00 00 00 00 02 74 B3
				29 01 00 00 00 00 02 75 00
				29 01 00 00 00 00 02 76 C4
				29 01 00 00 00 00 02 77 00
				29 01 00 00 00 00 02 78 D3
				29 01 00 00 00 00 02 79 00
				29 01 00 00 00 00 02 7A E1
				29 01 00 00 00 00 02 7B 00
				29 01 00 00 00 00 02 7C EF
				29 01 00 00 00 00 02 7D 00
				29 01 00 00 00 00 02 7E FB
				29 01 00 00 00 00 02 7F 01
				29 01 00 00 00 00 02 80 06
				29 01 00 00 00 00 02 81 01
				29 01 00 00 00 00 02 82 11
				29 01 00 00 00 00 02 83 01
				29 01 00 00 00 00 02 84 38
				29 01 00 00 00 00 02 85 01
				29 01 00 00 00 00 02 86 59
				29 01 00 00 00 00 02 87 01
				29 01 00 00 00 00 02 88 90
				29 01 00 00 00 00 02 89 01
				29 01 00 00 00 00 02 8A BC
				29 01 00 00 00 00 02 8B 02
				29 01 00 00 00 00 02 8C 03
				29 01 00 00 00 00 02 8D 02
				29 01 00 00 00 00 02 8E 3C
				29 01 00 00 00 00 02 8F 02
				29 01 00 00 00 00 02 90 3E
				29 01 00 00 00 00 02 91 02
				29 01 00 00 00 00 02 92 73
				29 01 00 00 00 00 02 93 02
				29 01 00 00 00 00 02 94 AA
				29 01 00 00 00 00 02 95 02
				29 01 00 00 00 00 02 96 CB
				29 01 00 00 00 00 02 97 02
				29 01 00 00 00 00 02 98 FD
				29 01 00 00 00 00 02 99 03
				29 01 00 00 00 00 02 9A 1B
				29 01 00 00 00 00 02 9B 03
				29 01 00 00 00 00 02 9C 49
				29 01 00 00 00 00 02 9D 03
				29 01 00 00 00 00 02 9E 5A
				29 01 00 00 00 00 02 9F 03
				29 01 00 00 00 00 02 A0 6F
				29 01 00 00 00 00 02 A2 03
				29 01 00 00 00 00 02 A3 7E
				29 01 00 00 00 00 02 A4 03
				29 01 00 00 00 00 02 A5 89
				29 01 00 00 00 00 02 A6 03
				29 01 00 00 00 00 02 A7 8D
				29 01 00 00 00 00 02 A9 03
				29 01 00 00 00 00 02 AA AC
				29 01 00 00 00 00 02 AB 03
				29 01 00 00 00 00 02 AC CF
				29 01 00 00 00 00 02 AD 03
				29 01 00 00 00 00 02 AE D3
				29 01 00 00 00 00 02 AF 00
				29 01 00 00 00 00 02 B0 AA
				29 01 00 00 00 00 02 B1 00
				29 01 00 00 00 00 02 B2 B3
				29 01 00 00 00 00 02 B3 00
				29 01 00 00 00 00 02 B4 C4
				29 01 00 00 00 00 02 B5 00
				29 01 00 00 00 00 02 B6 D3
				29 01 00 00 00 00 02 B7 00
				29 01 00 00 00 00 02 B8 E1
				29 01 00 00 00 00 02 B9 00
				29 01 00 00 00 00 02 BA EF
				29 01 00 00 00 00 02 BB 00
				29 01 00 00 00 00 02 BC FB
				29 01 00 00 00 00 02 BD 01
				29 01 00 00 00 00 02 BE 06
				29 01 00 00 00 00 02 BF 01
				29 01 00 00 00 00 02 C0 11
				29 01 00 00 00 00 02 C1 01
				29 01 00 00 00 00 02 C2 38
				29 01 00 00 00 00 02 C3 01
				29 01 00 00 00 00 02 C4 59
				29 01 00 00 00 00 02 C5 01
				29 01 00 00 00 00 02 C6 90
				29 01 00 00 00 00 02 C7 01
				29 01 00 00 00 00 02 C8 BC
				29 01 00 00 00 00 02 C9 02
				29 01 00 00 00 00 02 CA 03
				29 01 00 00 00 00 02 CB 02
				29 01 00 00 00 00 02 CC 3C
				29 01 00 00 00 00 02 CD 02
				29 01 00 00 00 00 02 CE 3E
				29 01 00 00 00 00 02 CF 02
				29 01 00 00 00 00 02 D0 73
				29 01 00 00 00 00 02 D1 02
				29 01 00 00 00 00 02 D2 AA
				29 01 00 00 00 00 02 D3 02
				29 01 00 00 00 00 02 D4 CB
				29 01 00 00 00 00 02 D5 02
				29 01 00 00 00 00 02 D6 FD
				29 01 00 00 00 00 02 D7 03
				29 01 00 00 00 00 02 D8 1B
				29 01 00 00 00 00 02 D9 03
				29 01 00 00 00 00 02 DA 49
				29 01 00 00 00 00 02 DB 03
				29 01 00 00 00 00 02 DC 5A
				29 01 00 00 00 00 02 DD 03
				29 01 00 00 00 00 02 DE 6F
				29 01 00 00 00 00 02 DF 03
				29 01 00 00 00 00 02 E0 7E
				29 01 00 00 00 00 02 E1 03
				29 01 00 00 00 00 02 E2 89
				29 01 00 00 00 00 02 E3 03
				29 01 00 00 00 00 02 E4 8D
				29 01 00 00 00 00 02 E5 03
				29 01 00 00 00 00 02 E6 AC
				29 01 00 00 00 00 02 E7 03
				29 01 00 00 00 00 02 E8 CF
				29 01 00 00 00 00 02 E9 03
				29 01 00 00 00 00 02 EA D3];
		fih,mdss-dsi-color-normal-command = [
				29 01 00 00 00 00 02 75 00
				29 01 00 00 00 00 02 76 2D
				29 01 00 00 00 00 02 77 00
				29 01 00 00 00 00 02 78 47
				29 01 00 00 00 00 02 79 00
				29 01 00 00 00 00 02 7A 71
				29 01 00 00 00 00 02 7B 00
				29 01 00 00 00 00 02 7C 8E
				29 01 00 00 00 00 02 7D 00
				29 01 00 00 00 00 02 7E A0
				29 01 00 00 00 00 02 7F 00
				29 01 00 00 00 00 02 80 B9
				29 01 00 00 00 00 02 81 00
				29 01 00 00 00 00 02 82 D2
				29 01 00 00 00 00 02 83 00
				29 01 00 00 00 00 02 84 E0
				29 01 00 00 00 00 02 85 00
				29 01 00 00 00 00 02 86 F1
				29 01 00 00 00 00 02 87 01
				29 01 00 00 00 00 02 88 22
				29 01 00 00 00 00 02 89 01
				29 01 00 00 00 00 02 8A 4A
				29 01 00 00 00 00 02 8B 01
				29 01 00 00 00 00 02 8C 87
				29 01 00 00 00 00 02 8D 01
				29 01 00 00 00 00 02 8E B8
				29 01 00 00 00 00 02 8F 02
				29 01 00 00 00 00 02 90 02
				29 01 00 00 00 00 02 91 02
				29 01 00 00 00 00 02 92 3E
				29 01 00 00 00 00 02 93 02
				29 01 00 00 00 00 02 94 40
				29 01 00 00 00 00 02 95 02
				29 01 00 00 00 00 02 96 74
				29 01 00 00 00 00 02 97 02
				29 01 00 00 00 00 02 98 AC
				29 01 00 00 00 00 02 99 02
				29 01 00 00 00 00 02 9A CD
				29 01 00 00 00 00 02 9B 02
				29 01 00 00 00 00 02 9C F3
				29 01 00 00 00 00 02 9D 03
				29 01 00 00 00 00 02 9E 11
				29 01 00 00 00 00 02 9F 03
				29 01 00 00 00 00 02 A0 36
				29 01 00 00 00 00 02 A2 03
				29 01 00 00 00 00 02 A3 41
				29 01 00 00 00 00 02 A4 03
				29 01 00 00 00 00 02 A5 4F
				29 01 00 00 00 00 02 A6 03
				29 01 00 00 00 00 02 A7 5D
				29 01 00 00 00 00 02 A9 03
				29 01 00 00 00 00 02 AA 6D
				29 01 00 00 00 00 02 AB 03
				29 01 00 00 00 00 02 AC 7D
				29 01 00 00 00 00 02 AD 03
				29 01 00 00 00 00 02 AE 94
				29 01 00 00 00 00 02 AF 03
				29 01 00 00 00 00 02 B0 C5
				29 01 00 00 00 00 02 B1 03
				29 01 00 00 00 00 02 B2 C7
				29 01 00 00 00 00 02 B3 00
				29 01 00 00 00 00 02 B4 2D
				29 01 00 00 00 00 02 B5 00
				29 01 00 00 00 00 02 B6 47
				29 01 00 00 00 00 02 B7 00
				29 01 00 00 00 00 02 B8 71
				29 01 00 00 00 00 02 B9 00
				29 01 00 00 00 00 02 BA 8E
				29 01 00 00 00 00 02 BB 00
				29 01 00 00 00 00 02 BC A0
				29 01 00 00 00 00 02 BD 00
				29 01 00 00 00 00 02 BE B9
				29 01 00 00 00 00 02 BF 00
				29 01 00 00 00 00 02 C0 D2
				29 01 00 00 00 00 02 C1 00
				29 01 00 00 00 00 02 C2 E0
				29 01 00 00 00 00 02 C3 00
				29 01 00 00 00 00 02 C4 F1
				29 01 00 00 00 00 02 C5 01
				29 01 00 00 00 00 02 C6 22
				29 01 00 00 00 00 02 C7 01
				29 01 00 00 00 00 02 C8 4A
				29 01 00 00 00 00 02 C9 01
				29 01 00 00 00 00 02 CA 87
				29 01 00 00 00 00 02 CB 01
				29 01 00 00 00 00 02 CC B8
				29 01 00 00 00 00 02 CD 02
				29 01 00 00 00 00 02 CE 02
				29 01 00 00 00 00 02 CF 02
				29 01 00 00 00 00 02 D0 3E
				29 01 00 00 00 00 02 D1 02
				29 01 00 00 00 00 02 D2 40
				29 01 00 00 00 00 02 D3 02
				29 01 00 00 00 00 02 D4 74
				29 01 00 00 00 00 02 D5 02
				29 01 00 00 00 00 02 D6 AC
				29 01 00 00 00 00 02 D7 02
				29 01 00 00 00 00 02 D8 CD
				29 01 00 00 00 00 02 D9 02
				29 01 00 00 00 00 02 DA F3
				29 01 00 00 00 00 02 DB 03
				29 01 00 00 00 00 02 DC 11
				29 01 00 00 00 00 02 DD 03
				29 01 00 00 00 00 02 DE 36
				29 01 00 00 00 00 02 DF 03
				29 01 00 00 00 00 02 E0 41
				29 01 00 00 00 00 02 E1 03
				29 01 00 00 00 00 02 E2 4F
				29 01 00 00 00 00 02 E3 03
				29 01 00 00 00 00 02 E4 5D
				29 01 00 00 00 00 02 E5 03
				29 01 00 00 00 00 02 E6 6D
				29 01 00 00 00 00 02 E7 03
				29 01 00 00 00 00 02 E8 7D
				29 01 00 00 00 00 02 E9 03
				29 01 00 00 00 00 02 EA 94
				29 01 00 00 00 00 02 EB 03
				29 01 00 00 00 00 02 EC C5
				29 01 00 00 00 00 02 ED 03
				29 01 00 00 00 00 02 EE C7
				29 01 00 00 00 00 02 EF 00
				29 01 00 00 00 00 02 F0 2D
				29 01 00 00 00 00 02 F1 00
				29 01 00 00 00 00 02 F2 47
				29 01 00 00 00 00 02 F3 00
				29 01 00 00 00 00 02 F4 71
				29 01 00 00 00 00 02 F5 00
				29 01 00 00 00 00 02 F6 8E
				29 01 00 00 00 00 02 F7 00
				29 01 00 00 00 00 02 F8 A0
				29 01 00 00 00 00 02 F9 00
				29 01 00 00 00 00 02 FA B9
				29 01 00 00 00 00 02 FB 01
				29 01 00 00 00 00 02 FF 21
				29 01 00 00 00 00 02 00 00
				29 01 00 00 00 00 02 01 D2
				29 01 00 00 00 00 02 02 00
				29 01 00 00 00 00 02 03 E0
				29 01 00 00 00 00 02 04 00
				29 01 00 00 00 00 02 05 F1
				29 01 00 00 00 00 02 06 01
				29 01 00 00 00 00 02 07 22
				29 01 00 00 00 00 02 08 01
				29 01 00 00 00 00 02 09 4A
				29 01 00 00 00 00 02 0A 01
				29 01 00 00 00 00 02 0B 87
				29 01 00 00 00 00 02 0C 01
				29 01 00 00 00 00 02 0D B8
				29 01 00 00 00 00 02 0E 02
				29 01 00 00 00 00 02 0F 02
				29 01 00 00 00 00 02 10 02
				29 01 00 00 00 00 02 11 3E
				29 01 00 00 00 00 02 12 02
				29 01 00 00 00 00 02 13 40
				29 01 00 00 00 00 02 14 02
				29 01 00 00 00 00 02 15 74
				29 01 00 00 00 00 02 16 02
				29 01 00 00 00 00 02 17 AC
				29 01 00 00 00 00 02 18 02
				29 01 00 00 00 00 02 19 CD
				29 01 00 00 00 00 02 1A 02
				29 01 00 00 00 00 02 1B F3
				29 01 00 00 00 00 02 1C 03
				29 01 00 00 00 00 02 1D 11
				29 01 00 00 00 00 02 1E 03
				29 01 00 00 00 00 02 1F 36
				29 01 00 00 00 00 02 20 03
				29 01 00 00 00 00 02 21 41
				29 01 00 00 00 00 02 22 03
				29 01 00 00 00 00 02 23 4F
				29 01 00 00 00 00 02 24 03
				29 01 00 00 00 00 02 25 5D
				29 01 00 00 00 00 02 26 03
				29 01 00 00 00 00 02 27 6D
				29 01 00 00 00 00 02 28 03
				29 01 00 00 00 00 02 29 7D
				29 01 00 00 00 00 02 2A 03
				29 01 00 00 00 00 02 2B 94
				29 01 00 00 00 00 02 2D 03
				29 01 00 00 00 00 02 2F C5
				29 01 00 00 00 00 02 30 03
				29 01 00 00 00 00 02 31 C7
				29 01 00 00 00 00 02 32 00
				29 01 00 00 00 00 02 33 2D
				29 01 00 00 00 00 02 34 00
				29 01 00 00 00 00 02 35 47
				29 01 00 00 00 00 02 36 00
				29 01 00 00 00 00 02 37 71
				29 01 00 00 00 00 02 38 00
				29 01 00 00 00 00 02 39 8E
				29 01 00 00 00 00 02 3A 00
				29 01 00 00 00 00 02 3B A0
				29 01 00 00 00 00 02 3D 00
				29 01 00 00 00 00 02 3F B9
				29 01 00 00 00 00 02 40 00
				29 01 00 00 00 00 02 41 D2
				29 01 00 00 00 00 02 42 00
				29 01 00 00 00 00 02 43 E0
				29 01 00 00 00 00 02 44 00
				29 01 00 00 00 00 02 45 F1
				29 01 00 00 00 00 02 46 01
				29 01 00 00 00 00 02 47 22
				29 01 00 00 00 00 02 48 01
				29 01 00 00 00 00 02 49 4A
				29 01 00 00 00 00 02 4A 01
				29 01 00 00 00 00 02 4B 87
				29 01 00 00 00 00 02 4C 01
				29 01 00 00 00 00 02 4D B8
				29 01 00 00 00 00 02 4E 02
				29 01 00 00 00 00 02 4F 02
				29 01 00 00 00 00 02 50 02
				29 01 00 00 00 00 02 51 3E
				29 01 00 00 00 00 02 52 02
				29 01 00 00 00 00 02 53 40
				29 01 00 00 00 00 02 54 02
				29 01 00 00 00 00 02 55 74
				29 01 00 00 00 00 02 56 02
				29 01 00 00 00 00 02 58 AC
				29 01 00 00 00 00 02 59 02
				29 01 00 00 00 00 02 5A CD
				29 01 00 00 00 00 02 5B 02
				29 01 00 00 00 00 02 5C F3
				29 01 00 00 00 00 02 5D 03
				29 01 00 00 00 00 02 5E 11
				29 01 00 00 00 00 02 5F 03
				29 01 00 00 00 00 02 60 36
				29 01 00 00 00 00 02 61 03
				29 01 00 00 00 00 02 62 41
				29 01 00 00 00 00 02 63 03
				29 01 00 00 00 00 02 64 4F
				29 01 00 00 00 00 02 65 03
				29 01 00 00 00 00 02 66 5D
				29 01 00 00 00 00 02 67 03
				29 01 00 00 00 00 02 68 6D
				29 01 00 00 00 00 02 69 03
				29 01 00 00 00 00 02 6A 7D
				29 01 00 00 00 00 02 6B 03
				29 01 00 00 00 00 02 6C 94
				29 01 00 00 00 00 02 6D 03
				29 01 00 00 00 00 02 6E C5
				29 01 00 00 00 00 02 6F 03
				29 01 00 00 00 00 02 70 C7
				29 01 00 00 00 00 02 71 00
				29 01 00 00 00 00 02 72 2D
				29 01 00 00 00 00 02 73 00
				29 01 00 00 00 00 02 74 47
				29 01 00 00 00 00 02 75 00
				29 01 00 00 00 00 02 76 71
				29 01 00 00 00 00 02 77 00
				29 01 00 00 00 00 02 78 8E
				29 01 00 00 00 00 02 79 00
				29 01 00 00 00 00 02 7A A0
				29 01 00 00 00 00 02 7B 00
				29 01 00 00 00 00 02 7C B9
				29 01 00 00 00 00 02 7D 00
				29 01 00 00 00 00 02 7E D2
				29 01 00 00 00 00 02 7F 00
				29 01 00 00 00 00 02 80 E0
				29 01 00 00 00 00 02 81 00
				29 01 00 00 00 00 02 82 F1
				29 01 00 00 00 00 02 83 01
				29 01 00 00 00 00 02 84 22
				29 01 00 00 00 00 02 85 01
				29 01 00 00 00 00 02 86 4A
				29 01 00 00 00 00 02 87 01
				29 01 00 00 00 00 02 88 87
				29 01 00 00 00 00 02 89 01
				29 01 00 00 00 00 02 8A B8
				29 01 00 00 00 00 02 8B 02
				29 01 00 00 00 00 02 8C 02
				29 01 00 00 00 00 02 8D 02
				29 01 00 00 00 00 02 8E 3E
				29 01 00 00 00 00 02 8F 02
				29 01 00 00 00 00 02 90 40
				29 01 00 00 00 00 02 91 02
				29 01 00 00 00 00 02 92 74
				29 01 00 00 00 00 02 93 02
				29 01 00 00 00 00 02 94 AC
				29 01 00 00 00 00 02 95 02
				29 01 00 00 00 00 02 96 CD
				29 01 00 00 00 00 02 97 02
				29 01 00 00 00 00 02 98 F3
				29 01 00 00 00 00 02 99 03
				29 01 00 00 00 00 02 9A 11
				29 01 00 00 00 00 02 9B 03
				29 01 00 00 00 00 02 9C 36
				29 01 00 00 00 00 02 9D 03
				29 01 00 00 00 00 02 9E 41
				29 01 00 00 00 00 02 9F 03
				29 01 00 00 00 00 02 A0 4F
				29 01 00 00 00 00 02 A2 03
				29 01 00 00 00 00 02 A3 5D
				29 01 00 00 00 00 02 A4 03
				29 01 00 00 00 00 02 A5 6D
				29 01 00 00 00 00 02 A6 03
				29 01 00 00 00 00 02 A7 7D
				29 01 00 00 00 00 02 A9 03
				29 01 00 00 00 00 02 AA 94
				29 01 00 00 00 00 02 AB 03
				29 01 00 00 00 00 02 AC C5
				29 01 00 00 00 00 02 AD 03
				29 01 00 00 00 00 02 AE C7
				29 01 00 00 00 00 02 AF 00
				29 01 00 00 00 00 02 B0 2D
				29 01 00 00 00 00 02 B1 00
				29 01 00 00 00 00 02 B2 47
				29 01 00 00 00 00 02 B3 00
				29 01 00 00 00 00 02 B4 71
				29 01 00 00 00 00 02 B5 00
				29 01 00 00 00 00 02 B6 8E
				29 01 00 00 00 00 02 B7 00
				29 01 00 00 00 00 02 B8 A0
				29 01 00 00 00 00 02 B9 00
				29 01 00 00 00 00 02 BA B9
				29 01 00 00 00 00 02 BB 00
				29 01 00 00 00 00 02 BC D2
				29 01 00 00 00 00 02 BD 00
				29 01 00 00 00 00 02 BE E0
				29 01 00 00 00 00 02 BF 00
				29 01 00 00 00 00 02 C0 F1
				29 01 00 00 00 00 02 C1 01
				29 01 00 00 00 00 02 C2 22
				29 01 00 00 00 00 02 C3 01
				29 01 00 00 00 00 02 C4 4A
				29 01 00 00 00 00 02 C5 01
				29 01 00 00 00 00 02 C6 87
				29 01 00 00 00 00 02 C7 01
				29 01 00 00 00 00 02 C8 B8
				29 01 00 00 00 00 02 C9 02
				29 01 00 00 00 00 02 CA 02
				29 01 00 00 00 00 02 CB 02
				29 01 00 00 00 00 02 CC 3E
				29 01 00 00 00 00 02 CD 02
				29 01 00 00 00 00 02 CE 40
				29 01 00 00 00 00 02 CF 02
				29 01 00 00 00 00 02 D0 74
				29 01 00 00 00 00 02 D1 02
				29 01 00 00 00 00 02 D2 AC
				29 01 00 00 00 00 02 D3 02
				29 01 00 00 00 00 02 D4 CD
				29 01 00 00 00 00 02 D5 02
				29 01 00 00 00 00 02 D6 F3
				29 01 00 00 00 00 02 D7 03
				29 01 00 00 00 00 02 D8 11
				29 01 00 00 00 00 02 D9 03
				29 01 00 00 00 00 02 DA 36
				29 01 00 00 00 00 02 DB 03
				29 01 00 00 00 00 02 DC 41
				29 01 00 00 00 00 02 DD 03
				29 01 00 00 00 00 02 DE 4F
				29 01 00 00 00 00 02 DF 03
				29 01 00 00 00 00 02 E0 5D
				29 01 00 00 00 00 02 E1 03
				29 01 00 00 00 00 02 E2 6D
				29 01 00 00 00 00 02 E3 03
				29 01 00 00 00 00 02 E4 7D
				29 01 00 00 00 00 02 E5 03
				29 01 00 00 00 00 02 E6 94
				29 01 00 00 00 00 02 E7 03
				29 01 00 00 00 00 02 E8 C5
				29 01 00 00 00 00 02 E9 03
				29 01 00 00 00 00 02 EA C7];
		fih,mdss-dsi-color-cold-command = [
				29 01 00 00 00 00 02 75 00
				29 01 00 00 00 00 02 76 CA
				29 01 00 00 00 00 02 77 00
				29 01 00 00 00 00 02 78 D2
				29 01 00 00 00 00 02 79 00
				29 01 00 00 00 00 02 7A E1
				29 01 00 00 00 00 02 7B 00
				29 01 00 00 00 00 02 7C EE
				29 01 00 00 00 00 02 7D 00
				29 01 00 00 00 00 02 7E FB
				29 01 00 00 00 00 02 7F 01
				29 01 00 00 00 00 02 80 07
				29 01 00 00 00 00 02 81 01
				29 01 00 00 00 00 02 82 12
				29 01 00 00 00 00 02 83 01
				29 01 00 00 00 00 02 84 1D
				29 01 00 00 00 00 02 85 01
				29 01 00 00 00 00 02 86 27
				29 01 00 00 00 00 02 87 01
				29 01 00 00 00 00 02 88 4B
				29 01 00 00 00 00 02 89 01
				29 01 00 00 00 00 02 8A 69
				29 01 00 00 00 00 02 8B 01
				29 01 00 00 00 00 02 8C 9C
				29 01 00 00 00 00 02 8D 01
				29 01 00 00 00 00 02 8E C6
				29 01 00 00 00 00 02 8F 02
				29 01 00 00 00 00 02 90 0A
				29 01 00 00 00 00 02 91 02
				29 01 00 00 00 00 02 92 42
				29 01 00 00 00 00 02 93 02
				29 01 00 00 00 00 02 94 43
				29 01 00 00 00 00 02 95 02
				29 01 00 00 00 00 02 96 76
				29 01 00 00 00 00 02 97 02
				29 01 00 00 00 00 02 98 AC
				29 01 00 00 00 00 02 99 02
				29 01 00 00 00 00 02 9A CD
				29 01 00 00 00 00 02 9B 02
				29 01 00 00 00 00 02 9C FC
				29 01 00 00 00 00 02 9D 03
				29 01 00 00 00 00 02 9E 19
				29 01 00 00 00 00 02 9F 03
				29 01 00 00 00 00 02 A0 3D
				29 01 00 00 00 00 02 A2 03
				29 01 00 00 00 00 02 A3 48
				29 01 00 00 00 00 02 A4 03
				29 01 00 00 00 00 02 A5 54
				29 01 00 00 00 00 02 A6 03
				29 01 00 00 00 00 02 A7 5E
				29 01 00 00 00 00 02 A9 03
				29 01 00 00 00 00 02 AA 6D
				29 01 00 00 00 00 02 AB 03
				29 01 00 00 00 00 02 AC 7D
				29 01 00 00 00 00 02 AD 03
				29 01 00 00 00 00 02 AE 91
				29 01 00 00 00 00 02 AF 03
				29 01 00 00 00 00 02 B0 CB
				29 01 00 00 00 00 02 B1 03
				29 01 00 00 00 00 02 B2 D3
				29 01 00 00 00 00 02 B3 00
				29 01 00 00 00 00 02 B4 CA
				29 01 00 00 00 00 02 B5 00
				29 01 00 00 00 00 02 B6 D2
				29 01 00 00 00 00 02 B7 00
				29 01 00 00 00 00 02 B8 E1
				29 01 00 00 00 00 02 B9 00
				29 01 00 00 00 00 02 BA EE
				29 01 00 00 00 00 02 BB 00
				29 01 00 00 00 00 02 BC FB
				29 01 00 00 00 00 02 BD 01
				29 01 00 00 00 00 02 BE 07
				29 01 00 00 00 00 02 BF 01
				29 01 00 00 00 00 02 C0 12
				29 01 00 00 00 00 02 C1 01
				29 01 00 00 00 00 02 C2 1D
				29 01 00 00 00 00 02 C3 01
				29 01 00 00 00 00 02 C4 27
				29 01 00 00 00 00 02 C5 01
				29 01 00 00 00 00 02 C6 4B
				29 01 00 00 00 00 02 C7 01
				29 01 00 00 00 00 02 C8 69
				29 01 00 00 00 00 02 C9 01
				29 01 00 00 00 00 02 CA 9C
				29 01 00 00 00 00 02 CB 01
				29 01 00 00 00 00 02 CC C6
				29 01 00 00 00 00 02 CD 02
				29 01 00 00 00 00 02 CE 0A
				29 01 00 00 00 00 02 CF 02
				29 01 00 00 00 00 02 D0 42
				29 01 00 00 00 00 02 D1 02
				29 01 00 00 00 00 02 D2 43
				29 01 00 00 00 00 02 D3 02
				29 01 00 00 00 00 02 D4 76
				29 01 00 00 00 00 02 D5 02
				29 01 00 00 00 00 02 D6 AC
				29 01 00 00 00 00 02 D7 02
				29 01 00 00 00 00 02 D8 CD
				29 01 00 00 00 00 02 D9 02
				29 01 00 00 00 00 02 DA FC
				29 01 00 00 00 00 02 DB 03
				29 01 00 00 00 00 02 DC 19
				29 01 00 00 00 00 02 DD 03
				29 01 00 00 00 00 02 DE 3D
				29 01 00 00 00 00 02 DF 03
				29 01 00 00 00 00 02 E0 48
				29 01 00 00 00 00 02 E1 03
				29 01 00 00 00 00 02 E2 54
				29 01 00 00 00 00 02 E3 03
				29 01 00 00 00 00 02 E4 5E
				29 01 00 00 00 00 02 E5 03
				29 01 00 00 00 00 02 E6 6D
				29 01 00 00 00 00 02 E7 03
				29 01 00 00 00 00 02 E8 7D
				29 01 00 00 00 00 02 E9 03
				29 01 00 00 00 00 02 EA 91
				29 01 00 00 00 00 02 EB 03
				29 01 00 00 00 00 02 EC CB
				29 01 00 00 00 00 02 ED 03
				29 01 00 00 00 00 02 EE D3
				29 01 00 00 00 00 02 EF 00
				29 01 00 00 00 00 02 F0 6B
				29 01 00 00 00 00 02 F1 00
				29 01 00 00 00 00 02 F2 79
				29 01 00 00 00 00 02 F3 00
				29 01 00 00 00 00 02 F4 92
				29 01 00 00 00 00 02 F5 00
				29 01 00 00 00 00 02 F6 A8
				29 01 00 00 00 00 02 F7 00
				29 01 00 00 00 00 02 F8 BB
				29 01 00 00 00 00 02 F9 00
				29 01 00 00 00 00 02 FA CC
				29 01 00 00 00 00 02 FF 21
				29 01 00 00 00 00 02 00 00
				29 01 00 00 00 00 02 01 DC
				29 01 00 00 00 00 02 02 00
				29 01 00 00 00 00 02 03 EA
				29 01 00 00 00 00 02 04 00
				29 01 00 00 00 00 02 05 F7
				29 01 00 00 00 00 02 06 01
				29 01 00 00 00 00 02 07 25
				29 01 00 00 00 00 02 08 01
				29 01 00 00 00 00 02 09 4A
				29 01 00 00 00 00 02 0A 01
				29 01 00 00 00 00 02 0B 85
				29 01 00 00 00 00 02 0C 01
				29 01 00 00 00 00 02 0D B4
				29 01 00 00 00 00 02 0E 01
				29 01 00 00 00 00 02 0F FF
				29 01 00 00 00 00 02 10 02
				29 01 00 00 00 00 02 11 39
				29 01 00 00 00 00 02 12 02
				29 01 00 00 00 00 02 13 3B
				29 01 00 00 00 00 02 14 02
				29 01 00 00 00 00 02 15 70
				29 01 00 00 00 00 02 16 02
				29 01 00 00 00 00 02 17 A8
				29 01 00 00 00 00 02 18 02
				29 01 00 00 00 00 02 19 C8
				29 01 00 00 00 00 02 1A 02
				29 01 00 00 00 00 02 1B F7
				29 01 00 00 00 00 02 1C 03
				29 01 00 00 00 00 02 1D 15
				29 01 00 00 00 00 02 1E 03
				29 01 00 00 00 00 02 1F 39
				29 01 00 00 00 00 02 20 03
				29 01 00 00 00 00 02 21 44
				29 01 00 00 00 00 02 22 03
				29 01 00 00 00 00 02 23 50
				29 01 00 00 00 00 02 24 03
				29 01 00 00 00 00 02 25 5F
				29 01 00 00 00 00 02 26 03
				29 01 00 00 00 00 02 27 6E
				29 01 00 00 00 00 02 28 03
				29 01 00 00 00 00 02 29 83
				29 01 00 00 00 00 02 2A 03
				29 01 00 00 00 00 02 2B A2
				29 01 00 00 00 00 02 2D 03
				29 01 00 00 00 00 02 2F CC
				29 01 00 00 00 00 02 30 03
				29 01 00 00 00 00 02 31 D3
				29 01 00 00 00 00 02 32 00
				29 01 00 00 00 00 02 33 6B
				29 01 00 00 00 00 02 34 00
				29 01 00 00 00 00 02 35 79
				29 01 00 00 00 00 02 36 00
				29 01 00 00 00 00 02 37 92
				29 01 00 00 00 00 02 38 00
				29 01 00 00 00 00 02 39 A8
				29 01 00 00 00 00 02 3A 00
				29 01 00 00 00 00 02 3B BB
				29 01 00 00 00 00 02 3D 00
				29 01 00 00 00 00 02 3F CC
				29 01 00 00 00 00 02 40 00
				29 01 00 00 00 00 02 41 DC
				29 01 00 00 00 00 02 42 00
				29 01 00 00 00 00 02 43 EA
				29 01 00 00 00 00 02 44 00
				29 01 00 00 00 00 02 45 F7
				29 01 00 00 00 00 02 46 01
				29 01 00 00 00 00 02 47 25
				29 01 00 00 00 00 02 48 01
				29 01 00 00 00 00 02 49 4A
				29 01 00 00 00 00 02 4A 01
				29 01 00 00 00 00 02 4B 85
				29 01 00 00 00 00 02 4C 01
				29 01 00 00 00 00 02 4D B4
				29 01 00 00 00 00 02 4E 01
				29 01 00 00 00 00 02 4F FF
				29 01 00 00 00 00 02 50 02
				29 01 00 00 00 00 02 51 39
				29 01 00 00 00 00 02 52 02
				29 01 00 00 00 00 02 53 3B
				29 01 00 00 00 00 02 54 02
				29 01 00 00 00 00 02 55 70
				29 01 00 00 00 00 02 56 02
				29 01 00 00 00 00 02 58 A8
				29 01 00 00 00 00 02 59 02
				29 01 00 00 00 00 02 5A C8
				29 01 00 00 00 00 02 5B 02
				29 01 00 00 00 00 02 5C F7
				29 01 00 00 00 00 02 5D 03
				29 01 00 00 00 00 02 5E 15
				29 01 00 00 00 00 02 5F 03
				29 01 00 00 00 00 02 60 39
				29 01 00 00 00 00 02 61 03
				29 01 00 00 00 00 02 62 44
				29 01 00 00 00 00 02 63 03
				29 01 00 00 00 00 02 64 50
				29 01 00 00 00 00 02 65 03
				29 01 00 00 00 00 02 66 5F
				29 01 00 00 00 00 02 67 03
				29 01 00 00 00 00 02 68 6E
				29 01 00 00 00 00 02 69 03
				29 01 00 00 00 00 02 6A 83
				29 01 00 00 00 00 02 6B 03
				29 01 00 00 00 00 02 6C A2
				29 01 00 00 00 00 02 6D 03
				29 01 00 00 00 00 02 6E CC
				29 01 00 00 00 00 02 6F 03
				29 01 00 00 00 00 02 70 D3
				29 01 00 00 00 00 02 71 00
				29 01 00 00 00 00 02 72 13
				29 01 00 00 00 00 02 73 00
				29 01 00 00 00 00 02 74 2D
				29 01 00 00 00 00 02 75 00
				29 01 00 00 00 00 02 76 53
				29 01 00 00 00 00 02 77 00
				29 01 00 00 00 00 02 78 70
				29 01 00 00 00 00 02 79 00
				29 01 00 00 00 00 02 7A 89
				29 01 00 00 00 00 02 7B 00
				29 01 00 00 00 00 02 7C 9E
				29 01 00 00 00 00 02 7D 00
				29 01 00 00 00 00 02 7E B1
				29 01 00 00 00 00 02 7F 00
				29 01 00 00 00 00 02 80 C3
				29 01 00 00 00 00 02 81 00
				29 01 00 00 00 00 02 82 D3
				29 01 00 00 00 00 02 83 01
				29 01 00 00 00 00 02 84 08
				29 01 00 00 00 00 02 85 01
				29 01 00 00 00 00 02 86 32
				29 01 00 00 00 00 02 87 01
				29 01 00 00 00 00 02 88 74
				29 01 00 00 00 00 02 89 01
				29 01 00 00 00 00 02 8A A7
				29 01 00 00 00 00 02 8B 01
				29 01 00 00 00 00 02 8C F5
				29 01 00 00 00 00 02 8D 02
				29 01 00 00 00 00 02 8E 33
				29 01 00 00 00 00 02 8F 02
				29 01 00 00 00 00 02 90 36
				29 01 00 00 00 00 02 91 02
				29 01 00 00 00 00 02 92 6D
				29 01 00 00 00 00 02 93 02
				29 01 00 00 00 00 02 94 A6
				29 01 00 00 00 00 02 95 02
				29 01 00 00 00 00 02 96 C7
				29 01 00 00 00 00 02 97 02
				29 01 00 00 00 00 02 98 F7
				29 01 00 00 00 00 02 99 03
				29 01 00 00 00 00 02 9A 17
				29 01 00 00 00 00 02 9B 03
				29 01 00 00 00 00 02 9C 41
				29 01 00 00 00 00 02 9D 03
				29 01 00 00 00 00 02 9E 4F
				29 01 00 00 00 00 02 9F 03
				29 01 00 00 00 00 02 A0 60
				29 01 00 00 00 00 02 A2 03
				29 01 00 00 00 00 02 A3 78
				29 01 00 00 00 00 02 A4 03
				29 01 00 00 00 00 02 A5 8E
				29 01 00 00 00 00 02 A6 03
				29 01 00 00 00 00 02 A7 A0
				29 01 00 00 00 00 02 A9 03
				29 01 00 00 00 00 02 AA A8
				29 01 00 00 00 00 02 AB 03
				29 01 00 00 00 00 02 AC CF
				29 01 00 00 00 00 02 AD 03
				29 01 00 00 00 00 02 AE D3
				29 01 00 00 00 00 02 AF 00
				29 01 00 00 00 00 02 B0 13
				29 01 00 00 00 00 02 B1 00
				29 01 00 00 00 00 02 B2 2D
				29 01 00 00 00 00 02 B3 00
				29 01 00 00 00 00 02 B4 53
				29 01 00 00 00 00 02 B5 00
				29 01 00 00 00 00 02 B6 70
				29 01 00 00 00 00 02 B7 00
				29 01 00 00 00 00 02 B8 89
				29 01 00 00 00 00 02 B9 00
				29 01 00 00 00 00 02 BA 9E
				29 01 00 00 00 00 02 BB 00
				29 01 00 00 00 00 02 BC B1
				29 01 00 00 00 00 02 BD 00
				29 01 00 00 00 00 02 BE C3
				29 01 00 00 00 00 02 BF 00
				29 01 00 00 00 00 02 C0 D3
				29 01 00 00 00 00 02 C1 01
				29 01 00 00 00 00 02 C2 08
				29 01 00 00 00 00 02 C3 01
				29 01 00 00 00 00 02 C4 32
				29 01 00 00 00 00 02 C5 01
				29 01 00 00 00 00 02 C6 74
				29 01 00 00 00 00 02 C7 01
				29 01 00 00 00 00 02 C8 A7
				29 01 00 00 00 00 02 C9 01
				29 01 00 00 00 00 02 CA F5
				29 01 00 00 00 00 02 CB 02
				29 01 00 00 00 00 02 CC 33
				29 01 00 00 00 00 02 CD 02
				29 01 00 00 00 00 02 CE 36
				29 01 00 00 00 00 02 CF 02
				29 01 00 00 00 00 02 D0 6D
				29 01 00 00 00 00 02 D1 02
				29 01 00 00 00 00 02 D2 A6
				29 01 00 00 00 00 02 D3 02
				29 01 00 00 00 00 02 D4 C7
				29 01 00 00 00 00 02 D5 02
				29 01 00 00 00 00 02 D6 F7
				29 01 00 00 00 00 02 D7 03
				29 01 00 00 00 00 02 D8 17
				29 01 00 00 00 00 02 D9 03
				29 01 00 00 00 00 02 DA 41
				29 01 00 00 00 00 02 DB 03
				29 01 00 00 00 00 02 DC 4F
				29 01 00 00 00 00 02 DD 03
				29 01 00 00 00 00 02 DE 60
				29 01 00 00 00 00 02 DF 03
				29 01 00 00 00 00 02 E0 78
				29 01 00 00 00 00 02 E1 03
				29 01 00 00 00 00 02 E2 8E
				29 01 00 00 00 00 02 E3 03
				29 01 00 00 00 00 02 E4 A0
				29 01 00 00 00 00 02 E5 03
				29 01 00 00 00 00 02 E6 A8
				29 01 00 00 00 00 02 E7 03
				29 01 00 00 00 00 02 E8 CF
				29 01 00 00 00 00 02 E9 03
				29 01 00 00 00 00 02 EA D3];

		/* gamma setting command */
		fih,mdss-dsi-color-gamma-1-command = [
				29 01 00 00 00 00 02 75 00
				29 01 00 00 00 00 02 76 BD
				29 01 00 00 00 00 02 77 00
				29 01 00 00 00 00 02 78 C6
				29 01 00 00 00 00 02 79 00
				29 01 00 00 00 00 02 7A D6
				29 01 00 00 00 00 02 7B 00
				29 01 00 00 00 00 02 7C E4
				29 01 00 00 00 00 02 7D 00
				29 01 00 00 00 00 02 7E F2
				29 01 00 00 00 00 02 7F 00
				29 01 00 00 00 00 02 80 FE
				29 01 00 00 00 00 02 81 01
				29 01 00 00 00 00 02 82 0A
				29 01 00 00 00 00 02 83 01
				29 01 00 00 00 00 02 84 15
				29 01 00 00 00 00 02 85 01
				29 01 00 00 00 00 02 86 20
				29 01 00 00 00 00 02 87 01
				29 01 00 00 00 00 02 88 45
				29 01 00 00 00 00 02 89 01
				29 01 00 00 00 00 02 8A 64
				29 01 00 00 00 00 02 8B 01
				29 01 00 00 00 00 02 8C 99
				29 01 00 00 00 00 02 8D 01
				29 01 00 00 00 00 02 8E C3
				29 01 00 00 00 00 02 8F 02
				29 01 00 00 00 00 02 90 08
				29 01 00 00 00 00 02 91 02
				29 01 00 00 00 00 02 92 40
				29 01 00 00 00 00 02 93 02
				29 01 00 00 00 00 02 94 42
				29 01 00 00 00 00 02 95 02
				29 01 00 00 00 00 02 96 75
				29 01 00 00 00 00 02 97 02
				29 01 00 00 00 00 02 98 AC
				29 01 00 00 00 00 02 99 02
				29 01 00 00 00 00 02 9A CD
				29 01 00 00 00 00 02 9B 02
				29 01 00 00 00 00 02 9C FB
				29 01 00 00 00 00 02 9D 03
				29 01 00 00 00 00 02 9E 19
				29 01 00 00 00 00 02 9F 03
				29 01 00 00 00 00 02 A0 3C
				29 01 00 00 00 00 02 A2 03
				29 01 00 00 00 00 02 A3 48
				29 01 00 00 00 00 02 A4 03
				29 01 00 00 00 00 02 A5 51
				29 01 00 00 00 00 02 A6 03
				29 01 00 00 00 00 02 A7 5E
				29 01 00 00 00 00 02 A9 03
				29 01 00 00 00 00 02 AA 6C
				29 01 00 00 00 00 02 AB 03
				29 01 00 00 00 00 02 AC 7D
				29 01 00 00 00 00 02 AD 03
				29 01 00 00 00 00 02 AE 91
				29 01 00 00 00 00 02 AF 03
				29 01 00 00 00 00 02 B0 CD
				29 01 00 00 00 00 02 B1 03
				29 01 00 00 00 00 02 B2 D3
				29 01 00 00 00 00 02 B3 00
				29 01 00 00 00 00 02 B4 BD
				29 01 00 00 00 00 02 B5 00
				29 01 00 00 00 00 02 B6 C6
				29 01 00 00 00 00 02 B7 00
				29 01 00 00 00 00 02 B8 D6
				29 01 00 00 00 00 02 B9 00
				29 01 00 00 00 00 02 BA E4
				29 01 00 00 00 00 02 BB 00
				29 01 00 00 00 00 02 BC F2
				29 01 00 00 00 00 02 BD 00
				29 01 00 00 00 00 02 BE FE
				29 01 00 00 00 00 02 BF 01
				29 01 00 00 00 00 02 C0 0A
				29 01 00 00 00 00 02 C1 01
				29 01 00 00 00 00 02 C2 15
				29 01 00 00 00 00 02 C3 01
				29 01 00 00 00 00 02 C4 20
				29 01 00 00 00 00 02 C5 01
				29 01 00 00 00 00 02 C6 45
				29 01 00 00 00 00 02 C7 01
				29 01 00 00 00 00 02 C8 64
				29 01 00 00 00 00 02 C9 01
				29 01 00 00 00 00 02 CA 99
				29 01 00 00 00 00 02 CB 01
				29 01 00 00 00 00 02 CC C3
				29 01 00 00 00 00 02 CD 02
				29 01 00 00 00 00 02 CE 08
				29 01 00 00 00 00 02 CF 02
				29 01 00 00 00 00 02 D0 40
				29 01 00 00 00 00 02 D1 02
				29 01 00 00 00 00 02 D2 42
				29 01 00 00 00 00 02 D3 02
				29 01 00 00 00 00 02 D4 75
				29 01 00 00 00 00 02 D5 02
				29 01 00 00 00 00 02 D6 AC
				29 01 00 00 00 00 02 D7 02
				29 01 00 00 00 00 02 D8 CD
				29 01 00 00 00 00 02 D9 02
				29 01 00 00 00 00 02 DA FB
				29 01 00 00 00 00 02 DB 03
				29 01 00 00 00 00 02 DC 19
				29 01 00 00 00 00 02 DD 03
				29 01 00 00 00 00 02 DE 3C
				29 01 00 00 00 00 02 DF 03
				29 01 00 00 00 00 02 E0 48
				29 01 00 00 00 00 02 E1 03
				29 01 00 00 00 00 02 E2 51
				29 01 00 00 00 00 02 E3 03
				29 01 00 00 00 00 02 E4 5E
				29 01 00 00 00 00 02 E5 03
				29 01 00 00 00 00 02 E6 6C
				29 01 00 00 00 00 02 E7 03
				29 01 00 00 00 00 02 E8 7D
				29 01 00 00 00 00 02 E9 03
				29 01 00 00 00 00 02 EA 91
				29 01 00 00 00 00 02 EB 03
				29 01 00 00 00 00 02 EC CD
				29 01 00 00 00 00 02 ED 03
				29 01 00 00 00 00 02 EE D3
				29 01 00 00 00 00 02 EF 00
				29 01 00 00 00 00 02 F0 BD
				29 01 00 00 00 00 02 F1 00
				29 01 00 00 00 00 02 F2 C5
				29 01 00 00 00 00 02 F3 00
				29 01 00 00 00 00 02 F4 D5
				29 01 00 00 00 00 02 F5 00
				29 01 00 00 00 00 02 F6 E4
				29 01 00 00 00 00 02 F7 00
				29 01 00 00 00 00 02 F8 F1
				29 01 00 00 00 00 02 F9 00
				29 01 00 00 00 00 02 FA FC
				29 01 00 00 00 00 02 FF 21
				29 01 00 00 00 00 02 00 01
				29 01 00 00 00 00 02 01 09
				29 01 00 00 00 00 02 02 01
				29 01 00 00 00 00 02 03 14
				29 01 00 00 00 00 02 04 01
				29 01 00 00 00 00 02 05 1D
				29 01 00 00 00 00 02 06 01
				29 01 00 00 00 00 02 07 44
				29 01 00 00 00 00 02 08 01
				29 01 00 00 00 00 02 09 61
				29 01 00 00 00 00 02 0A 01
				29 01 00 00 00 00 02 0B 95
				29 01 00 00 00 00 02 0C 01
				29 01 00 00 00 00 02 0D C2
				29 01 00 00 00 00 02 0E 02
				29 01 00 00 00 00 02 0F 04
				29 01 00 00 00 00 02 10 02
				29 01 00 00 00 00 02 11 3C
				29 01 00 00 00 00 02 12 02
				29 01 00 00 00 00 02 13 3E
				29 01 00 00 00 00 02 14 02
				29 01 00 00 00 00 02 15 73
				29 01 00 00 00 00 02 16 02
				29 01 00 00 00 00 02 17 AA
				29 01 00 00 00 00 02 18 02
				29 01 00 00 00 00 02 19 CC
				29 01 00 00 00 00 02 1A 02
				29 01 00 00 00 00 02 1B F9
				29 01 00 00 00 00 02 1C 03
				29 01 00 00 00 00 02 1D 18
				29 01 00 00 00 00 02 1E 03
				29 01 00 00 00 00 02 1F 3B
				29 01 00 00 00 00 02 20 03
				29 01 00 00 00 00 02 21 47
				29 01 00 00 00 00 02 22 03
				29 01 00 00 00 00 02 23 53
				29 01 00 00 00 00 02 24 03
				29 01 00 00 00 00 02 25 60
				29 01 00 00 00 00 02 26 03
				29 01 00 00 00 00 02 27 70
				29 01 00 00 00 00 02 28 03
				29 01 00 00 00 00 02 29 84
				29 01 00 00 00 00 02 2A 03
				29 01 00 00 00 00 02 2B A4
				29 01 00 00 00 00 02 2D 03
				29 01 00 00 00 00 02 2F CC
				29 01 00 00 00 00 02 30 03
				29 01 00 00 00 00 02 31 D3
				29 01 00 00 00 00 02 32 00
				29 01 00 00 00 00 02 33 BD
				29 01 00 00 00 00 02 34 00
				29 01 00 00 00 00 02 35 C5
				29 01 00 00 00 00 02 36 00
				29 01 00 00 00 00 02 37 D5
				29 01 00 00 00 00 02 38 00
				29 01 00 00 00 00 02 39 E4
				29 01 00 00 00 00 02 3A 00
				29 01 00 00 00 00 02 3B F1
				29 01 00 00 00 00 02 3D 00
				29 01 00 00 00 00 02 3F FC
				29 01 00 00 00 00 02 40 01
				29 01 00 00 00 00 02 41 09
				29 01 00 00 00 00 02 42 01
				29 01 00 00 00 00 02 43 14
				29 01 00 00 00 00 02 44 01
				29 01 00 00 00 00 02 45 1D
				29 01 00 00 00 00 02 46 01
				29 01 00 00 00 00 02 47 44
				29 01 00 00 00 00 02 48 01
				29 01 00 00 00 00 02 49 61
				29 01 00 00 00 00 02 4A 01
				29 01 00 00 00 00 02 4B 95
				29 01 00 00 00 00 02 4C 01
				29 01 00 00 00 00 02 4D C2
				29 01 00 00 00 00 02 4E 02
				29 01 00 00 00 00 02 4F 04
				29 01 00 00 00 00 02 50 02
				29 01 00 00 00 00 02 51 3C
				29 01 00 00 00 00 02 52 02
				29 01 00 00 00 00 02 53 3E
				29 01 00 00 00 00 02 54 02
				29 01 00 00 00 00 02 55 73
				29 01 00 00 00 00 02 56 02
				29 01 00 00 00 00 02 58 AA
				29 01 00 00 00 00 02 59 02
				29 01 00 00 00 00 02 5A CC
				29 01 00 00 00 00 02 5B 02
				29 01 00 00 00 00 02 5C F9
				29 01 00 00 00 00 02 5D 03
				29 01 00 00 00 00 02 5E 18
				29 01 00 00 00 00 02 5F 03
				29 01 00 00 00 00 02 60 3B
				29 01 00 00 00 00 02 61 03
				29 01 00 00 00 00 02 62 47
				29 01 00 00 00 00 02 63 03
				29 01 00 00 00 00 02 64 53
				29 01 00 00 00 00 02 65 03
				29 01 00 00 00 00 02 66 60
				29 01 00 00 00 00 02 67 03
				29 01 00 00 00 00 02 68 70
				29 01 00 00 00 00 02 69 03
				29 01 00 00 00 00 02 6A 84
				29 01 00 00 00 00 02 6B 03
				29 01 00 00 00 00 02 6C A4
				29 01 00 00 00 00 02 6D 03
				29 01 00 00 00 00 02 6E CC
				29 01 00 00 00 00 02 6F 03
				29 01 00 00 00 00 02 70 D3
				29 01 00 00 00 00 02 71 01
				29 01 00 00 00 00 02 72 0D
				29 01 00 00 00 00 02 73 01
				29 01 00 00 00 00 02 74 12
				29 01 00 00 00 00 02 75 01
				29 01 00 00 00 00 02 76 1C
				29 01 00 00 00 00 02 77 01
				29 01 00 00 00 00 02 78 26
				29 01 00 00 00 00 02 79 01
				29 01 00 00 00 00 02 7A 2F
				29 01 00 00 00 00 02 7B 01
				29 01 00 00 00 00 02 7C 37
				29 01 00 00 00 00 02 7D 01
				29 01 00 00 00 00 02 7E 40
				29 01 00 00 00 00 02 7F 01
				29 01 00 00 00 00 02 80 48
				29 01 00 00 00 00 02 81 01
				29 01 00 00 00 00 02 82 4F
				29 01 00 00 00 00 02 83 01
				29 01 00 00 00 00 02 84 6D
				29 01 00 00 00 00 02 85 01
				29 01 00 00 00 00 02 86 85
				29 01 00 00 00 00 02 87 01
				29 01 00 00 00 00 02 88 B1
				29 01 00 00 00 00 02 89 01
				29 01 00 00 00 00 02 8A D8
				29 01 00 00 00 00 02 8B 02
				29 01 00 00 00 00 02 8C 14
				29 01 00 00 00 00 02 8D 02
				29 01 00 00 00 00 02 8E 48
				29 01 00 00 00 00 02 8F 02
				29 01 00 00 00 00 02 90 4A
				29 01 00 00 00 00 02 91 02
				29 01 00 00 00 00 02 92 7D
				29 01 00 00 00 00 02 93 02
				29 01 00 00 00 00 02 94 B2
				29 01 00 00 00 00 02 95 02
				29 01 00 00 00 00 02 96 D4
				29 01 00 00 00 00 02 97 03
				29 01 00 00 00 00 02 98 05
				29 01 00 00 00 00 02 99 03
				29 01 00 00 00 00 02 9A 22
				29 01 00 00 00 00 02 9B 03
				29 01 00 00 00 00 02 9C 50
				29 01 00 00 00 00 02 9D 03
				29 01 00 00 00 00 02 9E 63
				29 01 00 00 00 00 02 9F 03
				29 01 00 00 00 00 02 A0 79
				29 01 00 00 00 00 02 A2 03
				29 01 00 00 00 00 02 A3 8C
				29 01 00 00 00 00 02 A4 03
				29 01 00 00 00 00 02 A5 93
				29 01 00 00 00 00 02 A6 03
				29 01 00 00 00 00 02 A7 94
				29 01 00 00 00 00 02 A9 03
				29 01 00 00 00 00 02 AA B0
				29 01 00 00 00 00 02 AB 03
				29 01 00 00 00 00 02 AC D0
				29 01 00 00 00 00 02 AD 03
				29 01 00 00 00 00 02 AE D3
				29 01 00 00 00 00 02 AF 01
				29 01 00 00 00 00 02 B0 0D
				29 01 00 00 00 00 02 B1 01
				29 01 00 00 00 00 02 B2 12
				29 01 00 00 00 00 02 B3 01
				29 01 00 00 00 00 02 B4 1C
				29 01 00 00 00 00 02 B5 01
				29 01 00 00 00 00 02 B6 26
				29 01 00 00 00 00 02 B7 01
				29 01 00 00 00 00 02 B8 2F
				29 01 00 00 00 00 02 B9 01
				29 01 00 00 00 00 02 BA 37
				29 01 00 00 00 00 02 BB 01
				29 01 00 00 00 00 02 BC 40
				29 01 00 00 00 00 02 BD 01
				29 01 00 00 00 00 02 BE 48
				29 01 00 00 00 00 02 BF 01
				29 01 00 00 00 00 02 C0 4F
				29 01 00 00 00 00 02 C1 01
				29 01 00 00 00 00 02 C2 6D
				29 01 00 00 00 00 02 C3 01
				29 01 00 00 00 00 02 C4 85
				29 01 00 00 00 00 02 C5 01
				29 01 00 00 00 00 02 C6 B1
				29 01 00 00 00 00 02 C7 01
				29 01 00 00 00 00 02 C8 D8
				29 01 00 00 00 00 02 C9 02
				29 01 00 00 00 00 02 CA 14
				29 01 00 00 00 00 02 CB 02
				29 01 00 00 00 00 02 CC 48
				29 01 00 00 00 00 02 CD 02
				29 01 00 00 00 00 02 CE 4A
				29 01 00 00 00 00 02 CF 02
				29 01 00 00 00 00 02 D0 7D
				29 01 00 00 00 00 02 D1 02
				29 01 00 00 00 00 02 D2 B2
				29 01 00 00 00 00 02 D3 02
				29 01 00 00 00 00 02 D4 D4
				29 01 00 00 00 00 02 D5 03
				29 01 00 00 00 00 02 D6 05
				29 01 00 00 00 00 02 D7 03
				29 01 00 00 00 00 02 D8 22
				29 01 00 00 00 00 02 D9 03
				29 01 00 00 00 00 02 DA 50
				29 01 00 00 00 00 02 DB 03
				29 01 00 00 00 00 02 DC 63
				29 01 00 00 00 00 02 DD 03
				29 01 00 00 00 00 02 DE 79
				29 01 00 00 00 00 02 DF 03
				29 01 00 00 00 00 02 E0 8C
				29 01 00 00 00 00 02 E1 03
				29 01 00 00 00 00 02 E2 93
				29 01 00 00 00 00 02 E3 03
				29 01 00 00 00 00 02 E4 94
				29 01 00 00 00 00 02 E5 03
				29 01 00 00 00 00 02 E6 B0
				29 01 00 00 00 00 02 E7 03
				29 01 00 00 00 00 02 E8 D0
				29 01 00 00 00 00 02 E9 03
				29 01 00 00 00 00 02 EA D3];
		fih,mdss-dsi-color-gamma-2-command = [
				29 01 00 00 00 00 02 75 00
				29 01 00 00 00 00 02 76 F1
				29 01 00 00 00 00 02 77 00
				29 01 00 00 00 00 02 78 F8
				29 01 00 00 00 00 02 79 01
				29 01 00 00 00 00 02 7A 03
				29 01 00 00 00 00 02 7B 01
				29 01 00 00 00 00 02 7C 0F
				29 01 00 00 00 00 02 7D 01
				29 01 00 00 00 00 02 7E 19
				29 01 00 00 00 00 02 7F 01
				29 01 00 00 00 00 02 80 24
				29 01 00 00 00 00 02 81 01
				29 01 00 00 00 00 02 82 2D
				29 01 00 00 00 00 02 83 01
				29 01 00 00 00 00 02 84 36
				29 01 00 00 00 00 02 85 01
				29 01 00 00 00 00 02 86 3F
				29 01 00 00 00 00 02 87 01
				29 01 00 00 00 00 02 88 5F
				29 01 00 00 00 00 02 89 01
				29 01 00 00 00 00 02 8A 7A
				29 01 00 00 00 00 02 8B 01
				29 01 00 00 00 00 02 8C A8
				29 01 00 00 00 00 02 8D 01
				29 01 00 00 00 00 02 8E D0
				29 01 00 00 00 00 02 8F 02
				29 01 00 00 00 00 02 90 11
				29 01 00 00 00 00 02 91 02
				29 01 00 00 00 00 02 92 46
				29 01 00 00 00 00 02 93 02
				29 01 00 00 00 00 02 94 48
				29 01 00 00 00 00 02 95 02
				29 01 00 00 00 00 02 96 79
				29 01 00 00 00 00 02 97 02
				29 01 00 00 00 00 02 98 B0
				29 01 00 00 00 00 02 99 02
				29 01 00 00 00 00 02 9A CF
				29 01 00 00 00 00 02 9B 02
				29 01 00 00 00 00 02 9C FF
				29 01 00 00 00 00 02 9D 03
				29 01 00 00 00 00 02 9E 1C
				29 01 00 00 00 00 02 9F 03
				29 01 00 00 00 00 02 A0 40
				29 01 00 00 00 00 02 A2 03
				29 01 00 00 00 00 02 A3 48
				29 01 00 00 00 00 02 A4 03
				29 01 00 00 00 00 02 A5 53
				29 01 00 00 00 00 02 A6 03
				29 01 00 00 00 00 02 A7 60
				29 01 00 00 00 00 02 A9 03
				29 01 00 00 00 00 02 AA 6E
				29 01 00 00 00 00 02 AB 03
				29 01 00 00 00 00 02 AC 7E
				29 01 00 00 00 00 02 AD 03
				29 01 00 00 00 00 02 AE 92
				29 01 00 00 00 00 02 AF 03
				29 01 00 00 00 00 02 B0 CE
				29 01 00 00 00 00 02 B1 03
				29 01 00 00 00 00 02 B2 D3
				29 01 00 00 00 00 02 B3 00
				29 01 00 00 00 00 02 B4 F1
				29 01 00 00 00 00 02 B5 00
				29 01 00 00 00 00 02 B6 F8
				29 01 00 00 00 00 02 B7 01
				29 01 00 00 00 00 02 B8 03
				29 01 00 00 00 00 02 B9 01
				29 01 00 00 00 00 02 BA 0F
				29 01 00 00 00 00 02 BB 01
				29 01 00 00 00 00 02 BC 19
				29 01 00 00 00 00 02 BD 01
				29 01 00 00 00 00 02 BE 24
				29 01 00 00 00 00 02 BF 01
				29 01 00 00 00 00 02 C0 2D
				29 01 00 00 00 00 02 C1 01
				29 01 00 00 00 00 02 C2 36
				29 01 00 00 00 00 02 C3 01
				29 01 00 00 00 00 02 C4 3F
				29 01 00 00 00 00 02 C5 01
				29 01 00 00 00 00 02 C6 5F
				29 01 00 00 00 00 02 C7 01
				29 01 00 00 00 00 02 C8 7A
				29 01 00 00 00 00 02 C9 01
				29 01 00 00 00 00 02 CA A8
				29 01 00 00 00 00 02 CB 01
				29 01 00 00 00 00 02 CC D0
				29 01 00 00 00 00 02 CD 02
				29 01 00 00 00 00 02 CE 11
				29 01 00 00 00 00 02 CF 02
				29 01 00 00 00 00 02 D0 46
				29 01 00 00 00 00 02 D1 02
				29 01 00 00 00 00 02 D2 48
				29 01 00 00 00 00 02 D3 02
				29 01 00 00 00 00 02 D4 79
				29 01 00 00 00 00 02 D5 02
				29 01 00 00 00 00 02 D6 B0
				29 01 00 00 00 00 02 D7 02
				29 01 00 00 00 00 02 D8 CF
				29 01 00 00 00 00 02 D9 02
				29 01 00 00 00 00 02 DA FF
				29 01 00 00 00 00 02 DB 03
				29 01 00 00 00 00 02 DC 1C
				29 01 00 00 00 00 02 DD 03
				29 01 00 00 00 00 02 DE 40
				29 01 00 00 00 00 02 DF 03
				29 01 00 00 00 00 02 E0 48
				29 01 00 00 00 00 02 E1 03
				29 01 00 00 00 00 02 E2 53
				29 01 00 00 00 00 02 E3 03
				29 01 00 00 00 00 02 E4 60
				29 01 00 00 00 00 02 E5 03
				29 01 00 00 00 00 02 E6 6E
				29 01 00 00 00 00 02 E7 03
				29 01 00 00 00 00 02 E8 7E
				29 01 00 00 00 00 02 E9 03
				29 01 00 00 00 00 02 EA 92
				29 01 00 00 00 00 02 EB 03
				29 01 00 00 00 00 02 EC CE
				29 01 00 00 00 00 02 ED 03
				29 01 00 00 00 00 02 EE D3
				29 01 00 00 00 00 02 EF 00
				29 01 00 00 00 00 02 F0 E3
				29 01 00 00 00 00 02 F1 00
				29 01 00 00 00 00 02 F2 EA
				29 01 00 00 00 00 02 F3 00
				29 01 00 00 00 00 02 F4 F6
				29 01 00 00 00 00 02 F5 01
				29 01 00 00 00 00 02 F6 02
				29 01 00 00 00 00 02 F7 01
				29 01 00 00 00 00 02 F8 0C
				29 01 00 00 00 00 02 F9 01
				29 01 00 00 00 00 02 FA 18
				29 01 00 00 00 00 02 FF 21
				29 01 00 00 00 00 02 00 01
				29 01 00 00 00 00 02 01 20
				29 01 00 00 00 00 02 02 01
				29 01 00 00 00 00 02 03 2A
				29 01 00 00 00 00 02 04 01
				29 01 00 00 00 00 02 05 33
				29 01 00 00 00 00 02 06 01
				29 01 00 00 00 00 02 07 54
				29 01 00 00 00 00 02 08 01
				29 01 00 00 00 00 02 09 70
				29 01 00 00 00 00 02 0A 01
				29 01 00 00 00 00 02 0B A0
				29 01 00 00 00 00 02 0C 01
				29 01 00 00 00 00 02 0D C9
				29 01 00 00 00 00 02 0E 02
				29 01 00 00 00 00 02 0F 0B
				29 01 00 00 00 00 02 10 02
				29 01 00 00 00 00 02 11 41
				29 01 00 00 00 00 02 12 02
				29 01 00 00 00 00 02 13 42
				29 01 00 00 00 00 02 14 02
				29 01 00 00 00 00 02 15 75
				29 01 00 00 00 00 02 16 02
				29 01 00 00 00 00 02 17 AC
				29 01 00 00 00 00 02 18 02
				29 01 00 00 00 00 02 19 CB
				29 01 00 00 00 00 02 1A 02
				29 01 00 00 00 00 02 1B FB
				29 01 00 00 00 00 02 1C 03
				29 01 00 00 00 00 02 1D 1A
				29 01 00 00 00 00 02 1E 03
				29 01 00 00 00 00 02 1F 3D
				29 01 00 00 00 00 02 20 03
				29 01 00 00 00 00 02 21 48
				29 01 00 00 00 00 02 22 03
				29 01 00 00 00 00 02 23 54
				29 01 00 00 00 00 02 24 03
				29 01 00 00 00 00 02 25 62
				29 01 00 00 00 00 02 26 03
				29 01 00 00 00 00 02 27 71
				29 01 00 00 00 00 02 28 03
				29 01 00 00 00 00 02 29 85
				29 01 00 00 00 00 02 2A 03
				29 01 00 00 00 00 02 2B A5
				29 01 00 00 00 00 02 2D 03
				29 01 00 00 00 00 02 2F CD
				29 01 00 00 00 00 02 30 03
				29 01 00 00 00 00 02 31 D3
				29 01 00 00 00 00 02 32 00
				29 01 00 00 00 00 02 33 E3
				29 01 00 00 00 00 02 34 00
				29 01 00 00 00 00 02 35 EA
				29 01 00 00 00 00 02 36 00
				29 01 00 00 00 00 02 37 F6
				29 01 00 00 00 00 02 38 01
				29 01 00 00 00 00 02 39 02
				29 01 00 00 00 00 02 3A 01
				29 01 00 00 00 00 02 3B 0C
				29 01 00 00 00 00 02 3D 01
				29 01 00 00 00 00 02 3F 18
				29 01 00 00 00 00 02 40 01
				29 01 00 00 00 00 02 41 20
				29 01 00 00 00 00 02 42 01
				29 01 00 00 00 00 02 43 2A
				29 01 00 00 00 00 02 44 01
				29 01 00 00 00 00 02 45 33
				29 01 00 00 00 00 02 46 01
				29 01 00 00 00 00 02 47 54
				29 01 00 00 00 00 02 48 01
				29 01 00 00 00 00 02 49 70
				29 01 00 00 00 00 02 4A 01
				29 01 00 00 00 00 02 4B A0
				29 01 00 00 00 00 02 4C 01
				29 01 00 00 00 00 02 4D C9
				29 01 00 00 00 00 02 4E 02
				29 01 00 00 00 00 02 4F 0B
				29 01 00 00 00 00 02 50 02
				29 01 00 00 00 00 02 51 41
				29 01 00 00 00 00 02 52 02
				29 01 00 00 00 00 02 53 42
				29 01 00 00 00 00 02 54 02
				29 01 00 00 00 00 02 55 75
				29 01 00 00 00 00 02 56 02
				29 01 00 00 00 00 02 58 AC
				29 01 00 00 00 00 02 59 02
				29 01 00 00 00 00 02 5A CB
				29 01 00 00 00 00 02 5B 02
				29 01 00 00 00 00 02 5C FB
				29 01 00 00 00 00 02 5D 03
				29 01 00 00 00 00 02 5E 1A
				29 01 00 00 00 00 02 5F 03
				29 01 00 00 00 00 02 60 3D
				29 01 00 00 00 00 02 61 03
				29 01 00 00 00 00 02 62 48
				29 01 00 00 00 00 02 63 03
				29 01 00 00 00 00 02 64 54
				29 01 00 00 00 00 02 65 03
				29 01 00 00 00 00 02 66 62
				29 01 00 00 00 00 02 67 03
				29 01 00 00 00 00 02 68 71
				29 01 00 00 00 00 02 69 03
				29 01 00 00 00 00 02 6A 85
				29 01 00 00 00 00 02 6B 03
				29 01 00 00 00 00 02 6C A5
				29 01 00 00 00 00 02 6D 03
				29 01 00 00 00 00 02 6E CD
				29 01 00 00 00 00 02 6F 03
				29 01 00 00 00 00 02 70 D3
				29 01 00 00 00 00 02 71 01
				29 01 00 00 00 00 02 72 72
				29 01 00 00 00 00 02 73 01
				29 01 00 00 00 00 02 74 75
				29 01 00 00 00 00 02 75 01
				29 01 00 00 00 00 02 76 7A
				29 01 00 00 00 00 02 77 01
				29 01 00 00 00 00 02 78 80
				29 01 00 00 00 00 02 79 01
				29 01 00 00 00 00 02 7A 85
				29 01 00 00 00 00 02 7B 01
				29 01 00 00 00 00 02 7C 8B
				29 01 00 00 00 00 02 7D 01
				29 01 00 00 00 00 02 7E 90
				29 01 00 00 00 00 02 7F 01
				29 01 00 00 00 00 02 80 95
				29 01 00 00 00 00 02 81 01
				29 01 00 00 00 00 02 82 9A
				29 01 00 00 00 00 02 83 01
				29 01 00 00 00 00 02 84 AD
				29 01 00 00 00 00 02 85 01
				29 01 00 00 00 00 02 86 BF
				29 01 00 00 00 00 02 87 01
				29 01 00 00 00 00 02 88 DF
				29 01 00 00 00 00 02 89 01
				29 01 00 00 00 00 02 8A FC
				29 01 00 00 00 00 02 8B 02
				29 01 00 00 00 00 02 8C 2F
				29 01 00 00 00 00 02 8D 02
				29 01 00 00 00 00 02 8E 5C
				29 01 00 00 00 00 02 8F 02
				29 01 00 00 00 00 02 90 5D
				29 01 00 00 00 00 02 91 02
				29 01 00 00 00 00 02 92 8A
				29 01 00 00 00 00 02 93 02
				29 01 00 00 00 00 02 94 BD
				29 01 00 00 00 00 02 95 02
				29 01 00 00 00 00 02 96 DD
				29 01 00 00 00 00 02 97 03
				29 01 00 00 00 00 02 98 11
				29 01 00 00 00 00 02 99 03
				29 01 00 00 00 00 02 9A 30
				29 01 00 00 00 00 02 9B 03
				29 01 00 00 00 00 02 9C 63
				29 01 00 00 00 00 02 9D 03
				29 01 00 00 00 00 02 9E 78
				29 01 00 00 00 00 02 9F 03
				29 01 00 00 00 00 02 A0 89
				29 01 00 00 00 00 02 A2 03
				29 01 00 00 00 00 02 A3 8B
				29 01 00 00 00 00 02 A4 03
				29 01 00 00 00 00 02 A5 8C
				29 01 00 00 00 00 02 A6 03
				29 01 00 00 00 00 02 A7 8F
				29 01 00 00 00 00 02 A9 03
				29 01 00 00 00 00 02 AA B1
				29 01 00 00 00 00 02 AB 03
				29 01 00 00 00 00 02 AC CF
				29 01 00 00 00 00 02 AD 03
				29 01 00 00 00 00 02 AE D3
				29 01 00 00 00 00 02 AF 01
				29 01 00 00 00 00 02 B0 72
				29 01 00 00 00 00 02 B1 01
				29 01 00 00 00 00 02 B2 75
				29 01 00 00 00 00 02 B3 01
				29 01 00 00 00 00 02 B4 7A
				29 01 00 00 00 00 02 B5 01
				29 01 00 00 00 00 02 B6 80
				29 01 00 00 00 00 02 B7 01
				29 01 00 00 00 00 02 B8 85
				29 01 00 00 00 00 02 B9 01
				29 01 00 00 00 00 02 BA 8B
				29 01 00 00 00 00 02 BB 01
				29 01 00 00 00 00 02 BC 90
				29 01 00 00 00 00 02 BD 01
				29 01 00 00 00 00 02 BE 95
				29 01 00 00 00 00 02 BF 01
				29 01 00 00 00 00 02 C0 9A
				29 01 00 00 00 00 02 C1 01
				29 01 00 00 00 00 02 C2 AD
				29 01 00 00 00 00 02 C3 01
				29 01 00 00 00 00 02 C4 BF
				29 01 00 00 00 00 02 C5 01
				29 01 00 00 00 00 02 C6 DF
				29 01 00 00 00 00 02 C7 01
				29 01 00 00 00 00 02 C8 FC
				29 01 00 00 00 00 02 C9 02
				29 01 00 00 00 00 02 CA 2F
				29 01 00 00 00 00 02 CB 02
				29 01 00 00 00 00 02 CC 5C
				29 01 00 00 00 00 02 CD 02
				29 01 00 00 00 00 02 CE 5D
				29 01 00 00 00 00 02 CF 02
				29 01 00 00 00 00 02 D0 8A
				29 01 00 00 00 00 02 D1 02
				29 01 00 00 00 00 02 D2 BD
				29 01 00 00 00 00 02 D3 02
				29 01 00 00 00 00 02 D4 DD
				29 01 00 00 00 00 02 D5 03
				29 01 00 00 00 00 02 D6 11
				29 01 00 00 00 00 02 D7 03
				29 01 00 00 00 00 02 D8 30
				29 01 00 00 00 00 02 D9 03
				29 01 00 00 00 00 02 DA 63
				29 01 00 00 00 00 02 DB 03
				29 01 00 00 00 00 02 DC 78
				29 01 00 00 00 00 02 DD 03
				29 01 00 00 00 00 02 DE 89
				29 01 00 00 00 00 02 DF 03
				29 01 00 00 00 00 02 E0 8B
				29 01 00 00 00 00 02 E1 03
				29 01 00 00 00 00 02 E2 8C
				29 01 00 00 00 00 02 E3 03
				29 01 00 00 00 00 02 E4 8F
				29 01 00 00 00 00 02 E5 03
				29 01 00 00 00 00 02 E6 B1
				29 01 00 00 00 00 02 E7 03
				29 01 00 00 00 00 02 E8 CF
				29 01 00 00 00 00 02 E9 03
				29 01 00 00 00 00 02 EA D3];
		fih,mdss-dsi-color-gamma-3-command = [
				29 01 00 00 00 00 02 75 01
				29 01 00 00 00 00 02 76 94
				29 01 00 00 00 00 02 77 01
				29 01 00 00 00 00 02 78 97
				29 01 00 00 00 00 02 79 01
				29 01 00 00 00 00 02 7A 9B
				29 01 00 00 00 00 02 7B 01
				29 01 00 00 00 00 02 7C A0
				29 01 00 00 00 00 02 7D 01
				29 01 00 00 00 00 02 7E A5
				29 01 00 00 00 00 02 7F 01
				29 01 00 00 00 00 02 80 A9
				29 01 00 00 00 00 02 81 01
				29 01 00 00 00 00 02 82 AE
				29 01 00 00 00 00 02 83 01
				29 01 00 00 00 00 02 84 B2
				29 01 00 00 00 00 02 85 01
				29 01 00 00 00 00 02 86 B7
				29 01 00 00 00 00 02 87 01
				29 01 00 00 00 00 02 88 C7
				29 01 00 00 00 00 02 89 01
				29 01 00 00 00 00 02 8A D6
				29 01 00 00 00 00 02 8B 01
				29 01 00 00 00 00 02 8C F3
				29 01 00 00 00 00 02 8D 02
				29 01 00 00 00 00 02 8E 0D
				29 01 00 00 00 00 02 8F 02
				29 01 00 00 00 00 02 90 3B
				29 01 00 00 00 00 02 91 02
				29 01 00 00 00 00 02 92 65
				29 01 00 00 00 00 02 93 02
				29 01 00 00 00 00 02 94 66
				29 01 00 00 00 00 02 95 02
				29 01 00 00 00 00 02 96 91
				29 01 00 00 00 00 02 97 02
				29 01 00 00 00 00 02 98 C2
				29 01 00 00 00 00 02 99 02
				29 01 00 00 00 00 02 9A E2
				29 01 00 00 00 00 02 9B 03
				29 01 00 00 00 00 02 9C 10
				29 01 00 00 00 00 02 9D 03
				29 01 00 00 00 00 02 9E 29
				29 01 00 00 00 00 02 9F 03
				29 01 00 00 00 00 02 A0 49
				29 01 00 00 00 00 02 A2 03
				29 01 00 00 00 00 02 A3 53
				29 01 00 00 00 00 02 A4 03
				29 01 00 00 00 00 02 A5 5E
				29 01 00 00 00 00 02 A6 03
				29 01 00 00 00 00 02 A7 6A
				29 01 00 00 00 00 02 A9 03
				29 01 00 00 00 00 02 AA 79
				29 01 00 00 00 00 02 AB 03
				29 01 00 00 00 00 02 AC 86
				29 01 00 00 00 00 02 AD 03
				29 01 00 00 00 00 02 AE 98
				29 01 00 00 00 00 02 AF 03
				29 01 00 00 00 00 02 B0 CF
				29 01 00 00 00 00 02 B1 03
				29 01 00 00 00 00 02 B2 D3
				29 01 00 00 00 00 02 B3 01
				29 01 00 00 00 00 02 B4 94
				29 01 00 00 00 00 02 B5 01
				29 01 00 00 00 00 02 B6 97
				29 01 00 00 00 00 02 B7 01
				29 01 00 00 00 00 02 B8 9B
				29 01 00 00 00 00 02 B9 01
				29 01 00 00 00 00 02 BA A0
				29 01 00 00 00 00 02 BB 01
				29 01 00 00 00 00 02 BC A5
				29 01 00 00 00 00 02 BD 01
				29 01 00 00 00 00 02 BE A9
				29 01 00 00 00 00 02 BF 01
				29 01 00 00 00 00 02 C0 AE
				29 01 00 00 00 00 02 C1 01
				29 01 00 00 00 00 02 C2 B2
				29 01 00 00 00 00 02 C3 01
				29 01 00 00 00 00 02 C4 B7
				29 01 00 00 00 00 02 C5 01
				29 01 00 00 00 00 02 C6 C7
				29 01 00 00 00 00 02 C7 01
				29 01 00 00 00 00 02 C8 D6
				29 01 00 00 00 00 02 C9 01
				29 01 00 00 00 00 02 CA F3
				29 01 00 00 00 00 02 CB 02
				29 01 00 00 00 00 02 CC 0D
				29 01 00 00 00 00 02 CD 02
				29 01 00 00 00 00 02 CE 3B
				29 01 00 00 00 00 02 CF 02
				29 01 00 00 00 00 02 D0 65
				29 01 00 00 00 00 02 D1 02
				29 01 00 00 00 00 02 D2 66
				29 01 00 00 00 00 02 D3 02
				29 01 00 00 00 00 02 D4 91
				29 01 00 00 00 00 02 D5 02
				29 01 00 00 00 00 02 D6 C2
				29 01 00 00 00 00 02 D7 02
				29 01 00 00 00 00 02 D8 E2
				29 01 00 00 00 00 02 D9 03
				29 01 00 00 00 00 02 DA 10
				29 01 00 00 00 00 02 DB 03
				29 01 00 00 00 00 02 DC 29
				29 01 00 00 00 00 02 DD 03
				29 01 00 00 00 00 02 DE 49
				29 01 00 00 00 00 02 DF 03
				29 01 00 00 00 00 02 E0 53
				29 01 00 00 00 00 02 E1 03
				29 01 00 00 00 00 02 E2 5E
				29 01 00 00 00 00 02 E3 03
				29 01 00 00 00 00 02 E4 6A
				29 01 00 00 00 00 02 E5 03
				29 01 00 00 00 00 02 E6 79
				29 01 00 00 00 00 02 E7 03
				29 01 00 00 00 00 02 E8 86
				29 01 00 00 00 00 02 E9 03
				29 01 00 00 00 00 02 EA 98
				29 01 00 00 00 00 02 EB 03
				29 01 00 00 00 00 02 EC CF
				29 01 00 00 00 00 02 ED 03
				29 01 00 00 00 00 02 EE D3
				29 01 00 00 00 00 02 EF 01
				29 01 00 00 00 00 02 F0 8F
				29 01 00 00 00 00 02 F1 01
				29 01 00 00 00 00 02 F2 91
				29 01 00 00 00 00 02 F3 01
				29 01 00 00 00 00 02 F4 96
				29 01 00 00 00 00 02 F5 01
				29 01 00 00 00 00 02 F6 9B
				29 01 00 00 00 00 02 F7 01
				29 01 00 00 00 00 02 F8 A0
				29 01 00 00 00 00 02 F9 01
				29 01 00 00 00 00 02 FA A4
				29 01 00 00 00 00 02 FF 21
				29 01 00 00 00 00 02 00 01
				29 01 00 00 00 00 02 01 A9
				29 01 00 00 00 00 02 02 01
				29 01 00 00 00 00 02 03 AE
				29 01 00 00 00 00 02 04 01
				29 01 00 00 00 00 02 05 B2
				29 01 00 00 00 00 02 06 01
				29 01 00 00 00 00 02 07 C2
				29 01 00 00 00 00 02 08 01
				29 01 00 00 00 00 02 09 D2
				29 01 00 00 00 00 02 0A 01
				29 01 00 00 00 00 02 0B EF
				29 01 00 00 00 00 02 0C 02
				29 01 00 00 00 00 02 0D 09
				29 01 00 00 00 00 02 0E 02
				29 01 00 00 00 00 02 0F 37
				29 01 00 00 00 00 02 10 02
				29 01 00 00 00 00 02 11 61
				29 01 00 00 00 00 02 12 02
				29 01 00 00 00 00 02 13 62
				29 01 00 00 00 00 02 14 02
				29 01 00 00 00 00 02 15 8E
				29 01 00 00 00 00 02 16 02
				29 01 00 00 00 00 02 17 BF
				29 01 00 00 00 00 02 18 02
				29 01 00 00 00 00 02 19 E0
				29 01 00 00 00 00 02 1A 03
				29 01 00 00 00 00 02 1B 0E
				29 01 00 00 00 00 02 1C 03
				29 01 00 00 00 00 02 1D 27
				29 01 00 00 00 00 02 1E 03
				29 01 00 00 00 00 02 1F 4A
				29 01 00 00 00 00 02 20 03
				29 01 00 00 00 00 02 21 54
				29 01 00 00 00 00 02 22 03
				29 01 00 00 00 00 02 23 60
				29 01 00 00 00 00 02 24 03
				29 01 00 00 00 00 02 25 6D
				29 01 00 00 00 00 02 26 03
				29 01 00 00 00 00 02 27 7D
				29 01 00 00 00 00 02 28 03
				29 01 00 00 00 00 02 29 90
				29 01 00 00 00 00 02 2A 03
				29 01 00 00 00 00 02 2B B0
				29 01 00 00 00 00 02 2D 03
				29 01 00 00 00 00 02 2F CF
				29 01 00 00 00 00 02 30 03
				29 01 00 00 00 00 02 31 D3
				29 01 00 00 00 00 02 32 01
				29 01 00 00 00 00 02 33 8F
				29 01 00 00 00 00 02 34 01
				29 01 00 00 00 00 02 35 91
				29 01 00 00 00 00 02 36 01
				29 01 00 00 00 00 02 37 96
				29 01 00 00 00 00 02 38 01
				29 01 00 00 00 00 02 39 9B
				29 01 00 00 00 00 02 3A 01
				29 01 00 00 00 00 02 3B A0
				29 01 00 00 00 00 02 3D 01
				29 01 00 00 00 00 02 3F A4
				29 01 00 00 00 00 02 40 01
				29 01 00 00 00 00 02 41 A9
				29 01 00 00 00 00 02 42 01
				29 01 00 00 00 00 02 43 AE
				29 01 00 00 00 00 02 44 01
				29 01 00 00 00 00 02 45 B2
				29 01 00 00 00 00 02 46 01
				29 01 00 00 00 00 02 47 C2
				29 01 00 00 00 00 02 48 01
				29 01 00 00 00 00 02 49 D2
				29 01 00 00 00 00 02 4A 01
				29 01 00 00 00 00 02 4B EF
				29 01 00 00 00 00 02 4C 02
				29 01 00 00 00 00 02 4D 09
				29 01 00 00 00 00 02 4E 02
				29 01 00 00 00 00 02 4F 37
				29 01 00 00 00 00 02 50 02
				29 01 00 00 00 00 02 51 61
				29 01 00 00 00 00 02 52 02
				29 01 00 00 00 00 02 53 62
				29 01 00 00 00 00 02 54 02
				29 01 00 00 00 00 02 55 8E
				29 01 00 00 00 00 02 56 02
				29 01 00 00 00 00 02 58 BF
				29 01 00 00 00 00 02 59 02
				29 01 00 00 00 00 02 5A E0
				29 01 00 00 00 00 02 5B 03
				29 01 00 00 00 00 02 5C 0E
				29 01 00 00 00 00 02 5D 03
				29 01 00 00 00 00 02 5E 27
				29 01 00 00 00 00 02 5F 03
				29 01 00 00 00 00 02 60 4A
				29 01 00 00 00 00 02 61 03
				29 01 00 00 00 00 02 62 54
				29 01 00 00 00 00 02 63 03
				29 01 00 00 00 00 02 64 60
				29 01 00 00 00 00 02 65 03
				29 01 00 00 00 00 02 66 6D
				29 01 00 00 00 00 02 67 03
				29 01 00 00 00 00 02 68 7D
				29 01 00 00 00 00 02 69 03
				29 01 00 00 00 00 02 6A 90
				29 01 00 00 00 00 02 6B 03
				29 01 00 00 00 00 02 6C B0
				29 01 00 00 00 00 02 6D 03
				29 01 00 00 00 00 02 6E CF
				29 01 00 00 00 00 02 6F 03
				29 01 00 00 00 00 02 70 D3
				29 01 00 00 00 00 02 71 01
				29 01 00 00 00 00 02 72 E1
				29 01 00 00 00 00 02 73 01
				29 01 00 00 00 00 02 74 E3
				29 01 00 00 00 00 02 75 01
				29 01 00 00 00 00 02 76 E5
				29 01 00 00 00 00 02 77 01
				29 01 00 00 00 00 02 78 E9
				29 01 00 00 00 00 02 79 01
				29 01 00 00 00 00 02 7A EC
				29 01 00 00 00 00 02 7B 01
				29 01 00 00 00 00 02 7C EF
				29 01 00 00 00 00 02 7D 01
				29 01 00 00 00 00 02 7E F2
				29 01 00 00 00 00 02 7F 01
				29 01 00 00 00 00 02 80 F4
				29 01 00 00 00 00 02 81 01
				29 01 00 00 00 00 02 82 F7
				29 01 00 00 00 00 02 83 02
				29 01 00 00 00 00 02 84 02
				29 01 00 00 00 00 02 85 02
				29 01 00 00 00 00 02 86 0D
				29 01 00 00 00 00 02 87 02
				29 01 00 00 00 00 02 88 21
				29 01 00 00 00 00 02 89 02
				29 01 00 00 00 00 02 8A 35
				29 01 00 00 00 00 02 8B 02
				29 01 00 00 00 00 02 8C 59
				29 01 00 00 00 00 02 8D 02
				29 01 00 00 00 00 02 8E 7D
				29 01 00 00 00 00 02 8F 02
				29 01 00 00 00 00 02 90 7E
				29 01 00 00 00 00 02 91 02
				29 01 00 00 00 00 02 92 A5
				29 01 00 00 00 00 02 93 02
				29 01 00 00 00 00 02 94 D4
				29 01 00 00 00 00 02 95 02
				29 01 00 00 00 00 02 96 F8
				29 01 00 00 00 00 02 97 03
				29 01 00 00 00 00 02 98 23
				29 01 00 00 00 00 02 99 03
				29 01 00 00 00 00 02 9A 47
				29 01 00 00 00 00 02 9B 03
				29 01 00 00 00 00 02 9C 91
				29 01 00 00 00 00 02 9D 03
				29 01 00 00 00 00 02 9E AE
				29 01 00 00 00 00 02 9F 03
				29 01 00 00 00 00 02 A0 AF
				29 01 00 00 00 00 02 A2 03
				29 01 00 00 00 00 02 A3 B0
				29 01 00 00 00 00 02 A4 03
				29 01 00 00 00 00 02 A5 B1
				29 01 00 00 00 00 02 A6 03
				29 01 00 00 00 00 02 A7 B2
				29 01 00 00 00 00 02 A9 03
				29 01 00 00 00 00 02 AA BB
				29 01 00 00 00 00 02 AB 03
				29 01 00 00 00 00 02 AC D0
				29 01 00 00 00 00 02 AD 03
				29 01 00 00 00 00 02 AE D3
				29 01 00 00 00 00 02 AF 01
				29 01 00 00 00 00 02 B0 E1
				29 01 00 00 00 00 02 B1 01
				29 01 00 00 00 00 02 B2 E3
				29 01 00 00 00 00 02 B3 01
				29 01 00 00 00 00 02 B4 E5
				29 01 00 00 00 00 02 B5 01
				29 01 00 00 00 00 02 B6 E9
				29 01 00 00 00 00 02 B7 01
				29 01 00 00 00 00 02 B8 EC
				29 01 00 00 00 00 02 B9 01
				29 01 00 00 00 00 02 BA EF
				29 01 00 00 00 00 02 BB 01
				29 01 00 00 00 00 02 BC F2
				29 01 00 00 00 00 02 BD 01
				29 01 00 00 00 00 02 BE F4
				29 01 00 00 00 00 02 BF 01
				29 01 00 00 00 00 02 C0 F7
				29 01 00 00 00 00 02 C1 02
				29 01 00 00 00 00 02 C2 02
				29 01 00 00 00 00 02 C3 02
				29 01 00 00 00 00 02 C4 0D
				29 01 00 00 00 00 02 C5 02
				29 01 00 00 00 00 02 C6 21
				29 01 00 00 00 00 02 C7 02
				29 01 00 00 00 00 02 C8 35
				29 01 00 00 00 00 02 C9 02
				29 01 00 00 00 00 02 CA 59
				29 01 00 00 00 00 02 CB 02
				29 01 00 00 00 00 02 CC 7D
				29 01 00 00 00 00 02 CD 02
				29 01 00 00 00 00 02 CE 7E
				29 01 00 00 00 00 02 CF 02
				29 01 00 00 00 00 02 D0 A5
				29 01 00 00 00 00 02 D1 02
				29 01 00 00 00 00 02 D2 D4
				29 01 00 00 00 00 02 D3 02
				29 01 00 00 00 00 02 D4 F8
				29 01 00 00 00 00 02 D5 03
				29 01 00 00 00 00 02 D6 23
				29 01 00 00 00 00 02 D7 03
				29 01 00 00 00 00 02 D8 47
				29 01 00 00 00 00 02 D9 03
				29 01 00 00 00 00 02 DA 91
				29 01 00 00 00 00 02 DB 03
				29 01 00 00 00 00 02 DC AE
				29 01 00 00 00 00 02 DD 03
				29 01 00 00 00 00 02 DE AF
				29 01 00 00 00 00 02 DF 03
				29 01 00 00 00 00 02 E0 B0
				29 01 00 00 00 00 02 E1 03
				29 01 00 00 00 00 02 E2 B1
				29 01 00 00 00 00 02 E3 03
				29 01 00 00 00 00 02 E4 B2
				29 01 00 00 00 00 02 E5 03
				29 01 00 00 00 00 02 E6 BB
				29 01 00 00 00 00 02 E7 03
				29 01 00 00 00 00 02 E8 D0
				29 01 00 00 00 00 02 E9 03
				29 01 00 00 00 00 02 EA D3];
		fih,mdss-dsi-color-gamma-4-command = [
				29 01 00 00 00 00 02 75 01
				29 01 00 00 00 00 02 76 AB
				29 01 00 00 00 00 02 77 01
				29 01 00 00 00 00 02 78 AD
				29 01 00 00 00 00 02 79 01
				29 01 00 00 00 00 02 7A B2
				29 01 00 00 00 00 02 7B 01
				29 01 00 00 00 00 02 7C B6
				29 01 00 00 00 00 02 7D 01
				29 01 00 00 00 00 02 7E BA
				29 01 00 00 00 00 02 7F 01
				29 01 00 00 00 00 02 80 BE
				29 01 00 00 00 00 02 81 01
				29 01 00 00 00 00 02 82 C2
				29 01 00 00 00 00 02 83 01
				29 01 00 00 00 00 02 84 C6
				29 01 00 00 00 00 02 85 01
				29 01 00 00 00 00 02 86 C9
				29 01 00 00 00 00 02 87 01
				29 01 00 00 00 00 02 88 D8
				29 01 00 00 00 00 02 89 01
				29 01 00 00 00 00 02 8A E6
				29 01 00 00 00 00 02 8B 02
				29 01 00 00 00 00 02 8C 00
				29 01 00 00 00 00 02 8D 02
				29 01 00 00 00 00 02 8E 18
				29 01 00 00 00 00 02 8F 02
				29 01 00 00 00 00 02 90 43
				29 01 00 00 00 00 02 91 02
				29 01 00 00 00 00 02 92 6C
				29 01 00 00 00 00 02 93 02
				29 01 00 00 00 00 02 94 6D
				29 01 00 00 00 00 02 95 02
				29 01 00 00 00 00 02 96 97
				29 01 00 00 00 00 02 97 02
				29 01 00 00 00 00 02 98 C6
				29 01 00 00 00 00 02 99 02
				29 01 00 00 00 00 02 9A E6
				29 01 00 00 00 00 02 9B 03
				29 01 00 00 00 00 02 9C 15
				29 01 00 00 00 00 02 9D 03
				29 01 00 00 00 00 02 9E 2B
				29 01 00 00 00 00 02 9F 03
				29 01 00 00 00 00 02 A0 4C
				29 01 00 00 00 00 02 A2 03
				29 01 00 00 00 00 02 A3 57
				29 01 00 00 00 00 02 A4 03
				29 01 00 00 00 00 02 A5 62
				29 01 00 00 00 00 02 A6 03
				29 01 00 00 00 00 02 A7 6B
				29 01 00 00 00 00 02 A9 03
				29 01 00 00 00 00 02 AA 78
				29 01 00 00 00 00 02 AB 03
				29 01 00 00 00 00 02 AC 87
				29 01 00 00 00 00 02 AD 03
				29 01 00 00 00 00 02 AE 99
				29 01 00 00 00 00 02 AF 03
				29 01 00 00 00 00 02 B0 CF
				29 01 00 00 00 00 02 B1 03
				29 01 00 00 00 00 02 B2 D3
				29 01 00 00 00 00 02 B3 01
				29 01 00 00 00 00 02 B4 AB
				29 01 00 00 00 00 02 B5 01
				29 01 00 00 00 00 02 B6 AD
				29 01 00 00 00 00 02 B7 01
				29 01 00 00 00 00 02 B8 B2
				29 01 00 00 00 00 02 B9 01
				29 01 00 00 00 00 02 BA B6
				29 01 00 00 00 00 02 BB 01
				29 01 00 00 00 00 02 BC BA
				29 01 00 00 00 00 02 BD 01
				29 01 00 00 00 00 02 BE BE
				29 01 00 00 00 00 02 BF 01
				29 01 00 00 00 00 02 C0 C2
				29 01 00 00 00 00 02 C1 01
				29 01 00 00 00 00 02 C2 C6
				29 01 00 00 00 00 02 C3 01
				29 01 00 00 00 00 02 C4 C9
				29 01 00 00 00 00 02 C5 01
				29 01 00 00 00 00 02 C6 D8
				29 01 00 00 00 00 02 C7 01
				29 01 00 00 00 00 02 C8 E6
				29 01 00 00 00 00 02 C9 02
				29 01 00 00 00 00 02 CA 00
				29 01 00 00 00 00 02 CB 02
				29 01 00 00 00 00 02 CC 18
				29 01 00 00 00 00 02 CD 02
				29 01 00 00 00 00 02 CE 43
				29 01 00 00 00 00 02 CF 02
				29 01 00 00 00 00 02 D0 6C
				29 01 00 00 00 00 02 D1 02
				29 01 00 00 00 00 02 D2 6D
				29 01 00 00 00 00 02 D3 02
				29 01 00 00 00 00 02 D4 97
				29 01 00 00 00 00 02 D5 02
				29 01 00 00 00 00 02 D6 C6
				29 01 00 00 00 00 02 D7 02
				29 01 00 00 00 00 02 D8 E6
				29 01 00 00 00 00 02 D9 03
				29 01 00 00 00 00 02 DA 15
				29 01 00 00 00 00 02 DB 03
				29 01 00 00 00 00 02 DC 2B
				29 01 00 00 00 00 02 DD 03
				29 01 00 00 00 00 02 DE 4C
				29 01 00 00 00 00 02 DF 03
				29 01 00 00 00 00 02 E0 57
				29 01 00 00 00 00 02 E1 03
				29 01 00 00 00 00 02 E2 62
				29 01 00 00 00 00 02 E3 03
				29 01 00 00 00 00 02 E4 6B
				29 01 00 00 00 00 02 E5 03
				29 01 00 00 00 00 02 E6 78
				29 01 00 00 00 00 02 E7 03
				29 01 00 00 00 00 02 E8 87
				29 01 00 00 00 00 02 E9 03
				29 01 00 00 00 00 02 EA 99
				29 01 00 00 00 00 02 EB 03
				29 01 00 00 00 00 02 EC CF
				29 01 00 00 00 00 02 ED 03
				29 01 00 00 00 00 02 EE D3
				29 01 00 00 00 00 02 EF 01
				29 01 00 00 00 00 02 F0 A5
				29 01 00 00 00 00 02 F1 01
				29 01 00 00 00 00 02 F2 A7
				29 01 00 00 00 00 02 F3 01
				29 01 00 00 00 00 02 F4 AC
				29 01 00 00 00 00 02 F5 01
				29 01 00 00 00 00 02 F6 B0
				29 01 00 00 00 00 02 F7 01
				29 01 00 00 00 00 02 F8 B4
				29 01 00 00 00 00 02 F9 01
				29 01 00 00 00 00 02 FA B8
				29 01 00 00 00 00 02 FF 21
				29 01 00 00 00 00 02 00 01
				29 01 00 00 00 00 02 01 BC
				29 01 00 00 00 00 02 02 01
				29 01 00 00 00 00 02 03 C0
				29 01 00 00 00 00 02 04 01
				29 01 00 00 00 00 02 05 C4
				29 01 00 00 00 00 02 06 01
				29 01 00 00 00 00 02 07 D3
				29 01 00 00 00 00 02 08 01
				29 01 00 00 00 00 02 09 E1
				29 01 00 00 00 00 02 0A 01
				29 01 00 00 00 00 02 0B FB
				29 01 00 00 00 00 02 0C 02
				29 01 00 00 00 00 02 0D 14
				29 01 00 00 00 00 02 0E 02
				29 01 00 00 00 00 02 0F 40
				29 01 00 00 00 00 02 10 02
				29 01 00 00 00 00 02 11 67
				29 01 00 00 00 00 02 12 02
				29 01 00 00 00 00 02 13 68
				29 01 00 00 00 00 02 14 02
				29 01 00 00 00 00 02 15 94
				29 01 00 00 00 00 02 16 02
				29 01 00 00 00 00 02 17 C3
				29 01 00 00 00 00 02 18 02
				29 01 00 00 00 00 02 19 E3
				29 01 00 00 00 00 02 1A 03
				29 01 00 00 00 00 02 1B 12
				29 01 00 00 00 00 02 1C 03
				29 01 00 00 00 00 02 1D 2B
				29 01 00 00 00 00 02 1E 03
				29 01 00 00 00 00 02 1F 4D
				29 01 00 00 00 00 02 20 03
				29 01 00 00 00 00 02 21 58
				29 01 00 00 00 00 02 22 03
				29 01 00 00 00 00 02 23 64
				29 01 00 00 00 00 02 24 03
				29 01 00 00 00 00 02 25 6F
				29 01 00 00 00 00 02 26 03
				29 01 00 00 00 00 02 27 7E
				29 01 00 00 00 00 02 28 03
				29 01 00 00 00 00 02 29 92
				29 01 00 00 00 00 02 2A 03
				29 01 00 00 00 00 02 2B B2
				29 01 00 00 00 00 02 2D 03
				29 01 00 00 00 00 02 2F CF
				29 01 00 00 00 00 02 30 03
				29 01 00 00 00 00 02 31 D3
				29 01 00 00 00 00 02 32 01
				29 01 00 00 00 00 02 33 A5
				29 01 00 00 00 00 02 34 01
				29 01 00 00 00 00 02 35 A7
				29 01 00 00 00 00 02 36 01
				29 01 00 00 00 00 02 37 AC
				29 01 00 00 00 00 02 38 01
				29 01 00 00 00 00 02 39 B0
				29 01 00 00 00 00 02 3A 01
				29 01 00 00 00 00 02 3B B4
				29 01 00 00 00 00 02 3D 01
				29 01 00 00 00 00 02 3F B8
				29 01 00 00 00 00 02 40 01
				29 01 00 00 00 00 02 41 BC
				29 01 00 00 00 00 02 42 01
				29 01 00 00 00 00 02 43 C0
				29 01 00 00 00 00 02 44 01
				29 01 00 00 00 00 02 45 C4
				29 01 00 00 00 00 02 46 01
				29 01 00 00 00 00 02 47 D3
				29 01 00 00 00 00 02 48 01
				29 01 00 00 00 00 02 49 E1
				29 01 00 00 00 00 02 4A 01
				29 01 00 00 00 00 02 4B FB
				29 01 00 00 00 00 02 4C 02
				29 01 00 00 00 00 02 4D 14
				29 01 00 00 00 00 02 4E 02
				29 01 00 00 00 00 02 4F 40
				29 01 00 00 00 00 02 50 02
				29 01 00 00 00 00 02 51 67
				29 01 00 00 00 00 02 52 02
				29 01 00 00 00 00 02 53 68
				29 01 00 00 00 00 02 54 02
				29 01 00 00 00 00 02 55 94
				29 01 00 00 00 00 02 56 02
				29 01 00 00 00 00 02 58 C3
				29 01 00 00 00 00 02 59 02
				29 01 00 00 00 00 02 5A E3
				29 01 00 00 00 00 02 5B 03
				29 01 00 00 00 00 02 5C 12
				29 01 00 00 00 00 02 5D 03
				29 01 00 00 00 00 02 5E 2B
				29 01 00 00 00 00 02 5F 03
				29 01 00 00 00 00 02 60 4D
				29 01 00 00 00 00 02 61 03
				29 01 00 00 00 00 02 62 58
				29 01 00 00 00 00 02 63 03
				29 01 00 00 00 00 02 64 64
				29 01 00 00 00 00 02 65 03
				29 01 00 00 00 00 02 66 6F
				29 01 00 00 00 00 02 67 03
				29 01 00 00 00 00 02 68 7E
				29 01 00 00 00 00 02 69 03
				29 01 00 00 00 00 02 6A 92
				29 01 00 00 00 00 02 6B 03
				29 01 00 00 00 00 02 6C B2
				29 01 00 00 00 00 02 6D 03
				29 01 00 00 00 00 02 6E CF
				29 01 00 00 00 00 02 6F 03
				29 01 00 00 00 00 02 70 D3
				29 01 00 00 00 00 02 71 01
				29 01 00 00 00 00 02 72 FA
				29 01 00 00 00 00 02 73 01
				29 01 00 00 00 00 02 74 FB
				29 01 00 00 00 00 02 75 01
				29 01 00 00 00 00 02 76 FE
				29 01 00 00 00 00 02 77 02
				29 01 00 00 00 00 02 78 01
				29 01 00 00 00 00 02 79 02
				29 01 00 00 00 00 02 7A 03
				29 01 00 00 00 00 02 7B 02
				29 01 00 00 00 00 02 7C 06
				29 01 00 00 00 00 02 7D 02
				29 01 00 00 00 00 02 7E 08
				29 01 00 00 00 00 02 7F 02
				29 01 00 00 00 00 02 80 0B
				29 01 00 00 00 00 02 81 02
				29 01 00 00 00 00 02 82 0D
				29 01 00 00 00 00 02 83 02
				29 01 00 00 00 00 02 84 17
				29 01 00 00 00 00 02 85 02
				29 01 00 00 00 00 02 86 20
				29 01 00 00 00 00 02 87 02
				29 01 00 00 00 00 02 88 32
				29 01 00 00 00 00 02 89 02
				29 01 00 00 00 00 02 8A 44
				29 01 00 00 00 00 02 8B 02
				29 01 00 00 00 00 02 8C 66
				29 01 00 00 00 00 02 8D 02
				29 01 00 00 00 00 02 8E 87
				29 01 00 00 00 00 02 8F 02
				29 01 00 00 00 00 02 90 88
				29 01 00 00 00 00 02 91 02
				29 01 00 00 00 00 02 92 AE
				29 01 00 00 00 00 02 93 02
				29 01 00 00 00 00 02 94 DC
				29 01 00 00 00 00 02 95 03
				29 01 00 00 00 00 02 96 00
				29 01 00 00 00 00 02 97 03
				29 01 00 00 00 00 02 98 2C
				29 01 00 00 00 00 02 99 03
				29 01 00 00 00 00 02 9A 50
				29 01 00 00 00 00 02 9B 03
				29 01 00 00 00 00 02 9C 6B
				29 01 00 00 00 00 02 9D 03
				29 01 00 00 00 00 02 9E 6C
				29 01 00 00 00 00 02 9F 03
				29 01 00 00 00 00 02 A0 6D
				29 01 00 00 00 00 02 A2 03
				29 01 00 00 00 00 02 A3 6E
				29 01 00 00 00 00 02 A4 03
				29 01 00 00 00 00 02 A5 79
				29 01 00 00 00 00 02 A6 03
				29 01 00 00 00 00 02 A7 8C
				29 01 00 00 00 00 02 A9 03
				29 01 00 00 00 00 02 AA B3
				29 01 00 00 00 00 02 AB 03
				29 01 00 00 00 00 02 AC CF
				29 01 00 00 00 00 02 AD 03
				29 01 00 00 00 00 02 AE D3
				29 01 00 00 00 00 02 AF 01
				29 01 00 00 00 00 02 B0 FA
				29 01 00 00 00 00 02 B1 01
				29 01 00 00 00 00 02 B2 FB
				29 01 00 00 00 00 02 B3 01
				29 01 00 00 00 00 02 B4 FE
				29 01 00 00 00 00 02 B5 02
				29 01 00 00 00 00 02 B6 01
				29 01 00 00 00 00 02 B7 02
				29 01 00 00 00 00 02 B8 03
				29 01 00 00 00 00 02 B9 02
				29 01 00 00 00 00 02 BA 06
				29 01 00 00 00 00 02 BB 02
				29 01 00 00 00 00 02 BC 08
				29 01 00 00 00 00 02 BD 02
				29 01 00 00 00 00 02 BE 0B
				29 01 00 00 00 00 02 BF 02
				29 01 00 00 00 00 02 C0 0D
				29 01 00 00 00 00 02 C1 02
				29 01 00 00 00 00 02 C2 17
				29 01 00 00 00 00 02 C3 02
				29 01 00 00 00 00 02 C4 20
				29 01 00 00 00 00 02 C5 02
				29 01 00 00 00 00 02 C6 32
				29 01 00 00 00 00 02 C7 02
				29 01 00 00 00 00 02 C8 44
				29 01 00 00 00 00 02 C9 02
				29 01 00 00 00 00 02 CA 66
				29 01 00 00 00 00 02 CB 02
				29 01 00 00 00 00 02 CC 87
				29 01 00 00 00 00 02 CD 02
				29 01 00 00 00 00 02 CE 88
				29 01 00 00 00 00 02 CF 02
				29 01 00 00 00 00 02 D0 AE
				29 01 00 00 00 00 02 D1 02
				29 01 00 00 00 00 02 D2 DC
				29 01 00 00 00 00 02 D3 03
				29 01 00 00 00 00 02 D4 00
				29 01 00 00 00 00 02 D5 03
				29 01 00 00 00 00 02 D6 2C
				29 01 00 00 00 00 02 D7 03
				29 01 00 00 00 00 02 D8 50
				29 01 00 00 00 00 02 D9 03
				29 01 00 00 00 00 02 DA 6B
				29 01 00 00 00 00 02 DB 03
				29 01 00 00 00 00 02 DC 6C
				29 01 00 00 00 00 02 DD 03
				29 01 00 00 00 00 02 DE 6D
				29 01 00 00 00 00 02 DF 03
				29 01 00 00 00 00 02 E0 6E
				29 01 00 00 00 00 02 E1 03
				29 01 00 00 00 00 02 E2 79
				29 01 00 00 00 00 02 E3 03
				29 01 00 00 00 00 02 E4 8C
				29 01 00 00 00 00 02 E5 03
				29 01 00 00 00 00 02 E6 B3
				29 01 00 00 00 00 02 E7 03
				29 01 00 00 00 00 02 E8 CF
				29 01 00 00 00 00 02 E9 03
				29 01 00 00 00 00 02 EA D3];

		qcom,mdss-dsi-on-command-state = "dsi_lp_mode";
		qcom,mdss-dsi-off-command-state = "dsi_hs_mode";
		fih,mdss-dsi-color-command-state = "dsi_lp_mode";
		qcom,mdss-dsi-h-sync-pulse = <1>;
		qcom,mdss-dsi-traffic-mode = "burst_mode";
		qcom,mdss-dsi-lane-map = <0>;
		qcom,mdss-dsi-bllp-eof-power-mode;
		qcom,mdss-dsi-bllp-power-mode;
		qcom,mdss-dsi-lane-0-state;
		qcom,mdss-dsi-lane-1-state;
		qcom,mdss-dsi-lane-2-state;
		qcom,mdss-dsi-lane-3-state;
		/* command mode*/
		qcom,mdss-dsi-te-pin-select = <1>;
		qcom,mdss-dsi-te-v-sync-rd-ptr-irq-line = <0x2c>;
		qcom,mdss-dsi-te-v-sync-continue-lines = <0x3c>;
		qcom,mdss-dsi-te-dcs-command = <1>;
		qcom,mdss-dsi-te-check-enable;
		qcom,mdss-dsi-te-using-te-pin;
		/* command mode */
		qcom,mdss-dsi-panel-timings = [E7 36 24 00 66 6A 2A 3A 2D 03 04 00];
		qcom,mdss-dsi-t-clk-post = <0x03>;
		qcom,mdss-dsi-t-clk-pre = <0x2B>;
		qcom,mdss-dsi-bl-min-level = <1>;
		qcom,mdss-dsi-bl-max-level = <255>;
		qcom,mdss-dsi-dma-trigger = <0x04>;
		qcom,mdss-dsi-mdp-trigger = <0x0>;
		qcom,mdss-dsi-bl-pmic-control-type = "bl_i2c_rt4501";
		qcom,mdss-dsi-bias-p-en-gpio = <&msmgpio 129 0>;
		qcom,mdss-dsi-bias-n-en-gpio = <&msmgpio 130 0>;
		qcom,mdss-dsi-reset-sequence = <0 11>, <1 11>, <0 1>, <1 11>;
		qcom,mdss-pan-physical-width-dimension = <68>;	/* 68.04mm */
		qcom,mdss-pan-physical-height-dimension = <121>;	/* 120.96mm */
	};
};
