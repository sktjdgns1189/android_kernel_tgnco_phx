&i2c_6 {
	nxp_nfc@28 {
		compatible = "nxp,nfc-pn547";
		reg = <0x28>;
		nxp,ven-gpio = <&msmgpio 75 0x00>;
		nxp,firm-gpio = <&msmgpio 120 0x00>;
		interrupt-parent = <&msmgpio>;
		interrupts = <46 0x2>;
		nxp,irq-gpio = <&msmgpio 46 0x00>;
	};
};
